## components/esp_extractor_service/examples/extractor_service/main/Kconfig.projbuild
```kconfig
# SPDX-FileCopyrightText: 2026 Espressif Systems (Shanghai) CO., LTD
# SPDX-License-Identifier: LicenseRef-Espressif-Modified-MIT

menu "Extractor Service Example"

    config EXTRACTOR_EXAMPLE_WIFI_SSID
        string "WiFi SSID"
        default "myssid"
        help
            STA SSID used by esp_wifi_service_request_connect().

    config EXTRACTOR_EXAMPLE_WIFI_PASSWORD
        string "WiFi password"
        default "mypassword"
        help
            STA password used by esp_wifi_service_request_connect().

    config EXTRACTOR_EXAMPLE_WIFI_WAIT_SEC
        int "WiFi connect wait (seconds)"
        default 30
        range 5 120
        help
            Seconds to wait for STA got IP after request_connect.

    if ESP_EXTRACTOR_SERVICE_MCP_ENABLE && ESP_MCP_TRANSPORT_UART

    menu "MCP UART pins"

        config EXTRACTOR_MCP_UART_PORT
            int "MCP UART port number"
            range 0 2
            default 1

        config EXTRACTOR_MCP_UART_TX_IO
            int "MCP UART TX GPIO"
            range 0 48
            default 21

        config EXTRACTOR_MCP_UART_RX_IO
            int "MCP UART RX GPIO"
            range 0 48
            default 22

        config EXTRACTOR_MCP_UART_BAUD
            int "MCP UART baud rate"
            default 115200

    endmenu

    endif

endmenu
```

## components/esp_extractor_service/examples/extractor_service/sdkconfig.defaults
```kconfig
CONFIG_ESP_MAIN_TASK_STACK_SIZE=10240
CONFIG_FREERTOS_HZ=1000
CONFIG_ESP_TASK_WDT_EN=n
CONFIG_ESP_INT_WDT=n

CONFIG_SPIRAM=y
CONFIG_ESPTOOLPY_FLASHSIZE_4MB=y

# FatFS / SD
CONFIG_FATFS_LFN_HEAP=y

# Extractor service: enable file, HTTP and HLS by default
CONFIG_ESP_EXTRACTOR_SERVICE_FILE_IO_SUPPORT=y
CONFIG_ESP_EXTRACTOR_SERVICE_HTTP_IO_SUPPORT=y
CONFIG_ESP_EXTRACTOR_SERVICE_HLS_SUPPORT=y

# Dummy sink for link case
CONFIG_ESP_MEDIA_DUMMY_SERVICE_SINK_SUPPORT=y

# Common extractors used by demos
CONFIG_MP4_EXTRACTOR_SUPPORT=y
CONFIG_WAV_EXTRACTOR_SUPPORT=y
CONFIG_AUDIO_ES_EXTRACTOR_SUPPORT=y
CONFIG_TS_EXTRACTOR_SUPPORT=y

CONFIG_PARTITION_TABLE_CUSTOM=y
CONFIG_PARTITION_TABLE_CUSTOM_FILENAME="partitions.csv"

CONFIG_ESP_MCP_ENABLE=y
CONFIG_ESP_MCP_TRANSPORT_UART=y
CONFIG_ESP_EXTRACTOR_SERVICE_MCP_ENABLE=y
CONFIG_ESP_MEDIA_SERVICE_MCP_ENABLE=y
```

## components/esp_extractor_service/examples/extractor_service/sdkconfig.defaults.esp32s3
```kconfig
CONFIG_SPIRAM_MODE_OCT=y
CONFIG_SPIRAM_SPEED_80M=y
CONFIG_ESP32S3_SPIRAM_SUPPORT=y

# Wifi static buffer refine
CONFIG_ESP_WIFI_STATIC_RX_BUFFER_NUM=8
CONFIG_ESP_WIFI_STATIC_TX_BUFFER_NUM=8
CONFIG_ESP_WIFI_DYNAMIC_RX_MGMT_BUFFER=y
CONFIG_ESP_WIFI_IRAM_OPT=n
CONFIG_ESP_WIFI_RX_IRAM_OPT=n

CONFIG_COMPILER_OPTIMIZATION_PERF=y

CONFIG_ESP_DEFAULT_CPU_FREQ_MHZ_240=y
CONFIG_ESP32S3_INSTRUCTION_CACHE_32KB=y
CONFIG_ESP32S3_DATA_CACHE_64KB=y
CONFIG_ESP32S3_DATA_CACHE_LINE_64B=y

CONFIG_FLASHMODE_QIO=y
CONFIG_ESPTOOLPY_FLASHMODE_QIO=y

CONFIG_SPIRAM_MALLOC_ALWAYSINTERNAL=128

CONFIG_ESP_ALLOW_BSS_SEG_EXTERNAL_MEMORY=y
CONFIG_SPIRAM_ALLOW_BSS_SEG_EXTERNAL_MEMORY=y

CONFIG_EXTRACTOR_MCP_UART_TX_IO=17
CONFIG_EXTRACTOR_MCP_UART_RX_IO=18
```
