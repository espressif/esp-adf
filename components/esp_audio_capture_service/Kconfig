## components/esp_audio_capture_service/Kconfig
```kconfig
menu "ESP Audio Capture Service"

    config ESP_AUDIO_CAPTURE_SERVICE_AI_SRC_ENABLED
        bool "Enable AI audio source"
        default y
        help
            Compile the AI audio source implementation.

    if ESP_AUDIO_CAPTURE_SERVICE_AI_SRC_ENABLED

    config ESP_AUDIO_CAPTURE_SERVICE_AI_SRC_AFE_SUPPORT
        bool "Enable AI source AFE support"
        default y

    config ESP_AUDIO_CAPTURE_SERVICE_AI_SRC_AEC_SUPPORT
        bool "Enable AI source AEC support"
        default y

    config ESP_AUDIO_CAPTURE_SERVICE_AI_SRC_VAD_SUPPORT
        bool "Enable AI source VAD support"
        default y

    config ESP_AUDIO_CAPTURE_SERVICE_AI_SRC_NS_SUPPORT
        bool "Enable AI source NS support"
        default y

    config ESP_AUDIO_CAPTURE_SERVICE_AI_SRC_WN_SUPPORT
        bool "Enable AI source WakeNet support"
        default y

    config ESP_AUDIO_CAPTURE_SERVICE_AI_SRC_DOA_SUPPORT
        bool "Enable AI source DOA support"
        default y

    endif  # ESP_AUDIO_CAPTURE_SERVICE_AI_SRC_ENABLED

    config ESP_AUDIO_CAPTURE_SERVICE_MCP_ENABLE
        bool "Enable audio capture service MCP tools"
        depends on ESP_MCP_ENABLE
        default n
        help
            Build the audio capture service MCP tool handler and embedded tool schema.
            This option depends on the global ESP Service MCP support.

endmenu
```

## components/esp_audio_capture_service/examples/audio_capture/main/Kconfig.projbuild
```kconfig
menu "Audio record example"

    config AUDIO_RECORD_ENABLE_VERIFY
        bool "Enable recorded-file playback verification"
        default y
        help
            Build the extractor, decoder, and player path used when the optional
            "verify" command argument is supplied.

    if ESP_AUDIO_CAPTURE_SERVICE_MCP_ENABLE && ESP_MCP_TRANSPORT_UART

    menu "MCP UART pins"

        config AUDIO_RECORD_MCP_UART_PORT
            int "MCP UART port number"
            range 0 2
            default 1
            help
                UART port used by the MCP transport. Keep this off the console UART.

        config AUDIO_RECORD_MCP_UART_TX_IO
            int "MCP UART TX GPIO"
            range 0 48
            default 21
            help
                Device TX pin. Connect to the USB-UART adapter RX.

        config AUDIO_RECORD_MCP_UART_RX_IO
            int "MCP UART RX GPIO"
            range 0 48
            default 22
            help
                Device RX pin. Connect to the USB-UART adapter TX.

        config AUDIO_RECORD_MCP_UART_BAUD
            int "MCP UART baud rate"
            default 115200
            help
                Baud rate for the MCP UART transport.

    endmenu

    endif  # ESP_AUDIO_CAPTURE_SERVICE_MCP_ENABLE && ESP_MCP_TRANSPORT_UART

endmenu
```

## components/esp_audio_capture_service/examples/audio_capture/sdkconfig.defaults
```kconfig
CONFIG_ESP_CAPTURE_ENABLE_AUDIO=y
CONFIG_ESP_MAIN_TASK_STACK_SIZE=10240
CONFIG_ESP_AUDIO_CAPTURE_SERVICE_AI_SRC_ENABLED=y
CONFIG_ESP_AUDIO_CAPTURE_SERVICE_AI_SRC_AFE_SUPPORT=y
CONFIG_ESP_AUDIO_CAPTURE_SERVICE_AI_SRC_AEC_SUPPORT=y
CONFIG_ESP_AUDIO_CAPTURE_SERVICE_AI_SRC_VAD_SUPPORT=y
CONFIG_ESP_AUDIO_CAPTURE_SERVICE_AI_SRC_NS_SUPPORT=y
CONFIG_ESP_AUDIO_CAPTURE_SERVICE_AI_SRC_WN_SUPPORT=y
CONFIG_ESP_AUDIO_CAPTURE_SERVICE_AI_SRC_DOA_SUPPORT=y
CONFIG_AUDIO_RECORD_ENABLE_VERIFY=y

CONFIG_SPIRAM=y
CONFIG_ESPTOOLPY_FLASHSIZE_8MB=y
CONFIG_PARTITION_TABLE_OFFSET=0x9000
CONFIG_PARTITION_TABLE_CUSTOM=y
CONFIG_PARTITION_TABLE_CUSTOM_FILENAME="partitions.csv"

# FatFS
CONFIG_FATFS_LFN_HEAP=y


CONFIG_FREERTOS_USE_TRACE_FACILITY=y
CONFIG_FREERTOS_VTASKLIST_INCLUDE_COREID=y
CONFIG_FREERTOS_GENERATE_RUN_TIME_STATS=y
CONFIG_FREERTOS_HZ=1000

# Only codecs used by settings.h and verification playback are linked.
CONFIG_AUDIO_DECODER_AAC_SUPPORT=y
CONFIG_AUDIO_DECODER_G711_SUPPORT=y
CONFIG_AUDIO_DECODER_PCM_SUPPORT=y
CONFIG_AUDIO_DECODER_MP3_SUPPORT=n
CONFIG_AUDIO_DECODER_AMRNB_SUPPORT=n
CONFIG_AUDIO_DECODER_AMRWB_SUPPORT=n
CONFIG_AUDIO_DECODER_FLAC_SUPPORT=n
CONFIG_AUDIO_DECODER_OPUS_SUPPORT=n
CONFIG_AUDIO_DECODER_VORBIS_SUPPORT=n
CONFIG_AUDIO_DECODER_ADPCM_SUPPORT=n
CONFIG_AUDIO_DECODER_ALAC_SUPPORT=n
CONFIG_AUDIO_DECODER_SBC_SUPPORT=n
CONFIG_AUDIO_DECODER_LC3_SUPPORT=n
CONFIG_AUDIO_DECODER_G722_SUPPORT=n
CONFIG_AUDIO_ENCODER_AAC_SUPPORT=y
CONFIG_AUDIO_ENCODER_G711_SUPPORT=y
CONFIG_AUDIO_ENCODER_PCM_SUPPORT=y
CONFIG_AUDIO_ENCODER_AMRNB_SUPPORT=n
CONFIG_AUDIO_ENCODER_AMRWB_SUPPORT=n
CONFIG_AUDIO_ENCODER_OPUS_SUPPORT=n
CONFIG_AUDIO_ENCODER_ADPCM_SUPPORT=n
CONFIG_AUDIO_ENCODER_ALAC_SUPPORT=n
CONFIG_AUDIO_ENCODER_SBC_SUPPORT=n
CONFIG_AUDIO_ENCODER_LC3_SUPPORT=n
CONFIG_AUDIO_ENCODER_G722_SUPPORT=n

CONFIG_ESP_MUXER_MP4_SUPPORT=y
CONFIG_ESP_MUXER_WAV_SUPPORT=y
CONFIG_ESP_MUXER_TS_SUPPORT=n
CONFIG_ESP_MUXER_OGG_SUPPORT=n
CONFIG_ESP_MUXER_FLV_SUPPORT=n
CONFIG_ESP_MUXER_CAF_SUPPORT=n
CONFIG_ESP_MUXER_AVI_SUPPORT=n

CONFIG_AUDIO_ES_EXTRACTOR_SUPPORT=y
CONFIG_MP4_EXTRACTOR_SUPPORT=y
CONFIG_WAV_EXTRACTOR_SUPPORT=y
CONFIG_TS_EXTRACTOR_SUPPORT=n
CONFIG_OGG_EXTRACTOR_SUPPORT=n
CONFIG_AVI_EXTRACTOR_SUPPORT=n
CONFIG_CAF_EXTRACTOR_SUPPORT=n
CONFIG_FLV_EXTRACTOR_SUPPORT=n

#
# Watchdog off so heap_trace_dump can finish printing
#
# CONFIG_TASK_WDT_PANIC is not set
CONFIG_ESP_TASK_WDT_EN=n
CONFIG_ESP_INT_WDT=n

#
# Heap tracing for run_all with_trace
#
CONFIG_HEAP_TRACING_STANDALONE=y
CONFIG_HEAP_TRACING=y
CONFIG_HEAP_TRACING_STACK_DEPTH=7
CONFIG_ESP_MEDIA_DUMMY_SERVICE_SINK_SUPPORT=y

# MCP UART verification (reuse component MCP Kconfig; no extra example enable switch)
CONFIG_ESP_MCP_ENABLE=y
CONFIG_ESP_MCP_TRANSPORT_UART=y
#CONFIG_ESP_AUDIO_CAPTURE_SERVICE_MCP_ENABLE=y
CONFIG_ESP_MEDIA_SERVICE_MCP_ENABLE=y
```

## components/esp_audio_capture_service/examples/audio_capture/sdkconfig.defaults.esp32s3
```kconfig
CONFIG_ESPTOOLPY_FLASHFREQ_120M=y
CONFIG_ESPTOOLPY_FLASHSIZE_4MB=y
# Required for IDF 6.x when running QSPI Flash > 80MHz on ESP32-S3
CONFIG_SPI_FLASH_HPM_ENA=y
CONFIG_BOOTLOADER_FLASH_DC_AWARE=y

CONFIG_SPIRAM_MODE_OCT=y
CONFIG_SPIRAM_SPEED_120M=y
CONFIG_ESP32S3_SPIRAM_SUPPORT=y


CONFIG_COMPILER_OPTIMIZATION_PERF=y

CONFIG_ESP_DEFAULT_CPU_FREQ_MHZ_240=y
CONFIG_ESP32S3_INSTRUCTION_CACHE_32KB=y
CONFIG_ESP32S3_DATA_CACHE_64KB=y
CONFIG_ESP32S3_DATA_CACHE_LINE_64B=y

CONFIG_FLASHMODE_QIO=y
CONFIG_ESPTOOLPY_FLASHMODE_QIO=y

CONFIG_SPIRAM_MALLOC_ALWAYSINTERNAL=128

CONFIG_ESP_ALLOW_BSS_SEG_EXTERNAL_MEMORY=y
CONFIG_SPIRAM_ALLOW_BSS_SEG_EXTERNAL_MEMORY=y
CONFIG_CAMERA_TASK_STACK_SIZE=4096

CONFIG_SR_WN_WN9S_HILEXIN=y
```

## components/esp_audio_capture_service/test_apps/sdkconfig.defaults
```kconfig
CONFIG_ESP_CAPTURE_ENABLE_AUDIO=y
CONFIG_PARTITION_TABLE_OFFSET=0x10000
CONFIG_ESP_MAIN_TASK_STACK_SIZE=10240
CONFIG_ESP_AUDIO_CAPTURE_SERVICE_ENABLE_CODEC_SRC=y
CONFIG_ESP_AUDIO_CAPTURE_SERVICE_ENABLE_AEC_SRC=n
CONFIG_ESP_AUDIO_CAPTURE_SERVICE_ENABLE_AI_AUD_SRC=y
CONFIG_ESP_AUDIO_CAPTURE_SERVICE_PORT_NUM=1

CONFIG_SPIRAM=y
CONFIG_ESPTOOLPY_FLASHSIZE_8MB=y
CONFIG_PARTITION_TABLE_OFFSET=0x9000
CONFIG_PARTITION_TABLE_CUSTOM=y
CONFIG_PARTITION_TABLE_CUSTOM_FILENAME="partitions.csv"
```

## components/esp_audio_player_service/Kconfig
```kconfig
menu "ESP Audio Player Service"

    config AUDIO_PLAYER_SERVICE_MCP_ENABLE
        bool "Enable audio player MCP tools"
        depends on ESP_MCP_ENABLE
        default n
        help
            Compile the audio player MCP handler and a complete flash-resident
            schema (playback tools plus ID3). Tool names use the
            esp_audio_player_service_ prefix.

endmenu
```

## components/esp_audio_player_service/examples/audio_player_mcp_example/main/Kconfig.projbuild
```kconfig
menu "Audio Player MCP Example"

    choice EXAMPLE_WIFI_MODE
        prompt "Wi-Fi mode for MCP HTTP"
        default EXAMPLE_WIFI_MODE_SOFTAP
        help
            SoftAP needs no router credentials: connect the PC to the board AP,
            then POST to http://192.168.4.1:8080/mcp.
            STA joins an existing AP; set SSID/password below.

        config EXAMPLE_WIFI_MODE_SOFTAP
            bool "SoftAP (recommended for smoke test)"

        config EXAMPLE_WIFI_MODE_STA
            bool "Station (join existing Wi-Fi)"
    endchoice

    config EXAMPLE_WIFI_SSID
        string "Wi-Fi SSID"
        default "esp-audio-mcp" if EXAMPLE_WIFI_MODE_SOFTAP
        default "myssid" if EXAMPLE_WIFI_MODE_STA
        help
            SoftAP SSID advertised by the board, or STA target SSID.

    config EXAMPLE_WIFI_PASSWORD
        string "Wi-Fi password"
        default "" if EXAMPLE_WIFI_MODE_SOFTAP
        default "mypassword" if EXAMPLE_WIFI_MODE_STA
        help
            SoftAP: leave empty for open AP. STA: WPA2 password.
            Do not commit real credentials into sdkconfig.defaults.

    config EXAMPLE_MCP_HTTP_PORT
        int "MCP HTTP listen port"
        default 8080
        range 1 65535

    config EXAMPLE_MCP_HTTP_URI
        string "MCP HTTP URI path"
        default "/mcp"

endmenu
```

## components/esp_audio_player_service/examples/audio_player_mcp_example/sdkconfig.defaults
```kconfig
CONFIG_AUDIO_PLAYER_SERVICE_MCP_ENABLE=y
CONFIG_ESP_MCP_ENABLE=y
CONFIG_ESP_MCP_TRANSPORT_HTTP=y

CONFIG_EXAMPLE_WIFI_MODE_SOFTAP=y
CONFIG_EXAMPLE_WIFI_SSID="esp-audio-mcp"
CONFIG_EXAMPLE_WIFI_PASSWORD=""
CONFIG_EXAMPLE_MCP_HTTP_PORT=8080
CONFIG_EXAMPLE_MCP_HTTP_URI="/mcp"

CONFIG_ESP_MAIN_TASK_STACK_SIZE=10240
CONFIG_ESP_TASK_WDT_INIT=n

CONFIG_ESP_PLAYER_ENABLE_AUDIO=y
CONFIG_ESP_PLAYER_ENABLE_VIDEO=n
CONFIG_ESP_PLAYER_ENABLE_HLS_IO=n

CONFIG_SPIRAM=y
CONFIG_ESPTOOLPY_FLASHSIZE_8MB=y
CONFIG_PARTITION_TABLE_OFFSET=0x9000
CONFIG_PARTITION_TABLE_CUSTOM=y
CONFIG_PARTITION_TABLE_CUSTOM_FILENAME="partitions.csv"
```

## components/esp_audio_player_service/examples/audio_player_mix_cli_example/sdkconfig.defaults
```kconfig
CONFIG_ESP_MAIN_TASK_STACK_SIZE=10240
CONFIG_ESP_TASK_WDT_INIT=n

CONFIG_ESP_PLAYER_ENABLE_AUDIO=y
CONFIG_ESP_PLAYER_ENABLE_VIDEO=n
CONFIG_ESP_PLAYER_ENABLE_HLS_IO=n

# Dummy SRC for `start link` (looping pattern AAC, no extra SD files).
CONFIG_ESP_MEDIA_DUMMY_SERVICE_SRC_SUPPORT=y

CONFIG_SPIRAM=y
CONFIG_ESPTOOLPY_FLASHSIZE_8MB=y
CONFIG_PARTITION_TABLE_OFFSET=0x9000
CONFIG_PARTITION_TABLE_CUSTOM=y
CONFIG_PARTITION_TABLE_CUSTOM_FILENAME="partitions.csv"
CONFIG_ESP_CONSOLE_UART=y
CONFIG_FATFS_LFN_HEAP=y
```

## components/esp_bt_hub/examples/bt_hub/sdkconfig.defaults.esp32
```kconfig
CONFIG_BT_ENABLED=y
CONFIG_BT_BLUEDROID_ENABLED=y
# CONFIG_BT_NIMBLE_ENABLED is not set
CONFIG_BT_CONTROLLER_ENABLED=y
CONFIG_BT_CLASSIC_ENABLED=y
CONFIG_BT_BLE_ENABLED=y
CONFIG_BTDM_CTRL_MODE_BLE_ONLY=n
CONFIG_BTDM_CTRL_MODE_BR_EDR_ONLY=n
CONFIG_BTDM_CTRL_MODE_BTDM=y
```

## components/esp_bt_hub/examples/bt_hub/sdkconfig.defaults.esp32s3
```kconfig
CONFIG_BT_ENABLED=y
CONFIG_BT_BLUEDROID_ENABLED=y
# CONFIG_BT_NIMBLE_ENABLED is not set
CONFIG_BT_CONTROLLER_ENABLED=y
# CONFIG_BT_CLASSIC_ENABLED is not set
CONFIG_BT_BLE_ENABLED=y
```

## components/esp_bt_hub/examples/bt_hub/sdkconfig.defaults.esp32s31
```kconfig
CONFIG_BT_ENABLED=y
CONFIG_BT_BLUEDROID_ENABLED=y
# CONFIG_BT_NIMBLE_ENABLED is not set
CONFIG_BT_CONTROLLER_ENABLED=y
CONFIG_BT_CLASSIC_ENABLED=y
CONFIG_BT_BLE_ENABLED=y
CONFIG_BTDM_CTRL_MODE_BLE_ONLY=n
CONFIG_BTDM_CTRL_MODE_BR_EDR_ONLY=n
CONFIG_BTDM_CTRL_MODE_BTDM=y
CONFIG_BT_LE_50_FEATURE_SUPPORT=y
CONFIG_BT_LE_EXT_ADV=y
CONFIG_BT_LE_MAX_EXT_ADV_INSTANCES=1
CONFIG_BT_BLE_50_FEATURES_SUPPORTED=y
CONFIG_BT_BLE_50_EXTEND_ADV_EN=y
CONFIG_BT_BLE_50_EXTEND_SCAN_EN=y
```

## components/esp_bt_hub/examples/bt_hub/sdkconfig.defaults.esp32s31.nimble
```kconfig
CONFIG_BT_ENABLED=y
# CONFIG_BT_BLUEDROID_ENABLED is not set
CONFIG_BT_NIMBLE_ENABLED=y
CONFIG_BT_CONTROLLER_ENABLED=y
# CONFIG_BT_CLASSIC_ENABLED is not set
CONFIG_BTDM_CTRL_MODE_BLE_ONLY=y
# CONFIG_BTDM_CTRL_MODE_BR_EDR_ONLY is not set
# CONFIG_BTDM_CTRL_MODE_BTDM is not set
CONFIG_BT_LE_50_FEATURE_SUPPORT=y
CONFIG_BT_LE_EXT_ADV=y
CONFIG_BT_LE_MAX_EXT_ADV_INSTANCES=1
CONFIG_BT_NIMBLE_ROLE_CENTRAL=y
CONFIG_BT_NIMBLE_ROLE_PERIPHERAL=y
CONFIG_BT_NIMBLE_ROLE_BROADCASTER=y
CONFIG_BT_NIMBLE_ROLE_OBSERVER=y
CONFIG_BT_NIMBLE_50_FEATURE_SUPPORT=y
CONFIG_BT_NIMBLE_EXT_ADV=y
CONFIG_BT_NIMBLE_MAX_EXT_ADV_INSTANCES=2
CONFIG_BT_NIMBLE_NVS_PERSIST=y
CONFIG_ESP_CONSOLE_UART_DEFAULT=y
CONFIG_PARTITION_TABLE_SINGLE_APP_LARGE=y
```

## components/esp_bt_hub/test_apps/esp_bt_hub_test_bluedroid/sdkconfig.defaults
```kconfig
CONFIG_BT_ENABLED=y
CONFIG_BT_BLUEDROID_ENABLED=y
# CONFIG_BT_NIMBLE_ENABLED is not set
CONFIG_BT_CLASSIC_ENABLED=y
CONFIG_LOG_DEFAULT_LEVEL_INFO=y
CONFIG_ESP_MAIN_TASK_STACK_SIZE=8192
```

## components/esp_bt_hub/test_apps/esp_bt_hub_test_bluedroid/sdkconfig.defaults.esp32
```kconfig
CONFIG_ESPTOOLPY_FLASHSIZE_8MB=y
CONFIG_ESPTOOLPY_FLASHSIZE="8MB"

CONFIG_BT_BLE_ENABLED=y
CONFIG_BT_BLE_42_FEATURES_SUPPORTED=y
CONFIG_BTDM_CTRL_MODE_BTDM=y
# CONFIG_BTDM_CTRL_MODE_BR_EDR_ONLY is not set
# CONFIG_BTDM_CTRL_MODE_BLE_ONLY is not set
```

## components/esp_bt_hub/test_apps/esp_bt_hub_test_nimble/sdkconfig.defaults
```kconfig
CONFIG_BT_ENABLED=y
# CONFIG_BT_BLUEDROID_ENABLED is not set
CONFIG_BT_NIMBLE_ENABLED=y
# CONFIG_BT_CLASSIC_ENABLED is not set
CONFIG_BT_NIMBLE_ROLE_CENTRAL=y
CONFIG_BT_NIMBLE_ROLE_PERIPHERAL=y
CONFIG_BT_NIMBLE_ROLE_BROADCASTER=y
CONFIG_BT_NIMBLE_ROLE_OBSERVER=y
CONFIG_BT_NIMBLE_EXT_ADV=y
CONFIG_BT_NIMBLE_MAX_EXT_ADV_INSTANCES=2
CONFIG_LOG_DEFAULT_LEVEL_INFO=y
CONFIG_ESP_MAIN_TASK_STACK_SIZE=8192
```

## components/esp_capture_service/test_apps/sdkconfig.defaults
```kconfig
CONFIG_ESP_CAPTURE_ENABLE_AUDIO=y
CONFIG_ESP_CAPTURE_ENABLE_VIDEO=y
CONFIG_ESP_CAPTURE_ENABLE_VIDEO_OVERLAY=y
CONFIG_PARTITION_TABLE_OFFSET=0x10000
CONFIG_ESP_MAIN_TASK_STACK_SIZE=10240
CONFIG_ESP_SYSTEM_PANIC_GDBSTUB=y
```

## components/esp_compact_font/Kconfig
```kconfig
menu "ESP Compact Font"

    comment "GFH is always built"

    config ESP_COMPACT_FONT_GFZ
        bool "GFZ zstd atlas"
        default n
        help
            Also accept a .gfz file: 2-bit pixels, one zstd frame per glyph,
            dictionary in the file. Leave this off unless that file should
            load. Turning it on compiles the zstd decoder into this component.

    config ESP_COMPACT_FONT_LVGL
        bool "LVGL bin font"
        default n
        help
            Accept the .bin written by lv_font_conv

endmenu
```

## components/esp_compact_font/examples/font_benchmark/sdkconfig.defaults
```kconfig
CONFIG_PARTITION_TABLE_CUSTOM=y
CONFIG_PARTITION_TABLE_CUSTOM_FILENAME="partitions.csv"
CONFIG_PARTITION_TABLE_OFFSET=0x9000
CONFIG_COMPILER_OPTIMIZATION_PERF=y
CONFIG_ESP_MAIN_TASK_STACK_SIZE=16384
CONFIG_SPIRAM_USE_MALLOC=y
CONFIG_SPIRAM_MALLOC_ALWAYSINTERNAL=2048
CONFIG_IDF_EXPERIMENTAL_FEATURES=y
CONFIG_ESP_COMPACT_FONT_LVGL=y
CONFIG_ESP_TASK_WDT_EN=n
```

## components/esp_extractor_service/Kconfig
```kconfig
menu "ESP-Extractor Service"

    config ESP_EXTRACTOR_SERVICE_FILE_IO_SUPPORT
        bool "Enable file GMF IO support"
        default y
        help
            Register file reader IO in the internal GMF pool when no pool is provided.

    config ESP_EXTRACTOR_SERVICE_HTTP_IO_SUPPORT
        bool "Enable HTTP GMF IO support"
        default y
        help
            Register HTTP/HTTPS reader IO in the internal GMF pool when no pool is provided.

    config ESP_EXTRACTOR_SERVICE_HLS_SUPPORT
        bool "Enable HLS extractor support"
        default n
        help
            Compile the HLS extractor path from esp_hls_stream.

    config ESP_EXTRACTOR_SERVICE_MCP_ENABLE
        bool "Enable extractor service MCP tools"
        depends on ESP_MCP_ENABLE
        default n
        help
            Build the extractor service MCP tool handler and embedded tool schema.
            This option depends on the global ESP Service MCP support.

endmenu
```
