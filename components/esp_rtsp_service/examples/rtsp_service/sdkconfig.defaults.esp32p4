## components/esp_rtsp_service/examples/rtsp_service/sdkconfig.defaults.esp32p4
```kconfig
# Flash setting
CONFIG_FLASHMODE_QIO=y
CONFIG_ESPTOOLPY_FLASHSIZE_8MB=y

CONFIG_SPIRAM_SPEED_250M=y

# If you use serial JTAG turn on this option
CONFIG_ESP_CONSOLE_USB_SERIAL_JTAG=y

# Set Slave target type
CONFIG_IDF_SLAVE_TARGET="esp32c6"
CONFIG_SLAVE_IDF_TARGET_ESP32C6=y

CONFIG_PARTITION_TABLE_OFFSET=0x9000
```

## components/esp_rtsp_service/examples/rtsp_service/sdkconfig.defaults.esp32s3
```kconfig
CONFIG_ESPTOOLPY_FLASHFREQ_80M=y
CONFIG_ESPTOOLPY_FLASHSIZE_4MB=y

CONFIG_SPIRAM_MODE_OCT=y
CONFIG_SPIRAM_SPEED_80M=y
CONFIG_ESP32S3_SPIRAM_SUPPORT=y

CONFIG_COMPILER_OPTIMIZATION_PERF=y

CONFIG_ESP_DEFAULT_CPU_FREQ_MHZ_240=y
CONFIG_ESP32S3_INSTRUCTION_CACHE_32KB=y
CONFIG_ESP32S3_DATA_CACHE_64KB=y
CONFIG_ESP32S3_DATA_CACHE_LINE_64B=y

CONFIG_FLASHMODE_QIO=y
CONFIG_ESPTOOLPY_FLASHMODE_QIO=y

CONFIG_SPIRAM_MALLOC_ALWAYSINTERNAL=128

CONFIG_ESP_ALLOW_BSS_SEG_EXTERNAL_MEMORY=y
CONFIG_SPIRAM_ALLOW_BSS_SEG_EXTERNAL_MEMORY=y
```

## components/esp_rtsp_service/examples/rtsp_service/sdkconfig.defaults.esp32s31
```kconfig
CONFIG_ESPTOOLPY_FLASHSIZE_4MB=y
CONFIG_COMPILER_OPTIMIZATION_PERF=y

CONFIG_SPIRAM_MALLOC_ALWAYSINTERNAL=128
CONFIG_SPIRAM_TRY_ALLOCATE_WIFI_LWIP=y
CONFIG_MBEDTLS_EXTERNAL_MEM_ALLOC=y
CONFIG_SPIRAM_MALLOC_RESERVE_INTERNAL=16384
CONFIG_ESP_ALLOW_BSS_SEG_EXTERNAL_MEMORY=y
CONFIG_SPIRAM_ALLOW_BSS_SEG_EXTERNAL_MEMORY=y
```

## components/esp_rtsp_service/test_apps/sdkconfig.defaults
```kconfig
# SPDX-FileCopyrightText: 2026 Espressif Systems (Shanghai) CO., LTD
# SPDX-License-Identifier: LicenseRef-Espressif-Modified-MIT
CONFIG_FREERTOS_HZ=1000
CONFIG_ESP_TASK_WDT_INIT=n
CONFIG_UNITY_ENABLE_BACKTRACE_ON_FAIL=y
CONFIG_ESP_MEDIA_DUMMY_SERVICE_SRC_SUPPORT=y
CONFIG_ESP_MEDIA_DUMMY_SERVICE_SINK_SUPPORT=y
CONFIG_ESP_RTSP_SERVICE_SRC_SUPPORT=y
CONFIG_ESP_RTSP_SERVICE_SINK_SUPPORT=y
CONFIG_ESP_RTSP_SERVICE_SERVER_SUPPORT=y

CONFIG_LWIP_MAX_UDP_PCBS=64
CONFIG_LWIP_UDP_RECVMBOX_SIZE=64
CONFIG_UDP_RECVMBOX_SIZE=64
```

## components/esp_sip_service/Kconfig
```kconfig
menu "ESP-SIP Service"

    config ESP_SIP_SERVICE_UPLINK_SUPPORT
        bool "Enable SIP uplink (media sink) support"
        default y
        help
            Build the uplink path that consumes frames from a linked media
            provider and sends them to the SIP peer. Disable when this firmware
            never sends media. Receive-only calls then take the codec from
            setup.audio_codec / video_codec, which is also what enables the
            stream at all.

    config ESP_SIP_SERVICE_DOWNLINK_SUPPORT
        bool "Enable SIP downlink (media source) support"
        default y
        help
            Build the downlink path that caches frames received from the SIP
            peer and exposes them as a media provider. Disable for send-only
            devices such as an unattended camera.

    config ESP_SIP_SERVICE_MCP_ENABLE
        bool "Enable SIP service MCP tools"
        depends on ESP_MCP_ENABLE
        default n
        help
            Build the SIP service MCP tool handler and embedded tool schema.
            This option depends on the global ESP Service MCP support.

endmenu
```

## components/esp_sip_service/test_apps/sdkconfig.defaults
```kconfig
# SPDX-FileCopyrightText: 2026 Espressif Systems (Shanghai) CO., LTD
# SPDX-License-Identifier: LicenseRef-Espressif-Modified-MIT
CONFIG_FREERTOS_HZ=1000
CONFIG_ESP_TASK_WDT_INIT=n
CONFIG_UNITY_ENABLE_BACKTRACE_ON_FAIL=y

# SIP pulls in libsrtp on top of Wi-Fi and unity, which overflows the 1 MB default
CONFIG_PARTITION_TABLE_SINGLE_APP_LARGE=y
CONFIG_ESP_MEDIA_DUMMY_SERVICE_SRC_SUPPORT=y
CONFIG_ESP_MEDIA_DUMMY_SERVICE_SINK_SUPPORT=y
CONFIG_ESP_SIP_SERVICE_UPLINK_SUPPORT=y
CONFIG_ESP_SIP_SERVICE_DOWNLINK_SUPPORT=y

CONFIG_LWIP_MAX_UDP_PCBS=64
CONFIG_LWIP_UDP_RECVMBOX_SIZE=64
CONFIG_UDP_RECVMBOX_SIZE=64
```

## components/esp_video_capture_service/Kconfig
```kconfig
menu "ESP Video Capture Service"

    config ESP_VIDEO_CAPTURE_SERVICE_MCP_ENABLE
        bool "Enable video capture service MCP tools"
        depends on ESP_MCP_ENABLE
        default n
        help
            Build the video capture service MCP tool handler and embedded tool schema.
            This option depends on the global ESP Service MCP support.

endmenu
```

## components/esp_video_capture_service/examples/video_capture/sdkconfig.defaults
```kconfig
#
# Bootloader config
#
CONFIG_BOOTLOADER_LOG_LEVEL_WARN=y

# Enable SPIRAM
CONFIG_SPIRAM=y

# Enable GDBStub
CONFIG_ESP_SYSTEM_PANIC_GDBSTUB=y

# Enable FreeRTOS trace
CONFIG_FREERTOS_USE_TRACE_FACILITY=y
CONFIG_FREERTOS_VTASKLIST_INCLUDE_COREID=y
CONFIG_FREERTOS_GENERATE_RUN_TIME_STATS=y
CONFIG_FREERTOS_HZ=1000

# Enable experimental features
CONFIG_IDF_EXPERIMENTAL_FEATURES=y

# Use customer partition table
CONFIG_PARTITION_TABLE_CUSTOM=y
CONFIG_PARTITION_TABLE_OFFSET=0xA000

#
# ESP WDT CONFIG
#
# CONFIG_TASK_WDT_PANIC is not set
CONFIG_ESP_TASK_WDT_EN=n
CONFIG_ESP_INT_WDT=n

#
# Compiler options
#
CONFIG_COMPILER_OPTIMIZATION_PERF=y
CONFIG_ESP_MAIN_TASK_STACK_SIZE=10240

#
# FatFS
#
CONFIG_FATFS_LFN_HEAP=y

#
# Capture / AI / overlay
#
CONFIG_ESP_CAPTURE_ENABLE_AUDIO=y
CONFIG_ESP_CAPTURE_ENABLE_VIDEO=y
CONFIG_ESP_CAPTURE_ENABLE_VIDEO_OVERLAY=y
CONFIG_ESP_PAINTER_BASIC_FONT_24=y
CONFIG_ESP_CAPTURE_ENABLE_VIDEO_DECODER=y
CONFIG_ESP_AUDIO_CAPTURE_SERVICE_AI_SRC_ENABLED=y
CONFIG_ESP_AUDIO_CAPTURE_SERVICE_AI_SRC_AFE_SUPPORT=y
CONFIG_ESP_AUDIO_CAPTURE_SERVICE_AI_SRC_AEC_SUPPORT=y
CONFIG_ESP_AUDIO_CAPTURE_SERVICE_AI_SRC_VAD_SUPPORT=y

#
# Trim unused audio codecs
#
CONFIG_AUDIO_DECODER_AAC_SUPPORT=n
CONFIG_AUDIO_DECODER_G711_SUPPORT=n
CONFIG_AUDIO_DECODER_PCM_SUPPORT=n
CONFIG_AUDIO_DECODER_MP3_SUPPORT=n
CONFIG_AUDIO_DECODER_AMRNB_SUPPORT=n
CONFIG_AUDIO_DECODER_AMRWB_SUPPORT=n
CONFIG_AUDIO_DECODER_FLAC_SUPPORT=n
CONFIG_AUDIO_DECODER_OPUS_SUPPORT=n
CONFIG_AUDIO_DECODER_VORBIS_SUPPORT=n
CONFIG_AUDIO_DECODER_ADPCM_SUPPORT=n
CONFIG_AUDIO_DECODER_ALAC_SUPPORT=n
CONFIG_AUDIO_DECODER_SBC_SUPPORT=n
CONFIG_AUDIO_DECODER_LC3_SUPPORT=n
CONFIG_AUDIO_DECODER_G722_SUPPORT=n
CONFIG_AUDIO_ENCODER_AAC_SUPPORT=y
CONFIG_AUDIO_ENCODER_G711_SUPPORT=y
CONFIG_AUDIO_ENCODER_PCM_SUPPORT=y
CONFIG_AUDIO_ENCODER_AMRNB_SUPPORT=n
CONFIG_AUDIO_ENCODER_AMRWB_SUPPORT=n
CONFIG_AUDIO_ENCODER_OPUS_SUPPORT=n
CONFIG_AUDIO_ENCODER_ADPCM_SUPPORT=n
CONFIG_AUDIO_ENCODER_ALAC_SUPPORT=n
CONFIG_AUDIO_ENCODER_SBC_SUPPORT=n
CONFIG_AUDIO_ENCODER_LC3_SUPPORT=n
CONFIG_AUDIO_ENCODER_G722_SUPPORT=n

#
# Muxer / extractor trim
#
CONFIG_ESP_MUXER_MP4_SUPPORT=y
CONFIG_ESP_MUXER_WAV_SUPPORT=n
CONFIG_ESP_MUXER_TS_SUPPORT=n
CONFIG_ESP_MUXER_OGG_SUPPORT=n
CONFIG_ESP_MUXER_FLV_SUPPORT=n
CONFIG_ESP_MUXER_CAF_SUPPORT=n
CONFIG_ESP_MUXER_AVI_SUPPORT=n
CONFIG_AUDIO_ES_EXTRACTOR_SUPPORT=n
CONFIG_MP4_EXTRACTOR_SUPPORT=n
CONFIG_WAV_EXTRACTOR_SUPPORT=n
CONFIG_TS_EXTRACTOR_SUPPORT=n
CONFIG_OGG_EXTRACTOR_SUPPORT=n
CONFIG_AVI_EXTRACTOR_SUPPORT=n
CONFIG_CAF_EXTRACTOR_SUPPORT=n
CONFIG_FLV_EXTRACTOR_SUPPORT=n

#
# UVC for fullspeed decode/re-encode demo
#
CONFIG_ESP_VIDEO_ENABLE_USB_UVC_VIDEO_DEVICE=y

#
# Heap tracing for run_all with_trace
#
CONFIG_HEAP_TRACING_STANDALONE=y
CONFIG_HEAP_TRACING=y
CONFIG_HEAP_TRACING_STACK_DEPTH=7
CONFIG_ESP_MEDIA_DUMMY_SERVICE_SRC_SUPPORT=y
CONFIG_ESP_MEDIA_DUMMY_SERVICE_SINK_SUPPORT=y

# MCP UART verification (reuse component MCP Kconfig; no extra example enable switch)
CONFIG_ESP_MCP_ENABLE=y
CONFIG_ESP_MCP_TRANSPORT_UART=y
#CONFIG_ESP_VIDEO_CAPTURE_SERVICE_MCP_ENABLE=y
CONFIG_ESP_MEDIA_SERVICE_MCP_ENABLE=y
```

## components/esp_video_capture_service/examples/video_capture/sdkconfig.defaults.esp32s3
```kconfig
CONFIG_ESPTOOLPY_FLASHFREQ_120M=y
CONFIG_ESPTOOLPY_FLASHSIZE_4MB=y
# Required for IDF 6.x when running QSPI Flash > 80MHz on ESP32-S3
CONFIG_SPI_FLASH_HPM_ENA=y
CONFIG_BOOTLOADER_FLASH_DC_AWARE=y

CONFIG_SPIRAM_MODE_OCT=y
CONFIG_SPIRAM_SPEED_120M=y
CONFIG_ESP32S3_SPIRAM_SUPPORT=y

# Wifi static buffer refine
CONFIG_ESP_WIFI_STATIC_RX_BUFFER_NUM=8
CONFIG_ESP_WIFI_STATIC_TX_BUFFER_NUM=8
CONFIG_ESP_WIFI_DYNAMIC_RX_MGMT_BUFFER=y
CONFIG_ESP_WIFI_IRAM_OPT=n
CONFIG_ESP_WIFI_RX_IRAM_OPT=n

CONFIG_COMPILER_OPTIMIZATION_PERF=y

CONFIG_ESP_DEFAULT_CPU_FREQ_MHZ_240=y
CONFIG_ESP32S3_INSTRUCTION_CACHE_32KB=y
CONFIG_ESP32S3_DATA_CACHE_64KB=y
CONFIG_ESP32S3_DATA_CACHE_LINE_64B=y

CONFIG_FLASHMODE_QIO=y
CONFIG_ESPTOOLPY_FLASHMODE_QIO=y

CONFIG_SPIRAM_MALLOC_ALWAYSINTERNAL=128

CONFIG_ESP_ALLOW_BSS_SEG_EXTERNAL_MEMORY=y
CONFIG_SPIRAM_ALLOW_BSS_SEG_EXTERNAL_MEMORY=y
CONFIG_CAMERA_TASK_STACK_SIZE=4096

CONFIG_AUDIO_DECODER_AAC_SUPPORT=n
CONFIG_AUDIO_DECODER_MP3_SUPPORT=n
CONFIG_AUDIO_DECODER_AMRNB_SUPPORT=n
CONFIG_AUDIO_DECODER_AMRWB_SUPPORT=n
CONFIG_AUDIO_DECODER_FLAC_SUPPORT=n
CONFIG_AUDIO_DECODER_VORBIS_SUPPORT=n
CONFIG_AUDIO_DECODER_ADPCM_SUPPORT=n
CONFIG_AUDIO_DECODER_ALAC_SUPPORT=n
CONFIG_AUDIO_DECODER_PCM_SUPPORT=n

CONFIG_AUDIO_SIMPLE_DEC_WAV_SUPPORT=n
CONFIG_AUDIO_SIMPLE_DEC_M4A_SUPPORT=n
CONFIG_AUDIO_SIMPLE_DEC_TS_SUPPORT=n

CONFIG_AUDIO_ENCODER_AMRNB_SUPPORT=n
CONFIG_AUDIO_ENCODER_AMRWB_SUPPORT=n
CONFIG_AUDIO_ENCODER_ADPCM_SUPPORT=n
CONFIG_AUDIO_ENCODER_ALAC_SUPPORT=n
CONFIG_AUDIO_ENCODER_PCM_SUPPORT=n

CONFIG_VIDEO_DECODER_SW_H264_SUPPORT=n
CONFIG_VIDEO_DECODER_SW_MJPEG_SUPPORT=n

## Camera support
CONFIG_CAMERA_OV3660=y
CONFIG_CAMERA_OV3660_DVP_RGB565_BE_640X480_10FPS=y
CONFIG_CAMERA_OV3660_DVP_DEFAULT_FMT_RGB565_BE_640X480_10FPS=y
```

## components/esp_video_capture_service/examples/video_capture/sdkconfig.defaults.esp32s31
```kconfig
CONFIG_ESPTOOLPY_FLASHSIZE_4MB=y
CONFIG_COMPILER_OPTIMIZATION_PERF=y

CONFIG_SPIRAM_MALLOC_ALWAYSINTERNAL=128
CONFIG_SPIRAM_TRY_ALLOCATE_WIFI_LWIP=y
CONFIG_MBEDTLS_EXTERNAL_MEM_ALLOC=y
CONFIG_SPIRAM_MALLOC_RESERVE_INTERNAL=16384
CONFIG_ESP_ALLOW_BSS_SEG_EXTERNAL_MEMORY=y
CONFIG_SPIRAM_ALLOW_BSS_SEG_EXTERNAL_MEMORY=y

CONFIG_VIDEO_DECODER_SW_H264_SUPPORT=n
CONFIG_VIDEO_DECODER_SW_MJPEG_SUPPORT=n

## Camera support
CONFIG_CAMERA_OV3660=y
CONFIG_CAMERA_OV3660_DVP_RGB565_BE_640X480_10FPS=y
CONFIG_CAMERA_OV3660_DVP_DEFAULT_FMT_RGB565_BE_640X480_10FPS=y
```

## components/esp_video_capture_service/test_apps/sdkconfig.defaults
```kconfig
CONFIG_ESP_CAPTURE_ENABLE_AUDIO=y
CONFIG_ESP_CAPTURE_ENABLE_VIDEO=y
CONFIG_ESP_CAPTURE_ENABLE_VIDEO_OVERLAY=y
CONFIG_ESP_MAIN_TASK_STACK_SIZE=10240
CONFIG_ESP_VIDEO_CAPTURE_SERVICE_ENABLE_V4L2_SRC=y

CONFIG_FREERTOS_HZ=1000

CONFIG_SPIRAM=y
CONFIG_ESPTOOLPY_FLASHSIZE_8MB=y
CONFIG_PARTITION_TABLE_OFFSET=0x9000
CONFIG_PARTITION_TABLE_CUSTOM=y
CONFIG_PARTITION_TABLE_CUSTOM_FILENAME="partitions.csv"
```

## components/esp_video_player_service/Kconfig
```kconfig
menu "ESP Video Player Service"

    config VIDEO_PLAYER_SERVICE_MCP_ENABLE
        bool "Enable video player MCP tools"
        depends on ESP_MCP_ENABLE
        default n
        help
            Compile the video player MCP handler and a complete flash-resident
            schema (playback tools plus video_info / tracks). Tool names use the
            esp_video_player_service_ prefix.

endmenu
```
