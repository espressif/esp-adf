## components/esp_ota_service/Kconfig
```kconfig
menu "OTA Service"

    menu "Verification and rollback"
        config OTA_FORCE_VERSION_CHECK
            bool "Require higher firmware version by default"
            default n
            help
                When enabled, esp_ota_service_checker_app_create(NULL) defaults to rejecting
                firmware images whose version is the same as or older than the
                currently running firmware. This can also be set per-checker at
                runtime via esp_ota_service_checker_app_cfg_t::version_policy.

        config OTA_ENABLE_ROLLBACK
            bool "Enable OTA rollback support"
            default n
            help
                After OTA upgrade, the new image starts in PENDING_VERIFY state.
                The application must call esp_ota_service_confirm_update() to confirm.
                If not confirmed before the next reboot, the bootloader rolls back
                to the previous firmware.
    endmenu

    menu "Download sources"
        config OTA_HTTP_TIMEOUT_MS
            int "HTTP/HTTPS source read timeout (ms)"
            default 10000
            range 1000 60000
            help
                Default read timeout for the HTTP/HTTPS OTA source.
                Can be overridden per-source via esp_ota_service_source_http_cfg_t.

        config OTA_ENABLE_BLE_SOURCE
            bool "Enable BLE OTA source (official ESP BLE OTA APP protocol)"
            default n
            help
                Compile esp_ota_service_source_ble so firmware can be received over BLE
                using the official ESP BLE OTA APP protocol (svc 0x8018,
                RECV_FW 0x8020, COMMAND 0x8022, sector-based with ACK).
                The GATT server is implemented natively on top of NimBLE, so
                no managed component is required.

        if OTA_ENABLE_BLE_SOURCE
            config OTA_BLE_RING_BUF_SIZE
                int "BLE OTA ring buffer size (bytes)"
                default 8192
                range 2048 32768
                help
                    Size of the ring buffer that holds APP-sent firmware bytes
                    before the OTA worker reads them. Larger values absorb
                    bursts when the radio delivers a sector fast.

            config OTA_BLE_WAIT_START_MS
                int "BLE OTA wait-for-start timeout (ms)"
                default 30000
                range 5000 120000
                help
                    Max time open() waits for the APP to send the Start OTA
                    command (which carries the firmware length) before
                    returning ESP_ERR_TIMEOUT.
        endif
    endmenu

    menu "Resume (NVS checkpoint)"
        config OTA_ENABLE_RESUME
            bool "Enable OTA resume (breakpoint continuation)"
            default y
            help
                Store OTA progress in NVS. On failure or reboot, the next OTA
                attempt resumes from the last saved offset instead of starting over.

        if OTA_ENABLE_RESUME
            config OTA_RESUME_SAVE_INTERVAL_KB
                int "Resume progress save interval (KB)"
                default 64
                range 16 256
                help
                    How often (in KB of data written) to save progress to NVS.
                    Smaller values provide finer resume granularity but increase
                    NVS wear.
        endif
    endmenu

    menu "Advanced targets"
        config OTA_ENABLE_BOOTLOADER_OTA
            bool "Enable bootloader OTA target"
            default n
            help
                Compile esp_ota_service_target_bootloader which allows updating the bootloader
                itself via OTA. The new bootloader image is first written to a
                staging partition, validated, then copied to the bootloader area.
                WARNING: Bootloader OTA is inherently risky. A power failure during
                the final copy step can brick the device.
    endmenu

endmenu
```

## components/esp_ota_service/examples/ota_ble/sdkconfig.defaults
```kconfig
# BLE OTA with esp_ota_service + official ESP BLE OTA APP protocol (ESP32-S3)

CONFIG_IDF_TARGET="esp32s3"

# Partition table (4 MB, compatible with the APP defaults)
CONFIG_PARTITION_TABLE_CUSTOM=y
CONFIG_PARTITION_TABLE_CUSTOM_FILENAME="partitions.csv"
CONFIG_ESPTOOLPY_FLASHSIZE_4MB=y

# FreeRTOS
CONFIG_FREERTOS_HZ=1000
CONFIG_FREERTOS_ENABLE_BACKWARD_COMPATIBILITY=y

# Bluetooth: NimBLE with large preferred MTU so the APP can use sector-sized writes
CONFIG_BT_ENABLED=y
CONFIG_BT_NIMBLE_ENABLED=y
CONFIG_BT_NIMBLE_ATT_PREFERRED_MTU=517
# Needed for legacy advertising used by the APP
CONFIG_BT_BLE_42_FEATURES_SUPPORTED=y

# OTA service: use the BLE source (official APP protocol).
CONFIG_OTA_ENABLE_BLE_SOURCE=y
CONFIG_OTA_FORCE_VERSION_CHECK=y
CONFIG_OTA_ENABLE_ROLLBACK=y
CONFIG_BOOTLOADER_APP_ROLLBACK_ENABLE=y

# Disable esp_service MCP layer (not needed for this example)
CONFIG_ESP_MCP_ENABLE=n
```

## components/esp_ota_service/examples/ota_fs/main/Kconfig.projbuild
```kconfig
menu "OTA FS Example"

    choice OTA_FS_EXAMPLE_STORAGE
        prompt "Storage backend for OTA bin files"
        default OTA_FS_EXAMPLE_STORAGE_SDCARD
        help
            Selects where the example reads firmware.bin / userdata.bin /
            flash_tone.bin from:

            - SDCARD:  board-manager mounted SD card (default, /sdcard).
            - USB_MSC: USB Host Mass Storage Class flash drive (/usb).

            The OTA pipeline itself is identical; only the VFS mount point
            and the mount/unmount code path differ.

        config OTA_FS_EXAMPLE_STORAGE_SDCARD
            bool "SD card (via esp_board_manager FS_SDCARD)"

        config OTA_FS_EXAMPLE_STORAGE_USB_MSC
            bool "USB flash drive (USB Host MSC)"
            depends on IDF_TARGET_ESP32S2 || IDF_TARGET_ESP32S3 || IDF_TARGET_ESP32P4
            help
                Requires a SoC with USB-OTG / USB-HS host capability
                (ESP32-S2, ESP32-S3, or ESP32-P4).
    endchoice

    if OTA_FS_EXAMPLE_STORAGE_USB_MSC

        config OTA_FS_EXAMPLE_USB_MOUNT_POINT
            string "USB flash drive VFS mount point"
            default "/usb"
            help
                VFS path where the first MSC device is mounted.
                firmware.bin / userdata.bin / flash_tone.bin are looked up
                under this path (e.g. /usb/firmware.bin).

        config OTA_FS_EXAMPLE_USB_CONNECT_TIMEOUT_MS
            int "USB flash drive connect timeout (ms)"
            default 15000
            range 1000 120000
            help
                How long to wait for a USB flash drive to appear after the
                host stack starts. If no device is inserted within this
                window, the example skips OTA and continues to idle.

    endif

endmenu
```

## components/esp_ota_service/examples/ota_fs/sdkconfig.defaults.esp32p4
```kconfig
CONFIG_IDF_TARGET="esp32p4"
CONFIG_IDF_TARGET_ESP32P4=y

# CPU / PSRAM — typical ESP32-P4 profile
CONFIG_ESP_DEFAULT_CPU_FREQ_MHZ_360=y
CONFIG_SPIRAM=y
CONFIG_SPIRAM_MODE_HEX=y
CONFIG_FREERTOS_TASK_CREATE_ALLOW_EXT_MEM=y
CONFIG_SPIRAM_SPEED_200M=y
CONFIG_SPIRAM_MALLOC_ALWAYSINTERNAL=1024

# P4 has no SD-card wiring in this example: default the storage backend to USB
# (mass storage class). Users can override via menuconfig.
CONFIG_OTA_FS_EXAMPLE_STORAGE_USB_MSC=y

# USB Host — HS host + hubs support
CONFIG_USB_HOST_HUBS_SUPPORTED=y
```

## components/esp_ota_service/examples/ota_fs/sdkconfig.defaults.esp32s3
```kconfig
CONFIG_IDF_TARGET="esp32s3"
CONFIG_IDF_TARGET_ESP32S3=y

# CPU / PSRAM (ESP32-S3-Korvo-2 V3)
CONFIG_ESP_DEFAULT_CPU_FREQ_MHZ_240=y
CONFIG_ESP32S3_DATA_CACHE_LINE_64B=y
CONFIG_SPIRAM=y
CONFIG_SPIRAM_MODE_OCT=y
CONFIG_FREERTOS_TASK_CREATE_ALLOW_EXT_MEM=y
CONFIG_SPIRAM_SPEED_80M=y
CONFIG_SPIRAM_MALLOC_ALWAYSINTERNAL=1024

# Board profile (Korvo2 V3 peripherals, devices, FS mount /sdcard) is in:
#   components/gen_bmgr_codes/board_manager.defaults
# Regenerate with: idf.py gen-bmgr-config -b esp32_s3_korvo2_v3
```
