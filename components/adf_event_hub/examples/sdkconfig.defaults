## components/adf_event_hub/examples/sdkconfig.defaults
```kconfig
CONFIG_FREERTOS_HZ=1000
CONFIG_ESP_MAIN_TASK_STACK_SIZE=8192
CONFIG_LOG_DEFAULT_LEVEL_INFO=y
CONFIG_LOG_MAXIMUM_EQUALS_DEFAULT=y
CONFIG_COMPILER_OPTIMIZATION_DEFAULT=y
CONFIG_ESP_MCP_ENABLE=n
```

## components/adf_event_hub/test_apps/sdkconfig.defaults
```kconfig
# SPDX-FileCopyrightText: 2026 Espressif Systems (Shanghai) CO., LTD
# SPDX-License-Identifier: LicenseRef-Espressif-Modified-MIT

CONFIG_FREERTOS_HZ=1000
CONFIG_ESP_TASK_WDT_INIT=n
CONFIG_ESP_MAIN_TASK_STACK_SIZE=16384

CONFIG_UNITY_ENABLE_BACKTRACE_ON_FAIL=y

# Event-hub tests do not need MCP support
CONFIG_ESP_MCP_ENABLE=n

CONFIG_UNITY_ENABLE_64BIT=y
```

## components/audio_hal/Kconfig.projbuild
```kconfig
menu "Audio HAL"

choice AUDIO_BOARD
    prompt "Audio board"
    default ESP_LYRAT_V4_3_BOARD
    help
        Select an audio board to use with the ESP-ADF

config ESP_LYRAT_V4_3_BOARD
    bool "ESP32-Lyrat V4.3"
config ESP_LYRAT_V4_2_BOARD
    bool "ESP32-Lyrat V4.2"
config ESP_LYRATD_MSC_V2_1_BOARD
    bool "ESP32-LyraTD-MSC V2.1"
config ESP_LYRATD_MSC_V2_2_BOARD
    bool "ESP32-LyraTD-MSC V2.2"
endchoice

endmenu
```

## components/audio_recorder/Kconfig.projbuild
```kconfig
menu "Audio Recorder"
    config AFE_MIC_NUM
        int "Number of micphones used for AFE"
        range 1 2
        default 2 if IDF_TARGET_ESP32S3
        default 1 if IDF_TARGET_ESP32
        help
            Now only support 1 or 2 mic
endmenu
```

## components/audio_stream/KConfig.projbuild
```kconfig
menu "Audio HAL"

config I2S_MCLK_SUPPORT
  bool "Support for I2S MCLK output"
  default n
  help
    This enables support for an I2S MCLK output.

  menu "I2S MCLK config"
    config I2S_MCLK_GPIO
      depends on I2S_MCLK_SUPPORT
        int "MCLK GPIO number"
        range 0 34
        default 0
        help              
          Select the GPIO for used I2S MCLK Output.
  endmenu
endmenu
```

## components/dueros_service/Kconfig
```kconfig
menu "DuerOS Service"

    config DUEROS_GEN_PROFILE
        bool "Generate the nvs partition which include the profile of dueros"
        default n

    config DUEROS_FLASH_PROFILE
        depends on DUEROS_GEN_PROFILE
        bool "Flash the generated nvs partition"
        default n

    config DUEROS_DEVICE_NAME
        string "Duer device name"
        default "Duer Name"

endmenu
```

## components/esp_audio_capture_service/examples/audio_capture/sdkconfig.defaults.esp32s31
```kconfig
CONFIG_ESPTOOLPY_FLASHSIZE_4MB=y
CONFIG_COMPILER_OPTIMIZATION_PERF=y

CONFIG_SPIRAM_MALLOC_ALWAYSINTERNAL=128
CONFIG_SPIRAM_TRY_ALLOCATE_WIFI_LWIP=y
CONFIG_MBEDTLS_EXTERNAL_MEM_ALLOC=y
CONFIG_SPIRAM_MALLOC_RESERVE_INTERNAL=16384
CONFIG_ESP_ALLOW_BSS_SEG_EXTERNAL_MEMORY=y
CONFIG_SPIRAM_ALLOW_BSS_SEG_EXTERNAL_MEMORY=y

CONFIG_AUDIO_DECODER_AAC_SUPPORT=n
CONFIG_AUDIO_DECODER_MP3_SUPPORT=n
CONFIG_AUDIO_DECODER_AMRNB_SUPPORT=n
CONFIG_AUDIO_DECODER_AMRWB_SUPPORT=n
CONFIG_AUDIO_DECODER_FLAC_SUPPORT=n
CONFIG_AUDIO_DECODER_VORBIS_SUPPORT=n
CONFIG_AUDIO_DECODER_ADPCM_SUPPORT=n
CONFIG_AUDIO_DECODER_ALAC_SUPPORT=n
CONFIG_AUDIO_DECODER_PCM_SUPPORT=n

CONFIG_AUDIO_SIMPLE_DEC_WAV_SUPPORT=n
CONFIG_AUDIO_SIMPLE_DEC_M4A_SUPPORT=n
CONFIG_AUDIO_SIMPLE_DEC_TS_SUPPORT=n

CONFIG_AUDIO_ENCODER_AMRNB_SUPPORT=n
CONFIG_AUDIO_ENCODER_AMRWB_SUPPORT=n
CONFIG_AUDIO_ENCODER_ADPCM_SUPPORT=n
CONFIG_AUDIO_ENCODER_ALAC_SUPPORT=n
CONFIG_AUDIO_ENCODER_PCM_SUPPORT=n

CONFIG_VIDEO_DECODER_SW_H264_SUPPORT=n
CONFIG_VIDEO_DECODER_SW_MJPEG_SUPPORT=n

## Camera support
CONFIG_CAMERA_OV3660=y
CONFIG_CAMERA_OV3660_DVP_RGB565_BE_640X480_10FPS=y
CONFIG_CAMERA_OV3660_DVP_DEFAULT_FMT_RGB565_BE_640X480_10FPS=y
```

## components/esp_button_service/examples/button_svc_example/main/Kconfig.projbuild
```kconfig
menu "Button Service Example"

    config BTN_EXAMPLE_GPIO0_PIN
        int "GPIO pin number for gpio_button_0"
        default 0
        range 0 48
        help
            GPIO pin connected to the first key.
            On ESP32-S3-DevKitC this is GPIO 0 (BOOT button).
            The pin is configured as input with an internal pull-up;
            press pulls it low (active-low).

    config BTN_EXAMPLE_GPIO1_PIN
        int "GPIO pin number for gpio_button_1"
        default 2
        range 0 48
        help
            GPIO pin connected to the second key.
            Connect a momentary switch between this pin and GND.
            An internal pull-up is enabled; press pulls it low.

    config BTN_EXAMPLE_ADC_CHANNEL
        int "ADC1 channel for adc_button_group"
        default 4
        range 0 9
        help
            ADC1 channel used for the resistor-ladder ADC button group.
            On ESP32-S3, channel 4 maps to GPIO 5.
            Three voltage thresholds are hard-coded in gen_board_device_config.c:
              button[0] PLAY     ~380 mV
              button[1] VOL_UP   ~820 mV
              button[2] VOL_DOWN ~1110 mV
            Adjust the voltage_range[] array if your resistor values differ.

endmenu
```

## components/esp_button_service/examples/button_svc_example/sdkconfig.defaults
```kconfig
# Target
CONFIG_IDF_TARGET="esp32s3"

# This example only needs esp_service core + event hub (no MCP / HTTP transports).
CONFIG_ESP_MCP_ENABLE=n

# Default pin / channel assignments (can be overridden via menuconfig)
CONFIG_BTN_EXAMPLE_GPIO0_PIN=0
CONFIG_BTN_EXAMPLE_GPIO1_PIN=2
CONFIG_BTN_EXAMPLE_ADC_CHANNEL=4

# Increase main task stack — board manager init uses the app-main stack
CONFIG_ESP_MAIN_TASK_STACK_SIZE=8192

# Console output — 1 MBaud for fast logging during key testing
CONFIG_ESP_CONSOLE_UART_BAUDRATE=1000000
```

## components/esp_cli_service/examples/sdkconfig.defaults
```kconfig
CONFIG_ESP_CONSOLE_UART_DEFAULT=y
CONFIG_ESP_CONSOLE_UART_BAUDRATE=115200
CONFIG_ESP_CONSOLE_UART_NUM=0
CONFIG_ESP_MCP_ENABLE=n
```

## components/esp_codec_dev/Kconfig
```kconfig
menu "Audio Codec Device Configuration"
   config ESP_IDF_VERSION
       string
       option env="ESP_IDF_VERSION"

    config CODEC_I2C_BACKWARD_COMPATIBLE
        bool "Enable backward compatibility for the I2C driver (force use of the old i2c_driver above v5.3)"
        default y  
        depends on ESP_IDF_VERSION >= 5.3
        help
            Enable this option for backward compatibility with the old I2C driver

    config CODEC_ES8311_SUPPORT
        bool "Support ES8311 Codec Chip"
        default y
        help
            Enable this option to support codec ES8311.

    config CODEC_ES7210_SUPPORT
        bool "Support ES7210 Codec Chip"
        default y
        help
            Enable this option to support codec ES7210.
    
    config CODEC_ES7243_SUPPORT
        bool "Support ES7243 Codec Chip"
        default y
        help
            Enable this option to support codec ES7243.

    config CODEC_ES7243E_SUPPORT
        bool "Support ES7243E Codec Chip"
        default y
        help
            Enable this option to support codec ES7243E.
    
    config CODEC_ES8156_SUPPORT
        bool "Support ES8156 Codec Chip"
        default y
        help
            Enable this option to support codec ES8156.

    config CODEC_AW88298_SUPPORT
        bool "Support AW88298 Codec Chip"
        default y
        help
            Enable this option to support codec AW88298.

    config CODEC_ES8374_SUPPORT
        bool "Support ES8374 Codec Chip"
        default y
        help
            Enable this option to support codec ES8374.

     config CODEC_ES8388_SUPPORT
        bool "Support ES8388 Codec Chip"
        default y
        help
            Enable this option to support codec ES8388.

    config CODEC_TAS5805M_SUPPORT
        bool "Support TAS5805M Codec Chip"
        default y
        help
            Enable this option to support codec TAS5805M.

    config CODEC_ZL38063_SUPPORT
        bool "Support ZL38063 Codec Chip"
        default n
        help
            Enable this option to support codec ZL38063.
            ZL38063 firmware only support xtensa, don't enable for RISC-V IC.
 endmenu
```

## components/esp_codec_dev/test_apps/codec_dev_test/sdkconfig.defaults
```kconfig
# Enable SPIRAM
CONFIG_SPIRAM=y

# Enable FreeRTOS trace
CONFIG_FREERTOS_HZ=1000

# Use new I2C master
CONFIG_CODEC_I2C_BACKWARD_COMPATIBLE=n

#
# ESP WDT CONFIG
#
# CONFIG_TASK_WDT_PANIC is not set
CONFIG_ESP_TASK_WDT_EN=n
CONFIG_ESP_INT_WDT=n
```

## components/esp_config_manager/examples/config_manager_example/sdkconfig.defaults
```kconfig
# Use custom partition table (SPIFFS + cfg_pri/cfg_bak) for FS and FLASH storage demos.
CONFIG_PARTITION_TABLE_CUSTOM=y
CONFIG_PARTITION_TABLE_CUSTOM_FILENAME="partitions.csv"
```

## components/esp_coze/Kconfig
```kconfig
menu "ESP COZE Chat"

    config ESP_COZE_WS_TASK_PRIO
        int "WebSocket task priority"
        range 1 24
        default 12
        help
            FreeRTOS priority passed to esp_websocket_client_config_t.task_prio.

    config ESP_COZE_WS_TASK_STACK
        int "WebSocket task stack size (bytes)"
        range 0 65536
        default 0
        help
            Passed to esp_websocket_client_config_t.task_stack.
            Set to 0 to use the websocket client library default stack size.

    config ESP_COZE_WS_TASK_NAME
        string "WebSocket FreeRTOS task name (empty = library default)"
        default ""
        help
            If non-empty, overrides the websocket worker task name.

    config ESP_COZE_WS_TASK_CORE_ID_SET
        bool "Pin WebSocket task to a specific CPU core"
        default n
        help
            Sets esp_websocket_client_config_t.task_core_id_set.
            When disabled, the worker uses default affinity (tskNO_AFFINITY).

    config ESP_COZE_WS_TASK_CORE_ID
        int "CPU core ID for WebSocket task"
        depends on ESP_COZE_WS_TASK_CORE_ID_SET
        range 0 1
        default 0
        help
            esp_websocket_client_config_t.task_core_id when pinning is enabled.
            On dual-core SoCs use 0 or 1; on single-core chips use 0.

    config ESP_COZE_WS_BUFFER_SIZE
        int "WebSocket RX/TX buffer size (bytes)"
        range 1024 131072
        default 20480
        help
            Passed to esp_websocket_client_config_t.buffer_size at init (not configurable via esp_coze_chat_config_t).

    config ESP_COZE_WS_RECONNECT_TIMEOUT_MS
        int "WebSocket reconnect timeout (ms)"
        range 100 300000
        default 1000
        help
            reconnect_timeout_ms for esp_websocket_client_config_t.

    config ESP_COZE_WS_NETWORK_TIMEOUT_MS
        int "WebSocket network I/O timeout (ms)"
        range 100 300000
        default 5000
        help
            network_timeout_ms for esp_websocket_client_config_t.

    config ESP_COZE_WS_CONNECT_TIMEOUT_MS
        int "Wait for WebSocket connected after start (ms)"
        range 1000 300000
        default 30000
        help
            Overrides esp_coze_chat_config_t.websocket_connect_timeout at init.

    config ESP_COZE_WS_AUDIO_SEND_TIMEOUT_MS
        int "WebSocket send timeout for uplink audio (input_audio_buffer.append, ms)"
        range 1000 120000
        default 20000
        help
            Passed to esp_websocket_client_send_text() when sending input_audio_buffer.append
            frames. Increase on slow links; default matches the former fixed 20 s cap.

    config ESP_COZE_DEBUG_TRACE_DATA
        bool "Trace WebSocket uplink/downlink text (audio: length only)"
        default n
        help
            Log every outbound JSON/text frame and inbound complete text frames.
            For input_audio_buffer.append and conversation.audio.delta, logs PCM/decoded
            length only to avoid huge base64 dumps.

endmenu
```

## components/esp_coze/test_apps/sdkconfig.defaults
```kconfig
#
# Serial flasher config
#
CONFIG_ESPTOOLPY_FLASHMODE_QIO=y
CONFIG_ESPTOOLPY_FLASH_SAMPLE_MODE_STR=y
CONFIG_ESPTOOLPY_FLASHFREQ_80M=y
CONFIG_ESPTOOLPY_FLASHFREQ="80m"
CONFIG_ESPTOOLPY_HEADER_FLASHSIZE_UPDATE=y
CONFIG_ESPTOOLPY_FLASHSIZE_8MB=y
# end of Serial flasher config

#
# Compiler options
#
CONFIG_COMPILER_OPTIMIZATION_PERF=y
# end of Compiler options

#
# ESP WDT CONFIG
#
# CONFIG_TASK_WDT_PANIC is not set
CONFIG_TASK_WDT_TIMEOUT_S=10
# end of ESP WDT CONFIG

#
# ESP System Settings
#
CONFIG_ESP_MAIN_TASK_STACK_SIZE=4096
# end of ESP System Settings

#
# ESP-TLS
#
CONFIG_ESP_TLS_INSECURE=y
CONFIG_ESP_TLS_SKIP_SERVER_CERT_VERIFY=y
# end of ESP-TLS

#
# FREERTOS
#
CONFIG_FREERTOS_ENABLE_BACKWARD_COMPATIBILITY=y
CONFIG_FREERTOS_TIMER_TASK_STACK_DEPTH=4096
CONFIG_FREERTOS_GENERATE_RUN_TIME_STATS=y
CONFIG_FREERTOS_VTASKLIST_INCLUDE_COREID=y
CONFIG_FREERTOS_HZ=1000
```

## components/esp_http_client/Kconfig
```kconfig
menu "ESP HTTP client"


config ENABLE_HTTPS
    bool "Enable https"
    default y
    help
        Enable https.

endmenu
```

## components/esp_live_photo/examples/live_photo_capture/sdkconfig.defaults
```kconfig
# Enable SPIRAM
CONFIG_SPIRAM=y

# Enable GDBStub
CONFIG_ESP_SYSTEM_PANIC_GDBSTUB=y

# Enable FreeRTOS trace
CONFIG_FREERTOS_USE_TRACE_FACILITY=y
CONFIG_FREERTOS_VTASKLIST_INCLUDE_COREID=y
CONFIG_FREERTOS_GENERATE_RUN_TIME_STATS=y
CONFIG_FREERTOS_HZ=1000

# Enable experimental features
CONFIG_IDF_EXPERIMENTAL_FEATURES=y

# Use customer partition table
CONFIG_PARTITION_TABLE_CUSTOM=y

#
# ESP WDT CONFIG
#
# CONFIG_TASK_WDT_PANIC is not set
CONFIG_ESP_TASK_WDT_EN=n
CONFIG_ESP_INT_WDT=n

#
# Compiler options
#
CONFIG_COMPILER_OPTIMIZATION_PERF=y

#
# FatFS
#
CONFIG_FATFS_LFN_STACK=y

#
# Main Task
#
CONFIG_ESP_MAIN_TASK_STACK_SIZE=8192
```

## components/esp_live_photo/examples/live_photo_capture/sdkconfig.defaults.esp32s3
```kconfig
CONFIG_ESP32S3_INSTRUCTION_CACHE_32KB=y
CONFIG_ESP32S3_INSTRUCTION_CACHE_SIZE=0x8000
CONFIG_ESP32S3_INSTRUCTION_CACHE_LINE_32B=y
CONFIG_ESP32S3_INSTRUCTION_CACHE_LINE_SIZE=32
CONFIG_ESP32S3_DATA_CACHE_64KB=y
CONFIG_ESP32S3_DATA_CACHE_SIZE=0x10000
CONFIG_ESP32S3_DATA_CACHE_LINE_64B=y
CONFIG_ESP32S3_DATA_CACHE_LINE_SIZE=64
CONFIG_ESP_DEFAULT_CPU_FREQ_MHZ_240=y
CONFIG_SPIRAM=y
CONFIG_SPIRAM_SPEED_80M=y
CONFIG_SPIRAM_MODE_OCT=y

CONFIG_ESPTOOLPY_FLASHMODE_QIO=y
CONFIG_ESPTOOLPY_FLASHFREQ_80M=y
CONFIG_ESPTOOLPY_FLASHSIZE_4MB=y

CONFIG_FATFS_API_ENCODING_UTF_8=y

#
# Partition Table
#
CONFIG_PARTITION_TABLE_OFFSET=0x8000
CONFIG_PARTITION_TABLE_MD5=y
# end of Partition Table

CONFIG_FREERTOS_ENABLE_BACKWARD_COMPATIBILITY=y

## Camera support
CONFIG_CAMERA_OV3660=y
CONFIG_CAMERA_OV3660_DVP_RGB565_640X480_10FPS=y
```

## components/esp_media_service/test_apps/sdkconfig.defaults
```kconfig
# SPDX-FileCopyrightText: 2026 Espressif Systems (Shanghai) CO., LTD
# SPDX-License-Identifier: LicenseRef-Espressif-Modified-MIT
CONFIG_FREERTOS_HZ=1000
CONFIG_ESP_TASK_WDT_INIT=n
CONFIG_UNITY_ENABLE_BACKTRACE_ON_FAIL=y
CONFIG_UNITY_ENABLE_64BIT=y
CONFIG_PARTITION_TABLE_OFFSET=0x9000
```

## components/esp_media_service/test_apps/sdkconfig.defaults.esp32p4
```kconfig
# Flash setting
CONFIG_FLASHMODE_QIO=y
CONFIG_ESPTOOLPY_FLASHSIZE_4MB=y

CONFIG_SPIRAM_SPEED_200M=y

# If you use serial JTAG turn on this option
CONFIG_ESP_CONSOLE_USB_SERIAL_JTAG=y

# Use camera SC2336
CONFIG_CAMERA_SC2336=y
CONFIG_CAMERA_SC2336_MIPI_RAW8_1280x720_30FPS=y

# Enable ISP pipelines
CONFIG_ESP_VIDEO_ENABLE_ISP_PIPELINE_CONTROLLER=y

# Set Slave target type
CONFIG_IDF_SLAVE_TARGET="esp32c6"
CONFIG_SLAVE_IDF_TARGET_ESP32C6=y
```
