## components/esp_service/test_apps/main/Kconfig.projbuild
```kconfig
menu "ESP Service test_apps Configuration"

    config ESP_SVC_TEST_WIFI_SSID
        string "WiFi SSID (test_apps STA)"
        default "myssid"
        help
            SSID for on-device transport tests that need WiFi (HTTP / SSE / WS smoke).

    config ESP_SVC_TEST_WIFI_PASSWORD
        string "WiFi password (test_apps STA)"
        default "mypassword"
        help
            WPA/WPA2 password for the STA interface used by transport smoke tests.

    if ESP_MCP_ENABLE

    config ESP_SVC_TEST_ENABLE_LIFECYCLE_STRESS
        bool "Enable transport start/stop lifecycle stress test"
        default y
        help
            Run repeated create / start / stop / destroy cycles on UART
            (UART_NUM_1, default pins) when CONFIG_ESP_MCP_TRANSPORT_UART is
            enabled. STDIO is not exercised on-device (console VFS is
            non-blocking; see ut_transport_lifecycle_test.c). SSE lifecycle
            stress (if compiled) runs inside ut_sse_transport.c once WiFi is up.

    config ESP_SVC_TEST_LIFECYCLE_STRESS_CYCLES
        int "Lifecycle stress cycle count per transport"
        default 100
        range 1 1000
        depends on ESP_SVC_TEST_ENABLE_LIFECYCLE_STRESS
        help
            Number of create/start/stop/destroy cycles to run per transport.

    config ESP_SVC_TEST_ENABLE_HTTP_TRANSPORT
        bool "Enable HTTP MCP transport smoke test"
        default n
        depends on ESP_MCP_TRANSPORT_HTTP
        help
            Run the plain HTTP POST transport smoke (Unity).
            Requires WiFi and CONFIG_ESP_MCP_TRANSPORT_HTTP=y.

    config ESP_SVC_TEST_ENABLE_SSE_TRANSPORT
        bool "Enable HTTP+SSE MCP transport smoke test"
        default n
        depends on ESP_MCP_TRANSPORT_SSE
        help
            Run the HTTP+SSE transport smoke (MCP-recommended).
            Requires WiFi and CONFIG_ESP_MCP_TRANSPORT_SSE=y.
            SSE endpoint:      GET  /mcp/sse
            Messages endpoint: POST /mcp/messages?sessionId=<id>

    config ESP_SVC_TEST_SSE_HOLD_AFTER_SMOKE
        bool "After SSE Unity smoke, keep MCP HTTP+SSE server running"
        default n
        depends on ESP_SVC_TEST_ENABLE_SSE_TRANSPORT
        help
            When enabled, the device does not tear down the SSE MCP server after the
            in-firmware smoke test. Use this so a PC can run scripts/test_mcp_sse.py against
            the board IP (default http://<ip>:8080/mcp/sse).

    config ESP_SVC_TEST_ENABLE_WS_TRANSPORT
        bool "Enable WebSocket MCP transport smoke test"
        default n
        depends on ESP_MCP_TRANSPORT_WS
        help
            Run the WebSocket transport smoke (Unity).
            Requires WiFi and CONFIG_ESP_MCP_TRANSPORT_WS=y
            (which in turn requires CONFIG_HTTPD_WS_SUPPORT=y).

    config ESP_SVC_TEST_WS_HOLD_AFTER_SMOKE
        bool "After WS Unity smoke, keep MCP WebSocket server running"
        default n
        depends on ESP_SVC_TEST_ENABLE_WS_TRANSPORT
        help
            When enabled, the device does not tear down the WS MCP server after the
            in-firmware smoke test. Use this so a PC can run scripts/test_mcp_ws.py against
            the board IP (default ws://<ip>:8081/mcp).

    config ESP_SVC_TEST_ENABLE_UART_TRANSPORT
        bool "Enable UART MCP transport smoke test"
        default n
        depends on ESP_MCP_TRANSPORT_UART
        help
            Run the UART transport smoke (Unity).
            Requires CONFIG_ESP_MCP_TRANSPORT_UART=y.

    config ESP_SVC_TEST_UART_HOLD_AFTER_SMOKE
        bool "After UART Unity smoke, keep MCP UART transport running"
        default n
        depends on ESP_SVC_TEST_ENABLE_UART_TRANSPORT
        help
            When enabled, the device does not tear down the UART MCP server after the
            in-firmware smoke test. Use this so a PC can run scripts/test_mcp_uart.py against
            the same serial port as the board USB-UART (ESP32-S3 UART0, default GPIO43/44,
            115200 baud).

    config ESP_SVC_TEST_UART_TX_PIN
        int "UART TX GPIO pin"
        default 43
        depends on ESP_SVC_TEST_ENABLE_UART_TRANSPORT
        help
            GPIO for UART MCP TX (ESP32-S3 UART0 default U0TXD is GPIO43).

    config ESP_SVC_TEST_UART_RX_PIN
        int "UART RX GPIO pin"
        default 44
        depends on ESP_SVC_TEST_ENABLE_UART_TRANSPORT
        help
            GPIO for UART MCP RX (ESP32-S3 UART0 default U0RXD is GPIO44).

    config ESP_SVC_TEST_UART_BAUD_RATE
        int "UART baud rate"
        default 115200
        depends on ESP_SVC_TEST_ENABLE_UART_TRANSPORT
        help
            Baud rate for UART MCP transport.

    endif  # ESP_MCP_ENABLE

endmenu
```

## components/esp_service/test_apps/sdkconfig.defaults
```kconfig
# Defaults for the esp_service on-device test_apps runner.
CONFIG_ESP_MAIN_TASK_STACK_SIZE=4096
CONFIG_FREERTOS_HZ=1000

# Exercise every transport we can reach over MCP.
CONFIG_ESP_MCP_ENABLE=y
CONFIG_ESP_MCP_TRANSPORT_HTTP=y
CONFIG_ESP_MCP_TRANSPORT_SSE=y
CONFIG_ESP_MCP_TRANSPORT_WS=y
CONFIG_ESP_MCP_TRANSPORT_UART=y

# Default on = SSE only (the MCP-recommended transport).  Enable others via
# menuconfig; the test_apps firmware will start whatever you enable.
CONFIG_ESP_SVC_TEST_ENABLE_LIFECYCLE_STRESS=y
# CONFIG_ESP_SVC_TEST_ENABLE_HTTP_TRANSPORT is not set
# CONFIG_ESP_SVC_TEST_ENABLE_SSE_TRANSPORT is not set
# CONFIG_ESP_SVC_TEST_ENABLE_WS_TRANSPORT is not set
# CONFIG_ESP_SVC_TEST_ENABLE_UART_TRANSPORT is not set

# Console on UART0 (CP2102 / ttyUSB0).
CONFIG_ESP_CONSOLE_UART_DEFAULT=y

# WebSocket support in the HTTP server, needed by the WS transport test.
CONFIG_HTTPD_WS_SUPPORT=y

CONFIG_UNITY_ENABLE_64BIT=y
```

## components/esp_wifi_service/Kconfig
```kconfig
menu "ESP-Service: Wi-Fi Service"

    menu "Provisioning agents"

        config WIFI_SERVICE_PROV_HTTP_ENABLE
            bool "Enable HTTP provisioning agent"
            default y
            help
                Enable the HTTP provisioning agent and its SoftAP captive portal helper.
                Disable this option when the application only uses non-HTTP provisioning.

        config WIFI_SERVICE_PROV_HTTP_DEFAULT_WEBUI_ENABLE
            bool "Embed default HTTP provisioning Web UI"
            depends on WIFI_SERVICE_PROV_HTTP_ENABLE
            default y
            help
                Embed the built-in HTML page used by the HTTP provisioning agent
                If disabled, the application must provide esp_wifi_service_prov_http_config_t.web_ui.data.

        config WIFI_SERVICE_PROV_BLUFI_ENABLE
            bool "Enable BLUFI provisioning agent"
            depends on BT_BLE_BLUFI_ENABLE || BT_NIMBLE_BLUFI_ENABLE
            default y
            help
                Enable the BLUFI provisioning agent for wifi_service.
                Disable this option when BLUFI provisioning is not used.

        config WIFI_SERVICE_PROV_BLUFI_BLE_SMP_ENABLE
            bool "Enable BLE SMP support in BLUFI provisioning"
            depends on WIFI_SERVICE_PROV_BLUFI_ENABLE && BT_BLUEDROID_ENABLED
            select BT_BLUFI_BLE_SMP_ENABLE
            select BT_BLE_SMP_ENABLE
            default n
            help
                Enable BLE Security Manager Protocol (SMP) for BLUFI provisioning.

        config WIFI_SERVICE_PROV_BLUFI_SECURITY_DH_ENABLE
            bool
            depends on WIFI_SERVICE_PROV_BLUFI_ENABLE
            default y
            select MBEDTLS_DHM_C
            select MBEDTLS_KEY_EXCHANGE_DHE_RSA
            help
                Internal option to keep BLUFI DH symbols linked when BLUFI agent is enabled.

    endmenu

    menu "Selector optional monitors"

        config WIFI_SERVICE_SELECTOR_PROBE_ENABLE
            bool "Enable selector HTTP probe monitor"
            default n
            help
                Enable the selector HTTP probe monitor used for Internet access checks
                and latency degradation events.

        config WIFI_SERVICE_SELECTOR_THROUGHPUT_ENABLE
            bool "Enable selector throughput monitor"
            default n
            help
                Enable the selector throughput monitor used for throughput degradation
                checks and events.

    endmenu

    config WIFI_SERVICE_MCP_ENABLE
        bool "Enable Wi-Fi service MCP tools"
        depends on ESP_MCP_ENABLE
        default n
        help
            Build the Wi-Fi service MCP tool handler and embedded tool schema.
            This option depends on the global ESP Service MCP support.

endmenu
```

## components/esp_wifi_service/examples/wifi_service_example/sdkconfig.defaults
```kconfig
CONFIG_ESP_MCP_ENABLE=y
CONFIG_WIFI_SERVICE_MCP_ENABLE=y

# Synced from wifi_demo defaults
CONFIG_PARTITION_TABLE_CUSTOM=y
CONFIG_PARTITION_TABLE_CUSTOM_FILENAME="partitions.csv"

CONFIG_ESP_WIFI_IRAM_OPT=n
CONFIG_ESP_WIFI_RX_IRAM_OPT=n

CONFIG_MBEDTLS_KEY_EXCHANGE_DHE_RSA=y
CONFIG_MBEDTLS_DHM_C=y

CONFIG_ESP_SYSTEM_EVENT_TASK_STACK_SIZE=4096
```

## components/esp_wifi_service/examples/wifi_service_example/sdkconfig.defaults.esp32
```kconfig
# Synced from wifi_demo/sdkconfig.defaults.esp32
CONFIG_BT_ENABLED=y
CONFIG_BT_CONTROLLER_ENABLED=y
CONFIG_BT_BLUEDROID_ENABLED=y
CONFIG_BT_BTC_TASK_STACK_SIZE=4096
CONFIG_BT_BLE_BLUFI_ENABLE=y
CONFIG_BT_BLE_42_FEATURES_SUPPORTED=y
```

## components/esp_wifi_service/test_apps/main/Kconfig.projbuild
```kconfig
menu "ESP Wi-Fi Service Test App"

    config WIFI_SERVICE_TEST_WITH_SSID
        bool "Run request_connect tests with configured SSIDs"
        default n
        help
            Enable unattended request_connect tests that use configured local
            Wi-Fi SSIDs and passwords.

    config WIFI_SERVICE_TEST_PRIMARY_SSID
        string "Primary Wi-Fi SSID for request_connect tests"
        default ""
        depends on WIFI_SERVICE_TEST_WITH_SSID

    config WIFI_SERVICE_TEST_SECONDARY_SSID
        string "Secondary Wi-Fi SSID for switch request_connect tests"
        default ""
        depends on WIFI_SERVICE_TEST_WITH_SSID

    config WIFI_SERVICE_TEST_PRIMARY_PASSWORD
        string "Primary Wi-Fi password for request_connect tests"
        default ""
        depends on WIFI_SERVICE_TEST_WITH_SSID

    config WIFI_SERVICE_TEST_SECONDARY_PASSWORD
        string "Secondary Wi-Fi password for switch request_connect tests"
        default ""
        depends on WIFI_SERVICE_TEST_WITH_SSID

endmenu
```

## components/esp_wifi_service/test_apps/sdkconfig.defaults
```kconfig
# SPDX-FileCopyrightText: 2026 Espressif Systems (Shanghai) CO., LTD
# SPDX-License-Identifier: LicenseRef-Espressif-Modified-MIT

CONFIG_ESPTOOLPY_FLASHSIZE_8MB=y
CONFIG_PARTITION_TABLE_CUSTOM=y
CONFIG_PARTITION_TABLE_CUSTOM_FILENAME="partitions.csv"

CONFIG_FREERTOS_HZ=1000
CONFIG_ESP_TASK_WDT_INIT=n
CONFIG_ESP_MAIN_TASK_STACK_SIZE=35840
CONFIG_ESP_SYSTEM_EVENT_TASK_STACK_SIZE=4096

CONFIG_UNITY_ENABLE_BACKTRACE_ON_FAIL=y
CONFIG_UNITY_ENABLE_64BIT=y

# Keep the default test app on local, unattended paths only.
CONFIG_WIFI_SERVICE_PROV_HTTP_ENABLE=n
CONFIG_WIFI_SERVICE_PROV_BLUFI_ENABLE=n
CONFIG_WIFI_SERVICE_SELECTOR_PROBE_ENABLE=n
CONFIG_WIFI_SERVICE_SELECTOR_THROUGHPUT_ENABLE=n
CONFIG_ESP_MCP_ENABLE=n
CONFIG_WIFI_SERVICE_TEST_WITH_SSID=n
```

## examples/advanced_examples/aec/sdkconfig.defaults.esp32p4
```kconfig
CONFIG_IDF_CMAKE=y
CONFIG_IDF_TARGET_ARCH_RISCV=y
CONFIG_IDF_TARGET_ARCH="riscv"
CONFIG_IDF_TARGET="esp32p4"
CONFIG_IDF_TARGET_ESP32P4=y
CONFIG_ESP_DEFAULT_CPU_FREQ_MHZ_360=y
CONFIG_ESP_DEFAULT_CPU_FREQ_MHZ=360
CONFIG_IDF_EXPERIMENTAL_FEATURES=y

#
# SPI RAM config
#
CONFIG_SPIRAM=y
CONFIG_SPIRAM_SPEED_200M=y
CONFIG_SPIRAM_ALLOW_STACK_EXTERNAL_MEMORY=y

#
# Audio HAL
#
CONFIG_ESP32_P4_FUNCTION_EV_BOARD=y

#
# DSP Library
#
CONFIG_DSP_ANSI=y
CONFIG_DSP_OPTIMIZATION=0
# CONFIG_DSP_MAX_FFT_SIZE_512 is not set
# CONFIG_DSP_MAX_FFT_SIZE_1024 is not set
# CONFIG_DSP_MAX_FFT_SIZE_2048 is not set
CONFIG_DSP_MAX_FFT_SIZE_4096=y
# CONFIG_DSP_MAX_FFT_SIZE_8192 is not set
# CONFIG_DSP_MAX_FFT_SIZE_16384 is not set
# CONFIG_DSP_MAX_FFT_SIZE_32768 is not set
CONFIG_DSP_MAX_FFT_SIZE=4096
# end of DSP Library
# end of Component config
```
