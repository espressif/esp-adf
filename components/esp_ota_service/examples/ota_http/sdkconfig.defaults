## components/esp_ota_service/examples/ota_http/sdkconfig.defaults
```kconfig
# Serial flasher
CONFIG_ESPTOOLPY_FLASHSIZE_8MB=y

# Partition table
CONFIG_PARTITION_TABLE_CUSTOM=y
CONFIG_PARTITION_TABLE_CUSTOM_FILENAME="partitions.csv"

# FreeRTOS
CONFIG_FREERTOS_HZ=1000
# ADF uses pre-v8 FreeRTOS type names (xSemaphoreHandle, xTimerHandle, etc.)
CONFIG_FREERTOS_ENABLE_BACKWARD_COMPATIBILITY=y

# FAT filesystem
CONFIG_FATFS_LFN_HEAP=y
CONFIG_FATFS_API_ENCODING_UTF_8=y

# OTA service
CONFIG_OTA_FORCE_VERSION_CHECK=n

# Disable esp_service MCP layer (not needed for this test)
CONFIG_ESP_MCP_ENABLE=n
CONFIG_OTA_ENABLE_ROLLBACK=y
CONFIG_BOOTLOADER_APP_ROLLBACK_ENABLE=y
```

## components/esp_ota_service/examples/ota_http/sdkconfig.defaults.esp32s3
```kconfig
CONFIG_IDF_TARGET="esp32s3"
CONFIG_IDF_TARGET_ESP32S3=y

# Board
CONFIG_ESP32_S3_KORVO2_V3_BOARD=y

# CPU / PSRAM
CONFIG_ESP32S3_DEFAULT_CPU_FREQ_240=y
CONFIG_ESP32S3_DATA_CACHE_LINE_64B=y
CONFIG_ESP32S3_SPIRAM_SUPPORT=y
CONFIG_SPIRAM_MODE_OCT=y
CONFIG_SPIRAM_ALLOW_STACK_EXTERNAL_MEMORY=y
CONFIG_SPIRAM_SPEED_80M=y
CONFIG_SPIRAM_MALLOC_ALWAYSINTERNAL=1024
```

## components/esp_ota_service/test_apps/sdkconfig.defaults
```kconfig
# SPDX-FileCopyrightText: 2026 Espressif Systems (Shanghai) CO., LTD
# SPDX-License-Identifier: LicenseRef-Espressif-Modified-MIT

CONFIG_ESPTOOLPY_FLASHSIZE_8MB=y
CONFIG_PARTITION_TABLE_CUSTOM=y
CONFIG_PARTITION_TABLE_CUSTOM_FILENAME="partition_table_unit_test_app.csv"
CONFIG_PARTITION_TABLE_FILENAME="partition_table_unit_test_app.csv"
CONFIG_PARTITION_TABLE_OFFSET=0x8000

CONFIG_FREERTOS_HZ=1000
CONFIG_ESP_TASK_WDT_INIT=n
CONFIG_ESP_MAIN_TASK_STACK_SIZE=35840

CONFIG_UNITY_ENABLE_BACKTRACE_ON_FAIL=y
CONFIG_UNITY_ENABLE_64BIT=y

# OTA unit tests do not require MCP support
CONFIG_ESP_MCP_ENABLE=n
```

## components/esp_ota_service/tools/sdcard_writer/sdkconfig.defaults
```kconfig
# Serial flasher
CONFIG_ESPTOOLPY_FLASHSIZE_8MB=y

# Partition table
CONFIG_PARTITION_TABLE_CUSTOM=y
CONFIG_PARTITION_TABLE_CUSTOM_FILENAME="partitions.csv"

# FAT filesystem
CONFIG_FATFS_LFN_HEAP=y
CONFIG_FATFS_API_ENCODING_UTF_8=y
```

## components/esp_ota_service/tools/sdcard_writer/sdkconfig.defaults.esp32s3
```kconfig
CONFIG_IDF_TARGET="esp32s3"
CONFIG_IDF_TARGET_ESP32S3=y

# CPU / PSRAM (ESP32-S3-Korvo-2 V3)
CONFIG_ESP_DEFAULT_CPU_FREQ_MHZ_240=y
CONFIG_ESP32S3_DATA_CACHE_LINE_64B=y
CONFIG_SPIRAM=y
CONFIG_SPIRAM_MODE_OCT=y
CONFIG_FREERTOS_TASK_CREATE_ALLOW_EXT_MEM=y
CONFIG_SPIRAM_SPEED_80M=y
CONFIG_SPIRAM_MALLOC_ALWAYSINTERNAL=1024
```

## components/esp_peripherals/test_apps/sdkconfig.defaults
```kconfig
#
# Compiler options
#
CONFIG_COMPILER_OPTIMIZATION_PERF=y
# end of Compiler options

#
# ESP WDT CONFIG
#
# CONFIG_TASK_WDT_PANIC is not set
CONFIG_ESP_TASK_WDT_INIT=n
CONFIG_TASK_WDT_TIMEOUT_S=10
# end of ESP WDT CONFIG

#
# ESP System Settings
#
CONFIG_ESP_MAIN_TASK_STACK_SIZE=4096
# end of ESP System Settings

#
# ESP-TLS
#
CONFIG_ESP_TLS_INSECURE=y
CONFIG_ESP_TLS_SKIP_SERVER_CERT_VERIFY=y
# end of ESP-TLS

#
# FREERTOS
#
CONFIG_FREERTOS_ENABLE_BACKWARD_COMPATIBILITY=y
CONFIG_FREERTOS_TIMER_TASK_STACK_DEPTH=4096
CONFIG_FREERTOS_GENERATE_RUN_TIME_STATS=y
CONFIG_FREERTOS_VTASKLIST_INCLUDE_COREID=y
CONFIG_FREERTOS_HZ=1000

#
# Partition Table
#
# CONFIG_PARTITION_TABLE_SINGLE_APP is not set
# CONFIG_PARTITION_TABLE_SINGLE_APP_LARGE is not set
# CONFIG_PARTITION_TABLE_TWO_OTA is not set
CONFIG_PARTITION_TABLE_CUSTOM=y
CONFIG_PARTITION_TABLE_CUSTOM_FILENAME="partitions.csv"
CONFIG_PARTITION_TABLE_FILENAME="partitions.csv"
CONFIG_PARTITION_TABLE_OFFSET=0x8000
CONFIG_PARTITION_TABLE_MD5=y
# end of Partition Table
```

## components/esp_peripherals/test_apps/sdkconfig.defaults.esp32p4
```kconfig
CONFIG_IDF_CMAKE=y
CONFIG_IDF_TARGET_ARCH_RISCV=y
CONFIG_IDF_TARGET_ARCH="riscv"
CONFIG_IDF_TARGET="esp32p4"
CONFIG_IDF_TARGET_ESP32P4=y
CONFIG_ESP_DEFAULT_CPU_FREQ_MHZ_360=y
CONFIG_ESP_DEFAULT_CPU_FREQ_MHZ=360
CONFIG_IDF_EXPERIMENTAL_FEATURES=y

#
# SPI RAM config
#
CONFIG_SPIRAM=y
CONFIG_SPIRAM_SPEED_200M=y
CONFIG_SPIRAM_ALLOW_STACK_EXTERNAL_MEMORY=y

#
# Audio HAL
#
CONFIG_ESP32_P4_FUNCTION_EV_BOARD=y
CONFIG_ESP_HOST_WIFI_ENABLED=y
CONFIG_ESP_WIFI_STATIC_RX_BUFFER_NUM=16
CONFIG_ESP_WIFI_DYNAMIC_RX_BUFFER_NUM=64
CONFIG_ESP_WIFI_DYNAMIC_TX_BUFFER_NUM=64
CONFIG_ESP_WIFI_AMPDU_TX_ENABLED=y
CONFIG_ESP_WIFI_TX_BA_WIN=32
CONFIG_ESP_WIFI_AMPDU_RX_ENABLED=y
CONFIG_ESP_WIFI_RX_BA_WIN=32

CONFIG_LWIP_TCP_SND_BUF_DEFAULT=65534
CONFIG_LWIP_TCP_WND_DEFAULT=65534
CONFIG_LWIP_TCP_RECVMBOX_SIZE=64
CONFIG_LWIP_UDP_RECVMBOX_SIZE=64
CONFIG_LWIP_TCPIP_RECVMBOX_SIZE=64
CONFIG_LWIP_TCP_SACK_OUT=y

#
# Wi-Fi Remote
#
CONFIG_SLAVE_IDF_TARGET_ESP32C6=y
CONFIG_ESP_WIFI_REMOTE_LIBRARY_HOSTED=y

#
# Bluetooth
#
CONFIG_BT_ENABLED=n
```

## components/esp_peripherals/test_apps/sdkconfig.defaults.esp32s3
```kconfig
CONFIG_IDF_CMAKE=y
CONFIG_IDF_TARGET_ARCH_XTENSA=y
CONFIG_IDF_TARGET="esp32s3"
CONFIG_IDF_TARGET_ESP32S3=y
CONFIG_IDF_FIRMWARE_CHIP_ID=0x0009


#
# Audio HAL
#
CONFIG_ESP32_S3_KORVO2_V3_BOARD=y
# end of Audio HAL

#
# ESP Speech Recognition
#
CONFIG_MODEL_IN_FLASH=y
CONFIG_AFE_INTERFACE_V1=y
CONFIG_SR_WN_WN9_HILEXIN=y
CONFIG_SR_MN_CN_MULTINET6_QUANT=y
CONFIG_SR_MN_EN_NONE=y
# end of ESP Speech Recognition

#
# Component config
#

#
# Driver configurations
#

#
# ESP32S3-Specific
#
# CONFIG_ESP32S3_DEFAULT_CPU_FREQ_80 is not set
# CONFIG_ESP32S3_DEFAULT_CPU_FREQ_160 is not set
CONFIG_ESP32S3_DEFAULT_CPU_FREQ_240=y
CONFIG_ESP32S3_DEFAULT_CPU_FREQ_MHZ=240

#
# Cache config
#
# CONFIG_ESP32S3_INSTRUCTION_CACHE_16KB is not set
CONFIG_ESP32S3_INSTRUCTION_CACHE_32KB=y
CONFIG_ESP32S3_INSTRUCTION_CACHE_SIZE=0x8000
# CONFIG_ESP32S3_INSTRUCTION_CACHE_4WAYS is not set
CONFIG_ESP32S3_INSTRUCTION_CACHE_8WAYS=y
CONFIG_ESP32S3_ICACHE_ASSOCIATED_WAYS=8
CONFIG_ESP32S3_INSTRUCTION_CACHE_LINE_32B=y
CONFIG_ESP32S3_INSTRUCTION_CACHE_LINE_SIZE=32
# CONFIG_ESP32S3_INSTRUCTION_CACHE_WRAP is not set
# CONFIG_ESP32S3_DATA_CACHE_16KB is not set
# CONFIG_ESP32S3_DATA_CACHE_32KB is not set
CONFIG_ESP32S3_DATA_CACHE_64KB=y
CONFIG_ESP32S3_DATA_CACHE_SIZE=0x10000
# CONFIG_ESP32S3_DATA_CACHE_4WAYS is not set
CONFIG_ESP32S3_DATA_CACHE_8WAYS=y
CONFIG_ESP32S3_DCACHE_ASSOCIATED_WAYS=8
# CONFIG_ESP32S3_DATA_CACHE_LINE_32B is not set
CONFIG_ESP32S3_DATA_CACHE_LINE_64B=y
CONFIG_ESP32S3_DATA_CACHE_LINE_SIZE=64
# CONFIG_ESP32S3_DATA_CACHE_WRAP is not set
# end of Cache config

CONFIG_ESP32S3_SPIRAM_SUPPORT=y

#
# SPI RAM config
#
CONFIG_SPIRAM_MODE_OCT=y
CONFIG_SPIRAM_TYPE_AUTO=y
CONFIG_SPIRAM_SPEED_80M=y
CONFIG_SPIRAM=y
CONFIG_SPIRAM_BOOT_INIT=y
CONFIG_SPIRAM_USE_MALLOC=y
CONFIG_SPIRAM_MEMTEST=y
CONFIG_SPIRAM_MALLOC_ALWAYSINTERNAL=4096
CONFIG_SPIRAM_TRY_ALLOCATE_WIFI_LWIP=y
CONFIG_SPIRAM_MALLOC_RESERVE_INTERNAL=32768
# end of SPI RAM config
# end of ESP32S3-Specific

#
# Wi-Fi
#
CONFIG_ESP_WIFI_ENABLED=y
CONFIG_ESP_WIFI_STATIC_RX_BUFFER_NUM=16
CONFIG_ESP_WIFI_DYNAMIC_RX_BUFFER_NUM=32
CONFIG_ESP_WIFI_DYNAMIC_TX_BUFFER=y
CONFIG_ESP_WIFI_TX_BUFFER_TYPE=1
CONFIG_ESP_WIFI_DYNAMIC_TX_BUFFER_NUM=32
CONFIG_ESP_WIFI_STATIC_RX_MGMT_BUFFER=y
CONFIG_ESP_WIFI_AMPDU_TX_ENABLED=y
CONFIG_ESP_WIFI_TX_BA_WIN=16
CONFIG_ESP_WIFI_AMPDU_RX_ENABLED=y
CONFIG_ESP_WIFI_RX_BA_WIN=16

#
# LWIP
#
CONFIG_LWIP_TCP_SND_BUF_DEFAULT=65535
CONFIG_LWIP_TCP_WND_DEFAULT=65535
CONFIG_LWIP_TCP_RECVMBOX_SIZE=32
```

## components/esp_playlist/Kconfig
```kconfig
menu "ESP-Playlist"
    config ESP_PLAYLIST_NAME_MAX
        int "Maximum playlist name length (bytes, including NUL)"
        default 64
        range 16 256
        help
            Size of playlist_name in esp_playlist_info_t. Changing this value
            changes the component ABI; rebuild all dependent components after
            modification.

    config ESP_PLAYLIST_MEDIA_NAME_MAX
        int "Maximum media display name length (bytes, including NUL)"
        default 128
        range 32 512
        help
            Size of media_name in esp_playlist_info_t. Strings longer than this
            are truncated when calling curr/next/prev/get_info.

    config ESP_PLAYLIST_URL_MAX
        int "Maximum media URL length (bytes, including NUL)"
        default 128
        range 32 1024
        help
            Size of media_url in esp_playlist_info_t. Long SD card paths or HTTP
            URLs may need a larger value; each esp_playlist_info_t on the stack
            grows by (new - old) bytes for this field.
endmenu
```

## components/esp_playlist/examples/playlist_benchmark/sdkconfig.defaults
```kconfig
#
# Serial flasher config
#
CONFIG_ESPTOOLPY_FLASHMODE_QIO=y
CONFIG_ESPTOOLPY_FLASHFREQ_80M=y
CONFIG_ESPTOOLPY_FLASHSIZE_4MB=y

#
# ESP PSRAM
#
CONFIG_SPIRAM=y
CONFIG_SPIRAM_SPEED_80M=y
CONFIG_SPIRAM_MALLOC_ALWAYSINTERNAL=128

#
# Partition Table
#
CONFIG_PARTITION_TABLE_CUSTOM=y
CONFIG_PARTITION_TABLE_CUSTOM_FILENAME="partitions_example.csv"
CONFIG_PARTITION_TABLE_FILENAME="partitions_example.csv"

#
# Compiler options
#
CONFIG_COMPILER_OPTIMIZATION_PERF=y
CONFIG_ESP_TASK_WDT_TIMEOUT_S=30
CONFIG_IDF_EXPERIMENTAL_FEATURES=y

#
# FAT Filesystem support
#
CONFIG_FATFS_VFS_FSTAT_BLKSIZE=4096
CONFIG_FATFS_LFN_HEAP=y
CONFIG_FATFS_API_ENCODING_UTF_8=y
```

## components/esp_playlist/examples/playlist_benchmark/sdkconfig.defaults.esp32p4
```kconfig
CONFIG_ESP32P4_SELECTS_REV_LESS_V3=y
CONFIG_ESP32P4_REV_MIN_100=y

#
# PSRAM config
#
CONFIG_SPIRAM_MODE_HEX=y
CONFIG_SPIRAM_SPEED_200M=y
```

## components/esp_playlist/examples/playlist_benchmark/sdkconfig.defaults.esp32s3
```kconfig
#
# ESP System Settings
#
CONFIG_ESP_DEFAULT_CPU_FREQ_MHZ_240=y
CONFIG_SPIRAM_MODE_OCT=y
```

## components/esp_playlist/test_apps/sdkconfig.defaults
```kconfig
CONFIG_PARTITION_TABLE_CUSTOM=y
CONFIG_PARTITION_TABLE_CUSTOM_FILENAME="partition.csv"
CONFIG_ESPTOOLPY_FLASHSIZE_4MB=y
CONFIG_FATFS_LFN_HEAP=y
CONFIG_FATFS_API_ENCODING_UTF_8=y
CONFIG_WL_SECTOR_SIZE_4096=y
CONFIG_UNITY_ENABLE_FLOAT=y
CONFIG_UNITY_ENABLE_DOUBLE=y
```

## components/esp_playlist/test_apps/sdkconfig.defaults.esp32p4
```kconfig
CONFIG_ESP32P4_SELECTS_REV_LESS_V3=n
CONFIG_ESP32P4_REV_MIN_300=y
CONFIG_ESP_CONSOLE_USB_SERIAL_JTAG=y

#
# PSRAM config
#
CONFIG_SPIRAM_MODE_HEX=y
CONFIG_SPIRAM_SPEED_200M=y
```

## components/esp_service/Kconfig
```kconfig
menu "ESP Service"

    config ESP_MCP_ENABLE
        bool "Enable MCP (Model Context Protocol) support"
        default y
        help
            Compiles the MCP server and transport layer, which exposes
            registered services as MCP tools callable by AI models
            (e.g. Claude, GPT-4) over HTTP/SSE, WebSocket, UART, etc.

            When disabled, only the service base class (esp_service)
            and service manager are compiled. This saves code space on
            targets that do not need AI/LLM integration.

    if ESP_MCP_ENABLE

    menu "MCP Transports"

        config ESP_MCP_TRANSPORT_HTTP
            bool "HTTP transport"
            default y
            help
                Plain HTTP POST transport. Clients send JSON-RPC requests
                and receive responses synchronously on the same connection.

        config ESP_MCP_TRANSPORT_SSE
            bool "HTTP+SSE transport (recommended)"
            default y
            help
                MCP-recommended transport using HTTP GET for a persistent
                Server-Sent Events channel and HTTP POST for JSON-RPC delivery.
                Requires ESP-IDF >= 5.1 (httpd async handler API).

        config ESP_MCP_TRANSPORT_WS
            bool "WebSocket transport"
            default y
            depends on HTTPD_WS_SUPPORT
            help
                WebSocket transport. Requires CONFIG_HTTPD_WS_SUPPORT=y
                in the HTTP server component.

        config ESP_MCP_TRANSPORT_UART
            bool "UART transport"
            default y
            help
                UART transport using newline-delimited JSON framing.

        config ESP_MCP_TRANSPORT_STDIO
            bool "STDIO transport"
            default y
            help
                stdin/stdout transport. Useful for host-side testing
                and CLI integrations.

        config ESP_MCP_TRANSPORT_SDIO
            bool "SDIO slave transport"
            default n
            depends on IDF_TARGET_ESP32 || IDF_TARGET_ESP32C6
            help
                SDIO slave transport. Only available on ESP32 and ESP32-C6.
                Disabled by default; enable only when using an SDIO
                host-to-device link.

    endmenu  # MCP Transports

    endif  # ESP_MCP_ENABLE

endmenu  # ESP Service
```

## components/esp_service/examples/mock_services/sdkconfig.defaults
```kconfig
# Defaults for the mock_services usage example.  This example only
# exercises the six services under components/; framework-level MCP and
# transports are covered by components/esp_service/test_apps/.
CONFIG_ESP_MAIN_TASK_STACK_SIZE=4096
CONFIG_FREERTOS_HZ=1000

# Console on UART0 (CP2102 / ttyUSB0).
CONFIG_ESP_CONSOLE_UART_DEFAULT=y
```
