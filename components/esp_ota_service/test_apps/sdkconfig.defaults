## components/esp_ota_service/test_apps/sdkconfig.defaults
```kconfig
# SPDX-FileCopyrightText: 2026 Espressif Systems (Shanghai) CO., LTD
# SPDX-License-Identifier: LicenseRef-Espressif-Modified-MIT

CONFIG_ESPTOOLPY_FLASHSIZE_8MB=y
CONFIG_PARTITION_TABLE_CUSTOM=y
CONFIG_PARTITION_TABLE_CUSTOM_FILENAME="partition_table_unit_test_app.csv"
CONFIG_PARTITION_TABLE_FILENAME="partition_table_unit_test_app.csv"
CONFIG_PARTITION_TABLE_OFFSET=0x8000

CONFIG_FREERTOS_HZ=1000
CONFIG_ESP_TASK_WDT_INIT=n
CONFIG_ESP_MAIN_TASK_STACK_SIZE=35840

CONFIG_UNITY_ENABLE_BACKTRACE_ON_FAIL=y
CONFIG_UNITY_ENABLE_64BIT=y

# Enable MCP layer so esp_ota_service_mcp unit tests run by default
CONFIG_ESP_MCP_ENABLE=y
```

## components/esp_playlist/Kconfig
```kconfig
menu "ESP-Playlist"
    config ESP_PLAYLIST_COMPACT_THRESHOLD
        int "Deleted value bytes percentage triggering catalog compaction (0 disables)"
        default 25
        range 0 100
        help
            After a successful deletion, reclaim unused value data when its share
            reaches this percentage. Media IDs and row slots remain stable;
            0 disables automatic compaction.

    config ESP_PLAYLIST_NAME_MAX
        int "Maximum playlist name length (bytes, including NUL)"
        default 64
        range 16 256
        help
            Size of playlist_name in esp_playlist_info_t. Changing this value
            changes the component ABI; rebuild all dependent components after
            modification.

    config ESP_PLAYLIST_MEDIA_NAME_MAX
        int "Maximum media display name length (bytes, including NUL)"
        default 128
        range 32 512
        help
            Size of media_name in esp_playlist_info_t. Strings longer than this
            are truncated when calling curr/next/prev/get_info.

    config ESP_PLAYLIST_URL_MAX
        int "Maximum media URL length (bytes, including NUL)"
        default 128
        range 32 1024
        help
            Size of media_url in esp_playlist_info_t. Long SD card paths or HTTP
            URLs may need a larger value; each esp_playlist_info_t on the stack
            grows by (new - old) bytes for this field.

    config ESP_PLAYLIST_FILE_SIZE_MAX
        int "Maximum playlist JSON file size accepted by esp_playlist_load (bytes)"
        default 262144
        range 1024 4194304
        help
            esp_playlist_load() refuses files larger than this instead of
            allocating the whole file plus its cJSON tree in RAM, and
            esp_playlist_save() returns ESP_ERR_INVALID_SIZE instead of writing
            a file that load would refuse.
endmenu
```

## components/esp_service/Kconfig
```kconfig
menu "ESP Service"

    config ESP_MCP_ENABLE
        bool "Enable MCP (Model Context Protocol) support"
        default y
        help
            Compiles the MCP server and transport layer, which exposes
            registered services as MCP tools callable by AI models
            (e.g. Claude, GPT-4) over HTTP/SSE, WebSocket, UART, etc.

            When disabled, only the service base class (esp_service)
            and service manager are compiled. This saves code space on
            targets that do not need AI/LLM integration.

    if ESP_MCP_ENABLE

    menu "MCP Transports"

        config ESP_MCP_TRANSPORT_HTTP
            bool "HTTP transport"
            default y
            help
                Plain HTTP POST transport. Clients send JSON-RPC requests
                and receive responses synchronously on the same connection.

        config ESP_MCP_TRANSPORT_SSE
            bool "HTTP+SSE transport (recommended)"
            default y
            help
                MCP-recommended transport using HTTP GET for a persistent
                Server-Sent Events channel and HTTP POST for JSON-RPC delivery.
                Requires the httpd async handler API available in the
                supported ESP-IDF versions (>= 5.4.3).

        config ESP_MCP_TRANSPORT_WS
            bool "WebSocket transport"
            default y
            depends on HTTPD_WS_SUPPORT
            # Releases with both handshake callbacks (v5.5.5+, v6.0.1+) answer
            # the upgrade without calling the URI handler: the bearer token
            # and Origin checks run from the pre-handshake callback (401/403)
            # and clients are registered from the post-handshake callback.
            # Releases with only the pre-handshake callback (v5.4.3,
            # v5.5.2-v5.5.4, v6.0) still call the handler for the GET, which
            # registers the client. Releases without either (v5.5.0, v5.5.1)
            # call the handler after the 101 is sent; the transport refuses
            # to start there with a token or CORS disabled. Selecting an
            # undefined symbol is a no-op.
            select HTTPD_WS_PRE_HANDSHAKE_CB_SUPPORT
            select HTTPD_WS_POST_HANDSHAKE_CB_SUPPORT
            help
                WebSocket transport. Requires CONFIG_HTTPD_WS_SUPPORT=y
                in the HTTP server component.

        config ESP_MCP_HTTPD_BODY_TIMEOUT_MS
            int "HTTP/SSE request body and WebSocket frame deadline (ms)"
            default 15000
            range 5000 600000
            help
                Longest time one POST body or one WebSocket frame may take to
                arrive, measured from the first read. esp_http_server serves
                every connection from one task, so a client that trickles its
                body holds all other clients for about this long; a POST is
                then answered with 408 and the socket is closed, a WebSocket
                client is dropped. The deadline is checked around each read,
                so a read that blocks for the httpd receive timeout
                (recv_wait_timeout, 5 s by default) can overrun it by that
                much; the minimum is one such window. esp_http_server reads
                the first byte of a WebSocket frame before the handler arms
                the deadline, so a frame can overrun it by two such windows.
                The default allows a max_request_size body (4096 bytes) at
                well under 3 kbit/s.

        config ESP_MCP_TRANSPORT_UART
            bool "UART transport"
            default y
            help
                UART transport using newline-delimited JSON framing.

        config ESP_MCP_TRANSPORT_STDIO
            bool "STDIO transport"
            default y
            help
                stdin/stdout transport. Useful for host-side testing
                and CLI integrations.

        config ESP_MCP_TRANSPORT_SDIO
            bool "SDIO slave transport"
            default n
            depends on IDF_TARGET_ESP32 || IDF_TARGET_ESP32C6
            help
                SDIO slave transport. Only available on ESP32 and ESP32-C6.
                Disabled by default; enable only when using an SDIO
                host-to-device link.

    endmenu  # MCP Transports

    endif  # ESP_MCP_ENABLE

endmenu  # ESP-Service: ESP Service Base
```
