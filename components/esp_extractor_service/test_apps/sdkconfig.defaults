## components/esp_extractor_service/test_apps/sdkconfig.defaults
```kconfig
CONFIG_FREERTOS_HZ=1000
CONFIG_ESP_TASK_WDT_INIT=n
CONFIG_UNITY_ENABLE_BACKTRACE_ON_FAIL=y
CONFIG_ESP_MEDIA_DUMMY_SERVICE_SINK_SUPPORT=y
CONFIG_ESP_EXTRACTOR_SERVICE_FILE_IO_SUPPORT=y
```

## components/esp_llm_baidu/test_apps/sdkconfig.defaults
```kconfig
# SPDX-FileCopyrightText: 2026 Espressif Systems (Shanghai) CO., LTD
# SPDX-License-Identifier: Apache-2.0
CONFIG_FREERTOS_HZ=1000
CONFIG_ESP_TASK_WDT_INIT=n
CONFIG_UNITY_ENABLE_BACKTRACE_ON_FAIL=y
CONFIG_UNITY_ENABLE_64BIT=y
CONFIG_ESP_MAIN_TASK_STACK_SIZE=8192
CONFIG_SPIRAM=y
CONFIG_ESPTOOLPY_FLASHSIZE_8MB=y
CONFIG_ESP_LLM_BAIDU_AGENT_AUDIO_CODEC_PCM=y
CONFIG_ESP_MEDIA_DUMMY_SERVICE_SRC_SUPPORT=y
CONFIG_ESP_MEDIA_DUMMY_SERVICE_SINK_SUPPORT=y
```

## components/esp_llm_baidu/test_apps/sdkconfig.defaults.esp32p4
```kconfig
CONFIG_IDF_TARGET="esp32p4"
CONFIG_PARTITION_TABLE_OFFSET=0xA000
CONFIG_LIBC_NEWLIB=y
```

## components/esp_llm_baidu/test_apps/sdkconfig.defaults.esp32s31
```kconfig
CONFIG_IDF_TARGET="esp32s31"
CONFIG_ESPTOOLPY_FLASHSIZE_16MB=y
CONFIG_SPIRAM_MODE_OCT=y
CONFIG_SPIRAM_SPEED_80M=y
```

## components/esp_llm_coze/Kconfig
```kconfig
menu "ESP LLM Coze"

    config ESP_LLM_COZE_ENABLE
        bool "Enable ESP LLM Coze adapter"
        default y
        depends on ESP_LLM_SERVICE_ENABLE
        help
            Build the Coze adapter as a sibling component for esp_llm_service.

    menu "Audio profile"

        choice ESP_LLM_COZE_AUDIO_CODEC
            prompt "Uplink/downlink audio codec"
            default ESP_LLM_COZE_AUDIO_CODEC_OPUS

            config ESP_LLM_COZE_AUDIO_CODEC_OPUS
                bool "OPUS (16 kHz)"
                select AUDIO_ENCODER_OPUS_SUPPORT
                select AUDIO_DECODER_OPUS_SUPPORT

            config ESP_LLM_COZE_AUDIO_CODEC_PCM
                bool "PCM (16 kHz)"

            config ESP_LLM_COZE_AUDIO_CODEC_G711A
                bool "G.711 A-law (8 kHz)"

            config ESP_LLM_COZE_AUDIO_CODEC_G711U
                bool "G.711 mu-law (8 kHz)"

        endchoice

        config ESP_LLM_COZE_DOWNLINK_BITRATE
            int "Opus downlink bitrate (bits/s)"
            default 16000
            depends on ESP_LLM_COZE_AUDIO_CODEC_OPUS

        config ESP_LLM_COZE_DOWNLINK_FRAME_SIZE_MS
            int "Downlink frame size (ms)"
            default 60

        choice ESP_LLM_COZE_VAD_MODE
            prompt "Server VAD silence mode"
            default ESP_LLM_COZE_VAD_SILENCE_FAST

            config ESP_LLM_COZE_VAD_SILENCE_FAST
                bool "Fast silence detection"

            config ESP_LLM_COZE_VAD_SILENCE_NORMAL
                bool "Normal silence detection"

        endchoice

    endmenu

endmenu
```

## components/esp_llm_service/Kconfig
```kconfig
menu "ESP LLM Service"

    config ESP_LLM_SERVICE_MCP_ENABLE
        bool "Enable LLM service MCP tools"
        depends on ESP_MCP_ENABLE
        default n
        help
            Compile MCP session tools for esp_llm_service.

    config ESP_LLM_SERVICE_UPLINK_FRAME_TIMEOUT_MS
        int "Uplink acquire_frame timeout (ms)"
        default 100

    config ESP_LLM_SERVICE_UPLINK_STOP_TIMEOUT_MS
        int "Uplink task stop wait timeout (ms)"
        default 5000
        help
            Maximum time to wait for each media consume task to exit on stop.

    config ESP_LLM_SERVICE_TEST_HOOKS
        bool "Enable LLM service unit-test hooks"
        default n
        help
            Injected faults for contract tests. Do not enable in product builds.

endmenu
```

## components/esp_llm_service/test_apps/sdkconfig.defaults
```kconfig
# SPDX-FileCopyrightText: 2026 Espressif Systems (Shanghai) CO., LTD
# SPDX-License-Identifier: LicenseRef-Espressif-Modified-MIT
CONFIG_FREERTOS_HZ=1000
CONFIG_ESP_TASK_WDT_INIT=n
CONFIG_UNITY_ENABLE_BACKTRACE_ON_FAIL=y
CONFIG_UNITY_ENABLE_64BIT=y
CONFIG_ESP_MCP_ENABLE=y
CONFIG_ESP_LLM_SERVICE_MCP_ENABLE=y
CONFIG_ESP_LLM_SERVICE_UPLINK_STOP_TIMEOUT_MS=300
CONFIG_ESP_LLM_SERVICE_TEST_HOOKS=y
CONFIG_ESP_MEDIA_DUMMY_SERVICE_SRC_SUPPORT=y
CONFIG_ESP_MEDIA_DUMMY_SERVICE_SINK_SUPPORT=y
```

## components/esp_llm_tongyi/Kconfig
```kconfig
menu "ESP LLM Tongyi"

    config ESP_LLM_TONGYI_ENABLE
        bool "Enable ESP LLM Tongyi adapter"
        default y
        depends on ESP_LLM_SERVICE_ENABLE
        help
            Build the Tongyi adapter as a sibling component for esp_llm_service.

    menu "Audio profile"

        config ESP_LLM_TONGYI_SAMPLE_RATE
            int "Audio sample rate (Hz)"
            default 16000

        config ESP_LLM_TONGYI_FRAME_SIZE_MS
            int "Downstream Opus frame size (ms)"
            default 60

        config ESP_LLM_TONGYI_BIT_RATE_KBPS
            int "Downstream bit rate (kbps)"
            default 32

        config ESP_LLM_TONGYI_CAPTURE_UPLINK_BITRATE
            int "Capture uplink Opus bitrate (bps)"
            default 24000

    endmenu

    rsource "components/esp_tongyi/Kconfig"

endmenu
```

## components/esp_llm_tongyi/components/esp_tongyi/Kconfig
```kconfig
menu "ESP Tongyi"

    config ESP_TONGYI_WS_BUFFER_SIZE
        int "WebSocket RX/TX buffer size (bytes)"
        range 1024 131072
        default 20480
        help
            Passed to esp_websocket_client_config_t.buffer_size when
            transport.buffer_size is 0.

    config ESP_TONGYI_WS_CONNECT_TIMEOUT_MS
        int "Wait for WebSocket connected / session Started (ms)"
        range 1000 300000
        default 5000
        help
            Timeout used by esp_tongyi_start() when waiting for connected
            and server Started events.

    config ESP_TONGYI_WS_RECONNECT_TIMEOUT_MS
        int "WebSocket reconnect timeout (ms)"
        range 100 300000
        default 1000
        help
            reconnect_timeout_ms forwarded to esp_websocket_client_config_t.

    config ESP_TONGYI_WS_SEND_TIMEOUT_MS
        int "WebSocket send timeout (ms)"
        range 100 120000
        default 3000
        help
            Timeout used when sending text and binary frames.

    config ESP_TONGYI_WS_NETWORK_TIMEOUT_MS
        int "WebSocket network I/O timeout (ms)"
        range 100 300000
        default 5000
        help
            network_timeout_ms for esp_websocket_client_config_t.

    config ESP_TONGYI_MAX_JSON_BYTES
        int "Max assembled JSON message (bytes)"
        range 1024 1048576
        default 65536
        help
            Upper bound for WebSocket JSON reassembly.

    config ESP_TONGYI_MAX_BINARY_BYTES
        int "Max assembled binary message (bytes)"
        range 1024 1048576
        default 65536
        help
            Upper bound for WebSocket binary/audio reassembly.

    config ESP_TONGYI_MAX_IMAGE_BYTES
        int "Max image upload size (bytes)"
        range 1024 2097152
        default 262144
        help
            Maximum raw image accepted by esp_tongyi_send_image().

endmenu
```

## components/esp_llm_tongyi/test_apps/sdkconfig.defaults.esp32s3
```kconfig
CONFIG_IDF_TARGET="esp32s3"
CONFIG_ESPTOOLPY_FLASHMODE_QIO=y
CONFIG_SPIRAM_MODE_OCT=y
CONFIG_SPIRAM_SPEED_80M=y
```

## components/esp_llm_volc/Kconfig
```kconfig
menu "ESP LLM Volc"

    config ESP_LLM_VOLC_ENABLE
        bool "Enable ESP LLM Volc adapter"
        default y
        depends on ESP_LLM_SERVICE_ENABLE
        help
            Build the Volc adapter as a sibling component for esp_llm_service.

    menu "Audio profile"

        choice ESP_LLM_VOLC_AUDIO_CODEC
            prompt "RTC audio codec"
            default ESP_LLM_VOLC_AUDIO_CODEC_G711A

            config ESP_LLM_VOLC_AUDIO_CODEC_OPUS
                bool "OPUS (16 kHz)"
                select AUDIO_ENCODER_OPUS_SUPPORT
                select AUDIO_DECODER_OPUS_SUPPORT

            config ESP_LLM_VOLC_AUDIO_CODEC_G711A
                bool "G.711 A-law (8 kHz)"

            config ESP_LLM_VOLC_AUDIO_CODEC_G711U
                bool "G.711 mu-law (8 kHz)"

        endchoice

    endmenu

    menu "Video RTC profile"

        config ESP_LLM_VOLC_VIDEO_PUBLISH
            bool "Publish RTC video track when video uplink is enabled"
            default n

        config ESP_LLM_VOLC_VIDEO_SUBSCRIBE
            bool "Subscribe RTC remote video"
            default n

        choice ESP_LLM_VOLC_VIDEO_CODEC
            prompt "RTC video codec"
            default ESP_LLM_VOLC_VIDEO_CODEC_JPEG

            config ESP_LLM_VOLC_VIDEO_CODEC_JPEG
                bool "JPEG"

            config ESP_LLM_VOLC_VIDEO_CODEC_H264
                bool "H.264"

        endchoice

    endmenu

endmenu
```

## components/esp_media_service/Kconfig
```kconfig
menu "ESP Media Service"

    config ESP_MEDIA_SERVICE_MCP_ENABLE
        bool "Enable media service MCP tools"
        depends on ESP_MCP_ENABLE
        default n
        help
            Build media service MCP tool handlers for link/unlink and dummy-sink
            get_stats, plus the embedded tool schemas. Depends on the global ESP
            Service MCP support.

    menu "ESP Media Dummy Service"

        config ESP_MEDIA_DUMMY_SERVICE_SRC_SUPPORT
            bool "Enable dummy media source service"
            default n
            help
                Build the debug-only dummy source that generates audio/video pattern frames.
                Encoded pattern assets are embedded only when this option is enabled.

        config ESP_MEDIA_DUMMY_SERVICE_SINK_SUPPORT
            bool "Enable dummy media sink service"
            default n
            help
                Build the debug-only dummy sink that consumes linked providers and keeps
                per-stream audio/video statistics.

    endmenu

endmenu
```

## components/esp_muxer_service/Kconfig
```kconfig
menu "ESP-Muxer Service"

    config ESP_MUXER_SERVICE_MCP_ENABLE
        bool "Enable muxer service MCP tools"
        depends on ESP_MCP_ENABLE
        default n
        help
            Build the muxer service MCP tool handler and embedded tool schema.
            This option depends on the global ESP Service MCP support.

endmenu
```

## components/esp_muxer_service/examples/muxer_service/main/Kconfig.projbuild
```kconfig
menu "Muxer service example"

    if ESP_MUXER_SERVICE_MCP_ENABLE && ESP_MCP_TRANSPORT_UART

    menu "MCP UART pins"

        config MUXER_MCP_UART_PORT
            int "MCP UART port number"
            range 0 2
            default 1
            help
                UART port used by the MCP transport. Keep this off the console UART.

        config MUXER_MCP_UART_TX_IO
            int "MCP UART TX GPIO"
            range 0 48
            default 21
            help
                Device TX pin. Connect to the USB-UART adapter RX.

        config MUXER_MCP_UART_RX_IO
            int "MCP UART RX GPIO"
            range 0 48
            default 22
            help
                Device RX pin. Connect to the USB-UART adapter TX.

        config MUXER_MCP_UART_BAUD
            int "MCP UART baud rate"
            default 115200
            help
                Baud rate for the MCP UART transport.

    endmenu

    endif  # ESP_MUXER_SERVICE_MCP_ENABLE && ESP_MCP_TRANSPORT_UART

endmenu
```

## components/esp_muxer_service/examples/muxer_service/sdkconfig.defaults
```kconfig
CONFIG_ESP_MAIN_TASK_STACK_SIZE=10240
CONFIG_FREERTOS_HZ=1000
CONFIG_ESP_TASK_WDT_EN=n
CONFIG_ESP_INT_WDT=n

CONFIG_ESP_MEDIA_DUMMY_SERVICE_SRC_SUPPORT=y
CONFIG_ESP_MUXER_TS_SUPPORT=y

CONFIG_ESP_MCP_ENABLE=y
CONFIG_ESP_MCP_TRANSPORT_UART=y
CONFIG_ESP_MUXER_SERVICE_MCP_ENABLE=y
CONFIG_ESP_MEDIA_SERVICE_MCP_ENABLE=y

CONFIG_PARTITION_TABLE_SINGLE_APP_LARGE=y
```

## components/esp_player_service/test_apps/sdkconfig.defaults
```kconfig
CONFIG_ESP_MAIN_TASK_STACK_SIZE=10240
CONFIG_ESP_TASK_WDT_INIT=n
CONFIG_FREERTOS_HZ=1000
CONFIG_FREERTOS_ENABLE_BACKWARD_COMPATIBILITY=y
CONFIG_FREERTOS_TASK_CREATE_ALLOW_EXT_MEM=y

# Audio-only parent UT: no video render / HLS.
CONFIG_ESP_PLAYER_ENABLE_AUDIO=y
CONFIG_ESP_PLAYER_ENABLE_VIDEO=n
CONFIG_ESP_PLAYER_ENABLE_HLS_IO=n

CONFIG_SPIRAM=y
CONFIG_ESPTOOLPY_FLASHSIZE_8MB=y
CONFIG_PARTITION_TABLE_OFFSET=0x9000
CONFIG_PARTITION_TABLE_CUSTOM=y
CONFIG_PARTITION_TABLE_CUSTOM_FILENAME="partitions.csv"
```

## components/esp_rtmp_service/Kconfig
```kconfig
menu "ESP-RTMP Service"

    config ESP_RTMP_SERVICE_SRC_SUPPORT
        bool "Enable RTMP source role"
        default y
        help
            Build RTMP puller/source support.

    config ESP_RTMP_SERVICE_SINK_SUPPORT
        bool "Enable RTMP sink role"
        default y
        help
            Build RTMP pusher/sink support.

    config ESP_RTMP_SERVICE_SERVER_SUPPORT
        bool "Enable RTMP server role"
        default y
        help
            Build RTMP server/listener support.

    config ESP_RTMP_SERVICE_MCP_ENABLE
        bool "Enable RTMP service MCP tools"
        depends on ESP_MCP_ENABLE
        default n
        help
            Build the RTMP service MCP tool handler and embedded tool schema.
            This option depends on the global ESP Service MCP support.

endmenu
```

## components/esp_rtmp_service/examples/rtmp_service/main/Kconfig.projbuild
```kconfig
menu "RTMP service example"

    config RTMP_EXAMPLE_WIFI_SSID
        string "WiFi SSID"
        default "myssid"

    config RTMP_EXAMPLE_WIFI_PASSWORD
        string "WiFi password"
        default "mypassword"

    config RTMP_EXAMPLE_WIFI_WAIT_SEC
        int "WiFi connect wait (seconds)"
        default 10
        range 5 120

    config RTMP_EXAMPLE_PUSH_URL
        string "Pusher RTMP URL"
        default "rtmp://192.168.1.10/live/stream0"

    config RTMP_EXAMPLE_PULL_URL
        string "Puller RTMP URL"
        default "rtmp://192.168.1.10/live/stream0"

    config RTMP_EXAMPLE_SERVER_URL
        string "Local server listen URL"
        default "rtmp://0.0.0.0:1935/live"

    config RTMP_EXAMPLE_SERVER_STREAM
        string "Server stream name used in ffmpeg examples"
        default "stream0"

    if ESP_RTMP_SERVICE_MCP_ENABLE && ESP_MCP_TRANSPORT_UART

    menu "MCP UART pins"

        config RTMP_MCP_UART_PORT
            int "MCP UART port number"
            range 0 2
            default 1

        config RTMP_MCP_UART_TX_IO
            int "MCP UART TX GPIO"
            range 0 48
            default 21

        config RTMP_MCP_UART_RX_IO
            int "MCP UART RX GPIO"
            range 0 48
            default 22

        config RTMP_MCP_UART_BAUD
            int "MCP UART baud rate"
            default 115200

    endmenu

    endif  # ESP_RTMP_SERVICE_MCP_ENABLE && ESP_MCP_TRANSPORT_UART

endmenu
```

## components/esp_rtmp_service/examples/rtmp_service/sdkconfig.defaults
```kconfig
# SPDX-FileCopyrightText: 2026 Espressif Systems (Shanghai) CO., LTD
# SPDX-License-Identifier: LicenseRef-Espressif-Modified-MIT

CONFIG_ESP_MAIN_TASK_STACK_SIZE=10240
CONFIG_FREERTOS_HZ=1000
CONFIG_ESP_TASK_WDT_EN=n
CONFIG_ESP_INT_WDT=n
CONFIG_SPIRAM=y

CONFIG_ESP_MEDIA_DUMMY_SERVICE_SRC_SUPPORT=y
CONFIG_ESP_MEDIA_DUMMY_SERVICE_SINK_SUPPORT=y
CONFIG_ESP_RTMP_SERVICE_SRC_SUPPORT=y
CONFIG_ESP_RTMP_SERVICE_SINK_SUPPORT=y
CONFIG_ESP_RTMP_SERVICE_SERVER_SUPPORT=y

CONFIG_ESP_MCP_ENABLE=y
CONFIG_ESP_MCP_TRANSPORT_UART=y
CONFIG_ESP_RTMP_SERVICE_MCP_ENABLE=y
CONFIG_ESP_MEDIA_SERVICE_MCP_ENABLE=y

# Optimized for TCP speed
CONFIG_LWIP_TCPIP_RECVMBOX_SIZE=64
CONFIG_LWIP_SO_RCVBUF=y
CONFIG_LWIP_TCP_SND_BUF_DEFAULT=32768
CONFIG_LWIP_TCP_WND_DEFAULT=32768
CONFIG_LWIP_TCP_RECVMBOX_SIZE=64
CONFIG_LWIP_TCP_ACCEPTMBOX_SIZE=32

CONFIG_PARTITION_TABLE_SINGLE_APP_LARGE=y
```
