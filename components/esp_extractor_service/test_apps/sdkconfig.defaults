## components/esp_rtmp_service/test_apps/sdkconfig.defaults
```kconfig
# SPDX-FileCopyrightText: 2026 Espressif Systems (Shanghai) CO., LTD
# SPDX-License-Identifier: LicenseRef-Espressif-Modified-MIT
CONFIG_FREERTOS_HZ=1000
CONFIG_ESP_TASK_WDT_INIT=n
CONFIG_UNITY_ENABLE_BACKTRACE_ON_FAIL=y
CONFIG_ESP_MEDIA_DUMMY_SERVICE_SRC_SUPPORT=y
CONFIG_ESP_MEDIA_DUMMY_SERVICE_SINK_SUPPORT=y
CONFIG_ESP_RTMP_SERVICE_SRC_SUPPORT=y
CONFIG_ESP_RTMP_SERVICE_SINK_SUPPORT=y
CONFIG_ESP_RTMP_SERVICE_SERVER_SUPPORT=y
```

## components/esp_rtsp_service/Kconfig
```kconfig
menu "ESP-RTSP Service"

    config ESP_RTSP_SERVICE_SRC_SUPPORT
        bool "Enable RTSP source role"
        default y
        help
            Build RTSP client play/source support.

    config ESP_RTSP_SERVICE_SINK_SUPPORT
        bool "Enable RTSP sink role"
        default y
        help
            Build RTSP client push/sink support.

    config ESP_RTSP_SERVICE_SERVER_SUPPORT
        bool "Enable RTSP server role"
        default y
        help
            Build RTSP server support for locally pushed frames.

    config ESP_RTSP_SERVICE_MCP_ENABLE
        bool "Enable RTSP service MCP tools"
        depends on ESP_MCP_ENABLE
        default n
        help
            Build the RTSP service MCP tool handler and embedded tool schema.
            This option depends on the global ESP Service MCP support.

endmenu
```

## components/esp_rtsp_service/examples/rtsp_service/main/Kconfig.projbuild
```kconfig
menu "RTSP service example"

    config RTSP_EXAMPLE_WIFI_SSID
        string "WiFi SSID"
        default "myssid"

    config RTSP_EXAMPLE_WIFI_PASSWORD
        string "WiFi password"
        default "mypassword"

    config RTSP_EXAMPLE_PUSH_URL
        string "Pusher RTSP URL"
        default "rtsp://192.168.1.10:8554/live"

    config RTSP_EXAMPLE_PULL_URL
        string "Puller RTSP URL"
        default "rtsp://192.168.1.10:8554/live"

    config RTSP_EXAMPLE_SERVER_URL
        string "Local server URL"
        default "rtsp://0.0.0.0:554/live"

    if ESP_RTSP_SERVICE_MCP_ENABLE && ESP_MCP_TRANSPORT_UART

    menu "MCP UART pins"

        config RTSP_MCP_UART_PORT
            int "MCP UART port number"
            range 0 2
            default 1

        config RTSP_MCP_UART_TX_IO
            int "MCP UART TX GPIO"
            range 0 48
            default 21

        config RTSP_MCP_UART_RX_IO
            int "MCP UART RX GPIO"
            range 0 48
            default 22

        config RTSP_MCP_UART_BAUD
            int "MCP UART baud rate"
            default 115200

    endmenu

    endif

endmenu
```

## components/esp_rtsp_service/examples/rtsp_service/sdkconfig.defaults
```kconfig
# SPDX-FileCopyrightText: 2026 Espressif Systems (Shanghai) CO., LTD
# SPDX-License-Identifier: LicenseRef-Espressif-Modified-MIT

CONFIG_ESP_MAIN_TASK_STACK_SIZE=10240
CONFIG_FREERTOS_HZ=1000
CONFIG_ESP_TASK_WDT_EN=n
CONFIG_ESP_INT_WDT=n
CONFIG_SPIRAM=y

CONFIG_ESP_MEDIA_DUMMY_SERVICE_SRC_SUPPORT=y
CONFIG_ESP_MEDIA_DUMMY_SERVICE_SINK_SUPPORT=y
CONFIG_ESP_RTSP_SERVICE_SRC_SUPPORT=y
CONFIG_ESP_RTSP_SERVICE_SINK_SUPPORT=y
CONFIG_ESP_RTSP_SERVICE_SERVER_SUPPORT=y
CONFIG_LWIP_MAX_UDP_PCBS=64
CONFIG_LWIP_UDP_RECVMBOX_SIZE=64

CONFIG_ESP_MCP_ENABLE=y
CONFIG_ESP_MCP_TRANSPORT_UART=y
CONFIG_ESP_RTSP_SERVICE_MCP_ENABLE=y
CONFIG_ESP_MEDIA_SERVICE_MCP_ENABLE=y

CONFIG_PARTITION_TABLE_SINGLE_APP_LARGE=y
```
