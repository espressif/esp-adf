## adf_examples/ai_agent/coze_ws_app/main/Kconfig.projbuild
```kconfig
menu "Example Audio Configuration"

#
# Select how the audio conversation is triggered
#
choice
    prompt "Audio Conversation Trigger Mode"
    default CONTINUOUS_CONVERSATION_MODE

config VOICE_WAKEUP_MODE
    bool "Wake Word Mode"
    select SR_WN_WN9_HILEXIN
    help
      System is activated by a predefined wake word (e.g. 'Hi Lexin').

config CONTINUOUS_CONVERSATION_MODE
    bool "Continuous Mode"
    help
      Keeps the system active after the initial trigger for ongoing conversation.

config KEY_PRESS_DIALOG_MODE
    bool "Key Press Mode"
    help
      System is triggered by a physical key press.

endchoice

#
# Select audio upload encoding format
#
choice
    prompt "Audio Upload Encoding Format"
    default UPLOAD_FORMAT_OPUS
    help
      Select the audio format for uploading voice data to COZE service.

config UPLOAD_FORMAT_OPUS
    bool "OPUS"
    help
      Use OPUS encoding for uploading audio data.

config UPLOAD_FORMAT_PCM
    bool "PCM"
    help
      Use PCM encoding for uploading audio data.
      Note: Not recommended for production use due to large data size.

config UPLOAD_FORMAT_G711A
    bool "G711A (A-law)"
    help
      Use G711A (A-law) encoding for uploading audio data.

config UPLOAD_FORMAT_G711U
    bool "G711U (μ-law)"
    help
      Use G711U (μ-law) encoding for uploading audio data.

endchoice

#
# Select audio download decoding format
#
choice
    prompt "Audio Download Decoding Format"
    default DOWNLOAD_FORMAT_OPUS
    help
      Select the audio format for downloading voice data from COZE service.

config DOWNLOAD_FORMAT_OPUS
    bool "OPUS"
    help
      Use OPUS decoding for downloading audio data.

config DOWNLOAD_FORMAT_PCM
    bool "PCM"
    help
      Use PCM decoding for downloading audio data.
      Note: Not recommended for production use due to large data size.

config DOWNLOAD_FORMAT_G711A
    bool "G711A (A-law)"
    help
      Use G711A (A-law) decoding for downloading audio data.

config DOWNLOAD_FORMAT_G711U
    bool "G711U (μ-law)"
    help
      Use G711U (μ-law) decoding for downloading audio data.

endchoice

config ENABLE_RECORDER_DEBUG
    bool "Enable AEC Debug"
    default n
    help
      Enable AEC (Acoustic Echo Cancellation) debug functionality.
      When enabled, AEC debug data will be written for debugging purposes.

config COZE_BOT_ID
    string "COZE_BOT_ID"
    default "7239506**************"

config COZE_ACCESS_TOKEN
    string "COZE_ACCESS_TOKEN"
    default "pat_******************"

endmenu
```

## adf_examples/ai_agent/coze_ws_app/sdkconfig.defaults.esp32
```kconfig
CONFIG_IDF_CMAKE=y
CONFIG_IDF_TARGET="esp32"

#
# Partition Table
#
CONFIG_PARTITION_TABLE_CUSTOM=y
CONFIG_PARTITION_TABLE_CUSTOM_FILENAME="partitions_lite.csv"
CONFIG_PARTITION_TABLE_FILENAME="partitions_lite.csv"
CONFIG_PARTITION_TABLE_OFFSET=0x8000
CONFIG_PARTITION_TABLE_MD5=y
# end of Partition Table
```

## adf_examples/ai_agent/coze_ws_app/sdkconfig.defaults.esp32c6
```kconfig
CONFIG_IDF_CMAKE=y
CONFIG_IDF_TARGET_ARCH_RISCV=y
CONFIG_IDF_TARGET="esp32c6"
CONFIG_IDF_TARGET_ESP32c6=y

#
# Partition Table
#
CONFIG_PARTITION_TABLE_CUSTOM=y
CONFIG_PARTITION_TABLE_CUSTOM_FILENAME="partitions_lite.csv"
CONFIG_PARTITION_TABLE_FILENAME="partitions_lite.csv"
CONFIG_PARTITION_TABLE_OFFSET=0x8000
CONFIG_PARTITION_TABLE_MD5=y
# end of Partition Table
```

## adf_examples/checks/esp_audio_analyzer_app/main/Kconfig.projbuild
```kconfig
menu "ESP Audio Analyzer App Configuration"

    config AUDIO_ANALYZER_HARDWARE_NAME
        string "Hardware Name"
        default "ESP-Audio-Hardware"
        help
            Specifies the device or hardware name used in the audio test system.
            This name will be displayed in the generated test reports.

    config AUDIO_ANALYZER_ENABLE_AFE
        bool "Enable AFE"
        default y
        select GMF_AI_AUDIO_INIT_AFE
        help
            Enable Audio Front-End (AFE) in the recording pipeline.

        menu "Audio Front-End (AFE) Configuration"
            depends on AUDIO_ANALYZER_ENABLE_AFE

            config AUDIO_ANALYZER_AFE_ENABLE_AEC
                bool "Enable AEC"
                default y
                select GMF_AI_AUDIO_AFE_AEC_ENABLE
                help
                    Enables the internal Acoustic Echo Cancellation (AEC) in the AFE pipeline.

            config AUDIO_ANALYZER_AFE_ENABLE_WAKEUP
                bool "Enable Wakeup"
                default n
                select GMF_AI_AUDIO_WAKEUP_ENABLE
                help
                    Enables wake word detection functionality in the AFE pipeline.

            config AUDIO_ANALYZER_AFE_ENABLE_VOICE_COMMAND
                bool "Enable Voice Command"
                default n
                select GMF_AI_AUDIO_VOICE_COMMAND_ENABLE
                help
                    Enables voice command detection functionality in the AFE pipeline.

        endmenu

    config AUDIO_ANALYZER_ENABLE_EMBED_FLASH
        bool "Enable store test audio in embed flash"
        default y
        help
            Enable storing test audio in embed flash to test audio playback.

    config AUDIO_ANALYZER_ENABLE_SYSTEM_MONITOR
        bool "Enable system monitor"
        default n
        select FREERTOS_VTASKLIST_INCLUDE_COREID
        select FREERTOS_GENERATE_RUN_TIME_STATS
        help
            Enable system monitor to monitor the system status.

endmenu

menu "Example WIFI Configuration"

    config ESP_WIFI_SSID
        string "WiFi STA SSID"
        default ""
        help
        WiFi SSID (network name) to connect to or empty for Off.

    config ESP_WIFI_PASSWORD
        string "WiFi STA Password"
        default ""
        help
        WiFi Password if WEP/WPA/WPA2 or empty if Open.

    config ESP_WIFI_AP_SSID
        string "WiFi AP SSID"
        default ""
        help
        AP SSID (network name) to create or empty for Off.

    config ESP_WIFI_AP_PASSWORD
        string "WiFi AP Password"
        default ""
        help
        AP password for WPA2 or empty for Open.

    config MAX_STA_CONN
        int "Maximal STA connections"
        default 1
        help
        Max number of the STA connects to AP.

    config ESP_WIFI_AP_CHANNEL
        string "WiFi AP Channel"
        default ""
        help
        AP channel for better connection performance.

    config SERVER_IP
        string "WiFi AP IP Address"
        default "192.168.4.1"
        help
            IP address that the ESP will assign to it's AP interface. You can use this IP to connect to the camera after flashing.

    config ESP_MAXIMUM_RETRY
        int "Maximum retry"
        default 5
        help
        Set the Maximum retry to avoid station reconnecting to the AP unlimited when the AP is really inexistent.

endmenu
```

## adf_examples/checks/esp_audio_analyzer_app/sdkconfig.defaults
```kconfig
CONFIG_FREERTOS_HZ=1000
CONFIG_FREERTOS_ENABLE_BACKWARD_COMPATIBILITY=y

CONFIG_PARTITION_TABLE_CUSTOM=y
CONFIG_ESPTOOLPY_FLASHSIZE_4MB=y

CONFIG_AUDIO_ANALYZER_ENABLE_EMBED_FLASH=y
CONFIG_GMF_AI_AUDIO_INIT_AFE=y
CONFIG_GMF_AI_AUDIO_AFE_VAD_ENABLE=n

CONFIG_COMPILER_OPTIMIZATION_SIZE=y
CONFIG_PERIPH_CTRL_FUNC_IN_IRAM=y

CONFIG_HTTPD_MAX_REQ_HDR_LEN=1024
CONFIG_HTTPD_WS_SUPPORT=y
CONFIG_ESP_HTTPS_SERVER_ENABLE=y
CONFIG_LWIP_IRAM_OPTIMIZATION=y

CONFIG_GMF_AUDIO_CODEC_DECODER_TYPE_FLAC=y
CONFIG_GMF_AUDIO_CODEC_ENCODER_TYPE_PCM=y
```

## adf_examples/checks/esp_audio_analyzer_app/sdkconfig.defaults.esp32p4
```kconfig
CONFIG_IDF_TARGET="esp32p4"
CONFIG_ESPTOOLPY_FLASHMODE_QIO=y
CONFIG_ESPTOOLPY_FLASHSIZE_16MB=y
CONFIG_PARTITION_TABLE_CUSTOM=y
CONFIG_AUDIO_ANALYZER_ENABLE_EMBED_FLASH=y
CONFIG_GMF_AUDIO_CODEC_DECODER_TYPE_FLAC=y
CONFIG_GMF_AUDIO_CODEC_ENCODER_TYPE_PCM=y
CONFIG_GMF_AI_AUDIO_AEC_CH_ALLOCATION="MR"
CONFIG_COMPILER_OPTIMIZATION_SIZE=y
CONFIG_HTTPD_MAX_REQ_HDR_LEN=1024
CONFIG_HTTPD_WS_SUPPORT=y
CONFIG_SPIRAM=y
CONFIG_FATFS_LFN_HEAP=y
CONFIG_FATFS_CODEPAGE_936=y
CONFIG_FREERTOS_HZ=1000
CONFIG_FREERTOS_ENABLE_BACKWARD_COMPATIBILITY=y
CONFIG_ESP_WIFI_DYNAMIC_TX_BUFFER_NUM=64
CONFIG_LWIP_IRAM_OPTIMIZATION=y
CONFIG_SLAVE_IDF_TARGET_ESP32C6=y
CONFIG_WIFI_RMT_EXTRA_IRAM_OPT=n
CONFIG_WIFI_RMT_SLP_IRAM_OPT=n
```

## adf_examples/checks/esp_audio_analyzer_app/sdkconfig.defaults.esp32s3
```kconfig
CONFIG_IDF_TARGET="esp32s3"
CONFIG_ESPTOOLPY_FLASHMODE_QIO=y
CONFIG_ESPTOOLPY_FLASHSIZE_4MB=y
CONFIG_PARTITION_TABLE_CUSTOM=y
CONFIG_AUDIO_ANALYZER_ENABLE_EMBED_FLASH=y
CONFIG_GMF_AI_AUDIO_INIT_AFE=y
CONFIG_GMF_AI_AUDIO_AFE_CH_ALLOCATION="MRMN"
CONFIG_GMF_AI_AUDIO_AFE_VAD_ENABLE=n
CONFIG_COMPILER_OPTIMIZATION_SIZE=y
CONFIG_HTTPD_MAX_REQ_HDR_LEN=1024
CONFIG_HTTPD_WS_SUPPORT=y
CONFIG_PERIPH_CTRL_FUNC_IN_IRAM=y
CONFIG_PM_SLP_IRAM_OPT=y
CONFIG_SPIRAM=y
CONFIG_SPIRAM_MODE_OCT=y
CONFIG_SPIRAM_SPEED_80M=y
CONFIG_SPIRAM_MALLOC_ALWAYSINTERNAL=256
CONFIG_SPIRAM_ALLOW_BSS_SEG_EXTERNAL_MEMORY=y
CONFIG_SPIRAM_ALLOW_NOINIT_SEG_EXTERNAL_MEMORY=y
CONFIG_ESP_DEFAULT_CPU_FREQ_MHZ_240=y
CONFIG_ESP32S3_INSTRUCTION_CACHE_32KB=y
CONFIG_ESP32S3_DATA_CACHE_64KB=y
CONFIG_ESP32S3_DATA_CACHE_LINE_64B=y
CONFIG_ESP_WIFI_DYNAMIC_TX_BUFFER_NUM=64
CONFIG_FATFS_LFN_HEAP=y
CONFIG_FATFS_CODEPAGE_936=y
CONFIG_FATFS_FS_LOCK=7
CONFIG_FREERTOS_HZ=1000
CONFIG_FREERTOS_ENABLE_BACKWARD_COMPATIBILITY=y
CONFIG_LWIP_IRAM_OPTIMIZATION=y
```

## adf_examples/player/music_player/sdkconfig.defaults
```kconfig
#
# Serial flasher config
#
CONFIG_ESPTOOLPY_FLASHMODE_QIO=y
CONFIG_ESPTOOLPY_FLASHFREQ_80M=y
CONFIG_ESPTOOLPY_FLASHSIZE_8MB=y

#
# Partition Table
#
CONFIG_PARTITION_TABLE_CUSTOM=y
CONFIG_PARTITION_TABLE_CUSTOM_FILENAME="partitions.csv"
CONFIG_PARTITION_TABLE_OFFSET=0xA000

#
# Compiler options
#
CONFIG_COMPILER_OPTIMIZATION_PERF=y

#
# FreeRTOS
#
CONFIG_FREERTOS_HZ=1000
CONFIG_FREERTOS_ENABLE_BACKWARD_COMPATIBILITY=y
CONFIG_FREERTOS_GENERATE_RUN_TIME_STATS=y
CONFIG_FREERTOS_VTASKLIST_INCLUDE_COREID=y

#
# ESP PSRAM
#
CONFIG_SPIRAM=y
CONFIG_SPIRAM_TRY_ALLOCATE_WIFI_LWIP=y
CONFIG_FREERTOS_TASK_CREATE_ALLOW_EXT_MEM=y
CONFIG_SPIRAM_MALLOC_ALWAYSINTERNAL=128

#
# FatFS
#
CONFIG_FATFS_LFN_HEAP=y
CONFIG_FATFS_MAX_LFN=255
CONFIG_FATFS_API_ENCODING_UTF_8=y
CONFIG_FATFS_CODEPAGE_936=y

#
# LVGL v9
#
CONFIG_LV_OS_FREERTOS=y
CONFIG_LV_USE_CLIB_MALLOC=y
CONFIG_LV_USE_CLIB_STRING=y
CONFIG_LV_USE_CLIB_SPRINTF=y
CONFIG_LV_DEF_REFR_PERIOD=15
CONFIG_LV_OBJ_STYLE_CACHE=y
CONFIG_LV_USE_DEMO_MUSIC=y
CONFIG_LV_DEMO_MUSIC_AUTO_PLAY=n
CONFIG_LV_FONT_SOURCE_HAN_SANS_SC_16_CJK=y

#
# ESP LVGL Adapter
#
CONFIG_ESP_LVGL_ADAPTER_ENABLE_FS=y
CONFIG_ESP_LVGL_ADAPTER_ENABLE_FREETYPE=y
CONFIG_LV_USE_FREETYPE=y
CONFIG_LV_FREETYPE_USE_LVGL_PORT=y
CONFIG_LV_DRAW_THREAD_STACK_SIZE=32768

#
# Audio Simple Player Filters
#
CONFIG_ESP_AUDIO_SIMPLE_PLAYER_RESAMPLE_EN=y
CONFIG_AUDIO_SIMPLE_PLAYER_RESAMPLE_DEST_RATE=48000
CONFIG_ESP_AUDIO_SIMPLE_PLAYER_CH_CVT_EN=y
CONFIG_AUDIO_SIMPLE_PLAYER_CH_CVT_DEST=2
CONFIG_ESP_AUDIO_SIMPLE_PLAYER_BIT_CVT_EN=y
CONFIG_AUDIO_SIMPLE_PLAYER_BIT_CVT_DEST_16BIT=y
```

## adf_examples/player/music_player/sdkconfig.defaults.esp32p4
```kconfig
#
# ESP32-P4 target defaults
#
CONFIG_ESP32P4_SELECTS_REV_LESS_V3=n
CONFIG_ESP32P4_REV_MIN_301=y
CONFIG_CACHE_L2_CACHE_LINE_128B=y
CONFIG_IDF_EXPERIMENTAL_FEATURES=y
CONFIG_SPIRAM_SPEED_250M=y
```

## adf_examples/player/play_music_control/main/Kconfig.projbuild
```kconfig
menu "Example Configuration"

    config EXAMPLE_WIFI_SSID
        string "WiFi SSID"
        default "SSID"
        help
            SSID (network name) for the example to connect to.

    config EXAMPLE_WIFI_PASSWORD
        string "WiFi Password"
        default "PASSWORD"
        help
            WiFi password (WPA or WPA2) for the example to use.

endmenu
```

## adf_examples/player/play_music_control/sdkconfig.defaults
```kconfig
#
# Serial flasher config
#
CONFIG_ESPTOOLPY_FLASHSIZE_4MB=y
CONFIG_ESPTOOLPY_FLASHFREQ_80M=y

#
# Partition Table
#
CONFIG_PARTITION_TABLE_CUSTOM=y
CONFIG_PARTITION_TABLE_CUSTOM_FILENAME="partitions.csv"
CONFIG_PARTITION_TABLE_OFFSET=0xA000

CONFIG_COMPILER_OPTIMIZATION_PERF=y
CONFIG_FREERTOS_HZ=1000
CONFIG_FREERTOS_VTASKLIST_INCLUDE_COREID=y
CONFIG_FREERTOS_GENERATE_RUN_TIME_STATS=y
CONFIG_CODEC_I2C_BACKWARD_COMPATIBLE=n
CONFIG_SPIRAM_ALLOW_BSS_SEG_EXTERNAL_MEMORY=y

#
# SPI RAM config
#
CONFIG_SPIRAM=y
CONFIG_SPIRAM_SPEED_80M=y
CONFIG_SPIRAM_TRY_ALLOCATE_WIFI_LWIP=y
CONFIG_SPIRAM_ALLOW_STACK_EXTERNAL_MEMORY=y
CONFIG_SPIRAM_MALLOC_ALWAYSINTERNAL=1024
CONFIG_SPIRAM_TYPE_AUTO=y

#
# FAT Filesystem support
#
CONFIG_FATFS_VFS_FSTAT_BLKSIZE=4096
CONFIG_FATFS_LFN_HEAP=y
CONFIG_FATFS_API_ENCODING_UTF_8=y

#
# LittleFS
#
CONFIG_LITTLEFS_CACHE_SIZE=4096

#
# GMF IO Reader
#
CONFIG_GMF_IO_INIT_FILE_READER=y
CONFIG_GMF_IO_FILE_READ_CACHE_SIZE=4096
CONFIG_GMF_IO_INIT_HTTP_READER=y
CONFIG_GMF_IO_HTTP_READER_OUT_BUF_SIZE=8192
CONFIG_GMF_IO_INIT_FLASH_READER=n
CONFIG_ESP_AUDIO_SIMPLE_PLAYER_EMBED_FLASH_EN=n
CONFIG_GMF_IO_INIT_CODEC_DEV_RX=n

#
# GMF IO Writer
#
CONFIG_GMF_IO_INIT_CODEC_DEV_TX=y
CONFIG_GMF_IO_INIT_FILE_WRITER=n
CONFIG_GMF_IO_INIT_HTTP_WRITER=n

#
# GMF Audio Codec
#
CONFIG_GMF_AUDIO_CODEC_INIT_DECODER=y
CONFIG_GMF_AUDIO_CODEC_INIT_ENCODER=n
CONFIG_GMF_AUDIO_CODEC_DECODER_TYPE_AAC=y

CONFIG_ESP_CONSOLE_UART=y
CONFIG_ESP_CONSOLE_UART_BAUDRATE=2000000

#
# Audio Simple Player Filters
#
CONFIG_ESP_AUDIO_SIMPLE_PLAYER_RESAMPLE_EN=y
CONFIG_AUDIO_SIMPLE_PLAYER_RESAMPLE_DEST_RATE=48000
CONFIG_ESP_AUDIO_SIMPLE_PLAYER_CH_CVT_EN=y
CONFIG_AUDIO_SIMPLE_PLAYER_CH_CVT_DEST=2
CONFIG_ESP_AUDIO_SIMPLE_PLAYER_BIT_CVT_EN=y
CONFIG_AUDIO_SIMPLE_PLAYER_BIT_CVT_DEST_16BIT=y

#
# ESP-TLS
#
CONFIG_ESP_TLS_INSECURE=y
CONFIG_ESP_TLS_SKIP_SERVER_CERT_VERIFY=y

#
# Wi-Fi
#
CONFIG_ESP_WIFI_STATIC_RX_BUFFER_NUM=16
CONFIG_ESP_WIFI_DYNAMIC_RX_BUFFER_NUM=64
CONFIG_ESP_WIFI_STATIC_TX_BUFFER=y
CONFIG_ESP_WIFI_STATIC_TX_BUFFER_NUM=6
CONFIG_ESP_WIFI_CACHE_TX_BUFFER_NUM=32
CONFIG_ESP_WIFI_AMPDU_TX_ENABLED=y
CONFIG_ESP_WIFI_TX_BA_WIN=6
CONFIG_ESP_WIFI_AMPDU_RX_ENABLED=y
CONFIG_ESP_WIFI_RX_BA_WIN=16

#
# TCP
#
CONFIG_LWIP_TCP_WND_DEFAULT=32768
CONFIG_LWIP_TCP_RECVMBOX_SIZE=32
```

## adf_examples/player/play_music_control/sdkconfig.defaults.esp32
```kconfig
CONFIG_IDF_CMAKE=y
CONFIG_IDF_TARGET_ARCH_XTENSA=y
CONFIG_IDF_TARGET="esp32"
CONFIG_IDF_TARGET_ESP32=y
CONFIG_IDF_FIRMWARE_CHIP_ID=0x0000

CONFIG_ESP_DEFAULT_CPU_FREQ_MHZ_240=y
```

## adf_examples/player/play_music_control/sdkconfig.defaults.esp32p4
```kconfig
#
# SPI RAM config
#
CONFIG_IDF_EXPERIMENTAL_FEATURES=y
CONFIG_SPIRAM_SPEED_250M=y
CONFIG_ESP32P4_SELECTS_REV_LESS_V3=n
CONFIG_ESP32P4_REV_MIN_301=y
CONFIG_ESP_CONSOLE_USB_SERIAL_JTAG=y

#
# Wi-Fi Remote
#
CONFIG_SLAVE_IDF_TARGET_ESP32C6=y
CONFIG_ESP_WIFI_REMOTE_LIBRARY_HOSTED=y
CONFIG_ESP_HOSTED_CLI_ENABLED=n

#
# Wi-Fi configuration
#
CONFIG_WIFI_RMT_STATIC_RX_BUFFER_NUM=16
CONFIG_WIFI_RMT_DYNAMIC_RX_BUFFER_NUM=64
CONFIG_WIFI_RMT_STATIC_TX_BUFFER_NUM=10
CONFIG_WIFI_RMT_CACHE_TX_BUFFER_NUM=16
CONFIG_WIFI_RMT_AMPDU_TX_ENABLED=y
CONFIG_WIFI_RMT_TX_BA_WIN=6
CONFIG_WIFI_RMT_AMPDU_RX_ENABLED=y
CONFIG_WIFI_RMT_RX_BA_WIN=32
CONFIG_WIFI_RMT_IRAM_OPT=y
CONFIG_WIFI_RMT_RX_IRAM_OPT=y
CONFIG_WIFI_RMT_EXTRA_IRAM_OPT=n
CONFIG_WIFI_RMT_SLP_IRAM_OPT=n
```
