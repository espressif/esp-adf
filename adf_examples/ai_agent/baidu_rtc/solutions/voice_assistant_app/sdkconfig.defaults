## adf_examples/recorder/av_record_live_display/sdkconfig.defaults
```kconfig
#
# Serial flasher config
#
CONFIG_ESPTOOLPY_FLASHMODE_QIO=y
CONFIG_ESPTOOLPY_FLASHFREQ_80M=y
CONFIG_ESPTOOLPY_FLASHSIZE_4MB=y

#
# Partition Table
#
CONFIG_PARTITION_TABLE_CUSTOM=y
CONFIG_PARTITION_TABLE_CUSTOM_FILENAME="partitions.csv"
CONFIG_PARTITION_TABLE_OFFSET=0xA000

#
# Compiler options
#
CONFIG_COMPILER_OPTIMIZATION_PERF=y

#
# FreeRTOS
#
CONFIG_FREERTOS_HZ=1000
CONFIG_FREERTOS_ENABLE_BACKWARD_COMPATIBILITY=y
CONFIG_FREERTOS_USE_TRACE_FACILITY=y
CONFIG_FREERTOS_VTASKLIST_INCLUDE_COREID=y
CONFIG_FREERTOS_GENERATE_RUN_TIME_STATS=y

#
# ESP PSRAM
#
CONFIG_SPIRAM=y
CONFIG_FREERTOS_TASK_CREATE_ALLOW_EXT_MEM=y
CONFIG_SPIRAM_MALLOC_ALWAYSINTERNAL=128
CONFIG_SPIRAM_TRY_ALLOCATE_WIFI_LWIP=y

#
# FatFS
#
CONFIG_FATFS_LFN_HEAP=y
CONFIG_FATFS_VFS_FSTAT_BLKSIZE=0

#
# ESP Watchdog
#
CONFIG_ESP_TASK_WDT_EN=y
CONFIG_ESP_TASK_WDT_TIMEOUT_S=30

#
# Experimental features
#
CONFIG_IDF_EXPERIMENTAL_FEATURES=y

CONFIG_ESP_CONSOLE_UART_BAUDRATE=1000000
```

## adf_examples/recorder/av_record_live_display/sdkconfig.defaults.esp32p4
```kconfig
#
# ESP System Settings
#
CONFIG_ESP32P4_SELECTS_REV_LESS_V3=n
CONFIG_CACHE_L2_CACHE_LINE_128B=y
CONFIG_ESP32P4_REV_MIN_301=y

#
# PSRAM config
#
CONFIG_IDF_EXPERIMENTAL_FEATURES=y
CONFIG_SPIRAM_SPEED_250M=y

EXAMPLE_CONNECT_ETHERNET=n

#
# Camera Sensor Configuration
#
CONFIG_CAMERA_SC2336=y
CONFIG_CAMERA_SC2336_MIPI_RAW8_1024X600_30FPS=y
CONFIG_CAMERA_SC2336_MIPI_DEFAULT_FMT_RAW8_1024X600_30FPS=y
CONFIG_CAMERA_SC2336_MIPI_RAW8_1280X720_30FPS=n
CONFIG_ESP_VIDEO_ENABLE_ISP_PIPELINE_CONTROLLER=y
```

## adf_examples/recorder/av_record_live_display/sdkconfig.defaults.esp32s3
```kconfig
#
# ESP System Settings
#
CONFIG_ESP_DEFAULT_CPU_FREQ_MHZ_240=y
CONFIG_ESP32S3_DATA_CACHE_LINE_64B=y
CONFIG_ESP32S3_DATA_CACHE_64KB=y

#
# FLASH and PSRAM config
#
CONFIG_ESP32S3_SPIRAM_SUPPORT=y
CONFIG_SPIRAM_MODE_OCT=y
CONFIG_SPIRAM_SPEED_120M=y
CONFIG_SPIRAM_TIMING_TUNING_POINT_VIA_TEMPERATURE_SENSOR=y
CONFIG_SPIRAM_TIMING_MEASURE_TEMPERATURE_INTERVAL_SECOND=5
CONFIG_IDF_EXPERIMENTAL_FEATURES=y
CONFIG_BOOTLOADER_FLASH_DC_AWARE=y
CONFIG_ESPTOOLPY_FLASHMODE_QIO=y
CONFIG_ESPTOOLPY_FLASHFREQ_120M=y
CONFIG_SPI_FLASH_HPM_ENA=y

#
# Select and Set Camera Sensor
#
CONFIG_CAMERA_OV3660=y
CONFIG_CAMERA_OV3660_DVP_RGB565_BE_640X480_10FPS=y
CONFIG_CAMERA_OV3660_DVP_DEFAULT_FMT_RGB565_BE_640X480_10FPS=y
CONFIG_CAMERA_SC030IOT=n
```

## adf_examples/services_hub/main/Kconfig.projbuild
```kconfig
menu "Services Hub Example"

    config PROD_WIFI_SSID
        string "WiFi SSID"
        default "my_ssid"
        help
            Wi-Fi SSID the example connects to on boot. Leave empty to skip
            Wi-Fi start-up (the OTA service will also be idle in that case).
            Set this per-developer via `idf.py menuconfig`; do not commit
            concrete credentials to sdkconfig.defaults or Kconfig.

    config PROD_WIFI_PASSWORD
        string "WiFi Password"
        default "my_password"
        help
            Password for PROD_WIFI_SSID. Empty string means open network.
            Set this per-developer via `idf.py menuconfig`; do not commit
            concrete credentials to sdkconfig.defaults or Kconfig.

    config PROD_OTA_HTTP_HOST
        string "OTA HTTP host (IP or hostname)"
        default "0.0.0.0"
        help
            Host portion of the OTA firmware URL. Override with the IP or
            hostname printed by components/esp_ota_service/tools/ota_http_serve.py
            at startup. The default 0.0.0.0 is a placeholder; OTA check will
            fail until you set a reachable host via `idf.py menuconfig`.

    config PROD_OTA_HTTP_PORT
        int "OTA HTTP port"
        default 18070
        range 1 65535
        help
            TCP port ota_http_serve.py listens on. Matches its --port flag
            (default 18070).

    config PROD_OTA_HTTP_PATH
        string "OTA HTTP path"
        default "/firmware.bin"
        help
            URL path served by ota_http_serve.py. Default /firmware.bin
            matches the script's built-in handler; change only if you front
            the server with a reverse proxy that remaps the path.

    config PROD_OTA_TIMEOUT_MS
        int "OTA upgrade timeout (ms)"
        default 120000
        range 1000 600000
        help
            Upper bound app_main waits for the OTA upgrade to finish before
            treating it as a timeout. Raise this on slow networks (e.g. large
            RTT to the host) or when other tasks compete for CPU/flash.

endmenu
```

## adf_examples/services_hub/sdkconfig.defaults
```kconfig
# Flash/partition layout for OTA app target
CONFIG_ESPTOOLPY_FLASHSIZE_8MB=y
CONFIG_PARTITION_TABLE_CUSTOM=y
CONFIG_PARTITION_TABLE_CUSTOM_FILENAME="partitions.csv"

# esp_service: enable MCP tool schema/invoke for Wi-Fi/OTA services
CONFIG_ESP_MCP_ENABLE=y
CONFIG_ESP_MCP_TRANSPORT_HTTP=n
CONFIG_ESP_MCP_TRANSPORT_SSE=n
CONFIG_ESP_MCP_TRANSPORT_UART=n
CONFIG_ESP_MCP_TRANSPORT_STDIO=y

# CLI service (event_pub + aliases + tasks command)
CONFIG_FREERTOS_USE_TRACE_FACILITY=y
CONFIG_FREERTOS_USE_STATS_FORMATTING_FUNCTIONS=y

# OTA behavior
CONFIG_OTA_ENABLE_ROLLBACK=y
CONFIG_BOOTLOADER_APP_ROLLBACK_ENABLE=y
CONFIG_OTA_FORCE_VERSION_CHECK=n

# Misc runtime
CONFIG_FREERTOS_ENABLE_BACKWARD_COMPATIBILITY=y

# Wi-Fi IDF events run on sys_evt and fan out through adf_event_hub (callback
# subscribers are invoked synchronously). Default 2304 B overflows on our
# publish path (logs + calloc + downstream handlers).
CONFIG_ESP_SYSTEM_EVENT_TASK_STACK_SIZE=8192
```

## adf_examples/system/audio_power_save/main/Kconfig.projbuild
```kconfig
menu "Example Configuration"

    menu "Wi-Fi Configuration"

        config EXAMPLE_WIFI_SSID
            string "WiFi SSID"
            default "WIFI_SSID"
            help
                SSID (network name) for the example to connect to.

        config EXAMPLE_WIFI_PASSWORD
            string "WiFi Password"
            default "WIFI_PWD"
            help
                WiFi password (WPA or WPA2) for the example to use.

    endmenu

    menu "MQTT Configuration"

        config EXAMPLE_MQTT_BROKER_URI
            string "MQTT broker URI"
            default "mqtt://broker.emqx.io"
            help
                MQTT broker URI used for keepalive and remote wakeup demonstration.

        config EXAMPLE_MQTT_WAKE_TOPIC
            string "MQTT wakeup topic"
            default "/gmf/audio_power_save/wakeup"
            help
                Messages received on this topic are treated as MQTT wakeup events.

        config EXAMPLE_MQTT_STATUS_TOPIC
            string "MQTT status topic"
            default "/gmf/audio_power_save/status"
            help
                Topic used by this example to publish status messages.

        config EXAMPLE_MQTT_KEEPALIVE
            int "MQTT keepalive interval in seconds"
            default 30
            range 10 120
            help
                MQTT keepalive interval used by the client after Wi-Fi is connected.

    endmenu

    menu "Power Management Configuration"

        config EXAMPLE_MAX_CPU_FREQ_MHZ
            int "Maximum CPU frequency in MHz"
            default 240
            range 80 240
            help
                Maximum CPU frequency used by power management.

        config EXAMPLE_MIN_CPU_FREQ_MHZ
            int "Minimum CPU frequency in MHz"
            default 40
            range 40 80
            help
                Minimum CPU frequency used by power management.
                Keep this value less than or equal to the maximum CPU frequency.

    endmenu

    menu "Wakeup Source Configuration"

        config EXAMPLE_TIMER_WAKEUP_MS
            int "Timer wakeup delay in milliseconds"
            default 30000 if EXAMPLE_ENABLE_PROMPT_PLAYBACK
            default 120000 if !EXAMPLE_ENABLE_PROMPT_PLAYBACK
            range 1000 120000
            help
                Timer wakeup delay used as the fallback wakeup source.

        config EXAMPLE_WAKEUP_WAIT_MS
            int "Maximum wakeup wait time in milliseconds"
            default 70000 if EXAMPLE_ENABLE_PROMPT_PLAYBACK
            default 130000 if !EXAMPLE_ENABLE_PROMPT_PLAYBACK
            range 2000 180000
            help
                Maximum time to wait for any enabled wakeup source.

        config EXAMPLE_ENABLE_GPIO_WAKEUP
            bool "Enable GPIO wakeup source"
            default y
            help
                Enable GPIO level wakeup during idle low-power wait.

        if EXAMPLE_ENABLE_GPIO_WAKEUP

            config EXAMPLE_GPIO_WAKEUP_NUM
                int "GPIO wakeup number"
                default 0
                range 0 48
                help
                    GPIO number used as the GPIO wakeup source.
                    The default GPIO0 is usually connected to the BOOT button.
                    Keep it inactive while wakeup sources are being configured,
                    or select another input-capable GPIO.

            choice EXAMPLE_GPIO_WAKEUP_LEVEL
                prompt "GPIO wakeup active level"
                default EXAMPLE_GPIO_WAKEUP_LEVEL_LOW
                help
                    Select the active level for GPIO wakeup.

                config EXAMPLE_GPIO_WAKEUP_LEVEL_LOW
                    bool "Low level"

                config EXAMPLE_GPIO_WAKEUP_LEVEL_HIGH
                    bool "High level"

            endchoice

        endif

        config EXAMPLE_ENABLE_UART_WAKEUP
            bool "Enable UART wakeup source"
            default y
            help
                Enable console UART wakeup during idle low-power wait.

    endmenu

    config EXAMPLE_ENABLE_PROMPT_PLAYBACK
    bool "Enable prompt tone playback"
    default y
    help
        Play MP3 prompts from LittleFS before sleep and after wakeup.
        Disable to skip audio codec and simple player initialization
        for low-power and wakeup testing without a speaker.

endmenu
```

## adf_examples/system/audio_power_save/sdkconfig.defaults
```kconfig
#
# Serial flasher config
#
CONFIG_ESPTOOLPY_FLASHSIZE_4MB=y
CONFIG_ESPTOOLPY_FLASHFREQ_80M=y

#
# Partition Table
#
CONFIG_PARTITION_TABLE_CUSTOM=y
CONFIG_PARTITION_TABLE_CUSTOM_FILENAME="partitions.csv"
CONFIG_PARTITION_TABLE_OFFSET=0xA000

#
# Compiler options
#
CONFIG_COMPILER_OPTIMIZATION_PERF=y

#
# PHY
#
CONFIG_ESP_PHY_MAC_BB_PD=y
CONFIG_ESP_PHY_ENABLE_USB=y

#
# RTC Clock Config
#
CONFIG_RTC_CLK_SRC_EXT_CRYS=y

#
# FreeRTOS and power management
#
CONFIG_FREERTOS_HZ=1000
CONFIG_FREERTOS_USE_TICKLESS_IDLE=y
CONFIG_FREERTOS_IDLE_TIME_BEFORE_SLEEP=3
CONFIG_PM_ENABLE=y
CONFIG_PM_SLP_IRAM_OPT=y
CONFIG_PM_RTOS_IDLE_OPT=y
CONFIG_PM_SLP_DISABLE_GPIO=y
CONFIG_PM_POWER_DOWN_CPU_IN_LIGHT_SLEEP=y
CONFIG_PM_RESTORE_CACHE_TAGMEM_AFTER_LIGHT_SLEEP=y

#
# Wi-Fi
#
CONFIG_ESP_WIFI_SLP_IRAM_OPT=y
CONFIG_ESP_WIFI_IRAM_OPT=n
CONFIG_ESP_WIFI_RX_IRAM_OPT=n
CONFIG_ESP_WIFI_SLP_DEFAULT_MIN_ACTIVE_TIME=12
CONFIG_ESP_WIFI_SLP_DEFAULT_MAX_ACTIVE_TIME=60
CONFIG_ESP_WIFI_STA_DISCONNECTED_PM_ENABLE=y
CONFIG_ESP_WIFI_SOFTAP_SUPPORT=n
CONFIG_ESP_WIFI_SLP_BEACON_LOST_OPT=y
CONFIG_ESP_WIFI_SLP_BEACON_LOST_TIMEOUT=12
CONFIG_ESP_WIFI_SLP_BEACON_LOST_THRESHOLD=5
CONFIG_ESP_WIFI_SLP_PHY_ON_DELTA_EARLY_TIME=2
CONFIG_ESP_WIFI_SLP_PHY_OFF_DELTA_TIMEOUT_TIME=1

#
# LWIP
#
CONFIG_LWIP_IP6_FRAG=n
CONFIG_LWIP_ESP_GRATUITOUS_ARP=n
CONFIG_LWIP_DHCPS=n
CONFIG_LWIP_IPV6=n
CONFIG_LWIP_DHCP_COARSE_TIMER_SECS=10
CONFIG_LWIP_TCP_MSL=60000
CONFIG_LWIP_TCP_FIN_WAIT_TIMEOUT=20000

#
# ESP PSRAM
#
CONFIG_SPIRAM=y
CONFIG_SPIRAM_SPEED_80M=y
CONFIG_FREERTOS_TASK_CREATE_ALLOW_EXT_MEM=y
CONFIG_SPIRAM_MALLOC_ALWAYSINTERNAL=1024

#
# ESP Audio Simple Player
#
CONFIG_ESP_AUDIO_SIMPLE_PLAYER_HTTP_EN=n
CONFIG_ESP_AUDIO_SIMPLE_PLAYER_FILE_EN=y
CONFIG_ESP_AUDIO_SIMPLE_PLAYER_EMBED_FLASH_EN=n
CONFIG_ESP_AUDIO_SIMPLE_PLAYER_RESAMPLE_EN=y
CONFIG_AUDIO_SIMPLE_PLAYER_RESAMPLE_DEST_RATE=16000
CONFIG_ESP_AUDIO_SIMPLE_PLAYER_CH_CVT_EN=y
CONFIG_AUDIO_SIMPLE_PLAYER_CH_CVT_DEST=2
CONFIG_ESP_AUDIO_SIMPLE_PLAYER_BIT_CVT_EN=y
CONFIG_AUDIO_SIMPLE_PLAYER_BIT_CVT_DEST_16BIT=y
```

## adf_examples/system/audio_power_save/sdkconfig.defaults.esp32s3
```kconfig
#
# ESP32S3-Specific
#
CONFIG_ESP_DEFAULT_CPU_FREQ_MHZ_240=y
CONFIG_SPIRAM_MODE_OCT=y
```

## ai-examples/cli/sdkconfig.defaults
```kconfig
# Override some defaults so BT stack is enabled and
# Classic BT is enabled and BT_DRAM_RELEASE is disabled
CONFIG_FREERTOS_USE_TRACE_FACILITY=y
CONFIG_FREERTOS_USE_STATS_FORMATTING_FUNCTIONS=y
CONFIG_FREERTOS_GENERATE_RUN_TIME_STATS=y
CONFIG_FREERTOS_RUN_TIME_STATS_USING_ESP_TIMER=y
CONFIG_FREERTOS_RUN_TIME_STATS_USING_CPU_CLK=
```

## ai-examples/cloud_services/pipeline_aws_polly_mp3/main/Kconfig.projbuild
```kconfig
menu "Example Configuration"

config WIFI_SSID
    string "WiFi SSID"
	default "myssid"
	help
		SSID (network name) for the example to connect to.

config WIFI_PASSWORD
    string "WiFi Password"
	default "mypassword"
	help
		WiFi password (WPA or WPA2) for the example to use.

		Can be left blank if the network has no security set.

config AWS_ACCESS_KEY
    string "Amazon service access key ID"
    default ""
    help
        Amazon service Access key ID


config AWS_SECRET_KEY
    string "Amazon service access secret"
    default ""
    help
        Amazon service Access secret

config AWS_POLLY_REGION
    string "Amazon service region"
    default "us-east-1"
    help
        Amazon service region

endmenu
```

## ai-examples/cloud_services/pipeline_baidu_speech_mp3/main/Kconfig.projbuild
```kconfig
menu "Example Configuration"

config WIFI_SSID
    string "WiFi SSID"
	default "myssid"
	help
		SSID (network name) for the example to connect to.

config WIFI_PASSWORD
    string "WiFi Password"
	default "mypassword"
	help
		WiFi password (WPA or WPA2) for the example to use.

		Can be left blank if the network has no security set.

config BAIDU_ACCESS_KEY
    string "Baidu speech access key ID"
    default ""
    help
        Baidu speech Access key ID


config BAIDU_SECRET_KEY
    string "Baidu speech access secret"
    default ""
    help
        Baidu speech Access secret

endmenu
```
