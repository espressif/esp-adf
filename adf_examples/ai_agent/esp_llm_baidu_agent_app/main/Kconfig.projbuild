## adf_examples/ai_agent/esp_llm_volc_agent_app/main/Kconfig.projbuild
```kconfig
menu "Volc LLM agent application"

    config VOLC_IOT_INSTANCE_ID
        string "Volc IoT instance ID"
        default ""

    config VOLC_IOT_PRODUCT_KEY
        string "Volc IoT product key"
        default ""

    config VOLC_IOT_PRODUCT_SECRET
        string "Volc IoT product secret"
        default ""

    config VOLC_IOT_DEVICE_NAME
        string "Volc IoT device name"
        default ""

    config VOLC_BOT_ID
        string "Volc bot ID"
        default ""

    menu "Audio front-end features"

        config VOLC_AUDIO_VAD
            bool "Enable voice activity detection"
            default y

        config VOLC_AUDIO_WN
            bool "Enable WakeNet wake-up"
            default n
            help
                Enable local wake-word detection. When wake-up is enabled, the
                current response is cancelled. Audio uplink stays closed until
                the wake word.

    endmenu

    config VOLC_OUTPUT_VOLUME
        int "Audio output volume"
        default 80
        range 0 100

    menu "Wi-Fi"

        config VOLC_WIFI_SSID
            string "Wi-Fi SSID"
            default "myssid"

        config VOLC_WIFI_PASSWORD
            string "Wi-Fi password"
            default "mypasswd"

        config VOLC_WIFI_CONNECT_TIMEOUT_MS
            int "Wi-Fi connection timeout (ms)"
            default 30000
            range 5000 120000

    endmenu

    config VOLC_RUN_TIME_SEC
        int "Run time before clean shutdown (seconds, 0 runs forever)"
        default 0
        range 0 86400
        help
            Set a non-zero value to exercise the complete reverse stop,
            unlink, and destroy path after the specified duration.

endmenu
```

## adf_examples/ai_agent/esp_llm_volc_agent_app/sdkconfig.defaults
```kconfig
#
# Common defaults. Chip-specific flash and PSRAM options live in
# sdkconfig.defaults.esp32s3 / esp32s31 / esp32p4.
# The target is set by `idf.py set-target`, not pinned here.
#

#
# Serial flasher config
#
CONFIG_ESPTOOLPY_FLASHMODE_QIO=y

#
# Partition Table
#
CONFIG_PARTITION_TABLE_CUSTOM=y
CONFIG_PARTITION_TABLE_OFFSET=0xA000
# CONFIG_ESP_BOARD_* comes from components/gen_bmgr_codes/board_manager.defaults,
# which esp_board_manager regenerates for the selected board. Pinning those here
# would force the esp32s3 board's peripherals onto every other target.

#
# Compiler options
#
CONFIG_COMPILER_DISABLE_DEFAULT_ERRORS=y

#
# ESP PSRAM
#
CONFIG_SPIRAM=y
CONFIG_SPIRAM_MALLOC_ALWAYSINTERNAL=0
CONFIG_SPIRAM_ALLOW_STACK_EXTERNAL_MEMORY=y

#
# ESP System
#
CONFIG_ESP_MAIN_TASK_STACK_SIZE=20480
CONFIG_ESP_TASK_WDT_INIT=n

#
# Audio codec
#
CONFIG_CODEC_ES7243_SUPPORT=n
CONFIG_CODEC_ES7243E_SUPPORT=n
CONFIG_CODEC_ES8156_SUPPORT=n
CONFIG_CODEC_AW88298_SUPPORT=n
CONFIG_CODEC_ES8389_SUPPORT=n
CONFIG_CODEC_ES8388_SUPPORT=n
CONFIG_CODEC_TAS5805M_SUPPORT=n
CONFIG_CODEC_CJC8910_SUPPORT=n

#
# Capture
#
CONFIG_ESP_CAPTURE_ENABLE_AUDIO=y
CONFIG_ESP_AUDIO_CAPTURE_SERVICE_AI_SRC_ENABLED=y
CONFIG_ESP_AUDIO_CAPTURE_SERVICE_AI_SRC_AFE_SUPPORT=y
CONFIG_ESP_AUDIO_CAPTURE_SERVICE_AI_SRC_AEC_SUPPORT=y
CONFIG_ESP_AUDIO_CAPTURE_SERVICE_AI_SRC_VAD_SUPPORT=y
CONFIG_ESP_AUDIO_CAPTURE_SERVICE_AI_SRC_WN_SUPPORT=y

#
# Player
#
CONFIG_ESP_PLAYER_ENABLE_AUDIO=y
CONFIG_ESP_PLAYER_ENABLE_HLS_IO=n
CONFIG_AUDIO_ENCODER_OPUS_SUPPORT=y
CONFIG_AUDIO_DECODER_OPUS_SUPPORT=y
CONFIG_AUDIO_ENCODER_G711_SUPPORT=y
CONFIG_AUDIO_DECODER_G711_SUPPORT=y
CONFIG_AUDIO_ENCODER_PCM_SUPPORT=y
CONFIG_AUDIO_DECODER_PCM_SUPPORT=y
CONFIG_AUDIO_SIMPLE_DEC_WAV_SUPPORT=y

#
# Volc
#
CONFIG_ESP_LLM_VOLC_AUDIO_CODEC_G711A=y
CONFIG_VOLC_RTC_MODE=y
CONFIG_VOLC_WIFI_SSID="myssid"
CONFIG_VOLC_WIFI_PASSWORD="mypasswd"

#
# TLS
#
CONFIG_ESP_TLS_INSECURE=y
CONFIG_ESP_TLS_SKIP_SERVER_CERT_VERIFY=y

#
# LWIP
#
CONFIG_LWIP_TCP_SND_BUF_DEFAULT=65535
CONFIG_LWIP_TCP_WND_DEFAULT=65535
CONFIG_LWIP_MAX_UDP_PCBS=256
CONFIG_LWIP_UDP_RECVMBOX_SIZE=32
CONFIG_LWIP_SNTP_MAX_SERVERS=3

#
# mbedTLS
#
CONFIG_MBEDTLS_SSL_IN_CONTENT_LEN=16384
CONFIG_MBEDTLS_EXTERNAL_MEM_ALLOC=y

#
# Experimental features
#
CONFIG_IDF_EXPERIMENTAL_FEATURES=y
```

## adf_examples/player/music_player/sdkconfig.defaults.esp32s3
```kconfig
#
# ESP32-S3 target defaults
#
CONFIG_ESP_DEFAULT_CPU_FREQ_MHZ_240=y
CONFIG_SPIRAM=y
CONFIG_SPIRAM_MODE_OCT=y
CONFIG_SPIRAM_SPEED_80M=y
```

## adf_examples/player/music_player/sdkconfig.defaults.esp32s31
```kconfig
#
# ESP32-S31 target defaults
#
CONFIG_SPIRAM=y
CONFIG_SPIRAM_MODE_OCT=y
CONFIG_SPIRAM_SPEED_200M=y
CONFIG_FREERTOS_TASK_CREATE_ALLOW_EXT_MEM=y
```

## adf_examples/protocols/rtmp_cli/main/Kconfig.projbuild
```kconfig
menu "RTMP CLI Example Configuration"

    config RTMP_EXAMPLE_WIFI_SSID
        string "WiFi SSID"
        default "SSID"
        help
            SSID (network name) for the example to connect to.

    config RTMP_EXAMPLE_WIFI_PASSWORD
        string "WiFi Password"
        default "PASSWORD"
        help
            WiFi password (WPA or WPA2) for the example to use.

    config RTMP_EXAMPLE_PUSH_URL
        string "Default push URL"
        default "rtmp://192.168.1.10:1935/live/stream"
        help
            Destination used by 'rtmp push' when no URL argument is given. RTMP
            client URLs carry the stream name: rtmp[s]://host:port/app/stream.

    config RTMP_EXAMPLE_PULL_URL
        string "Default pull URL"
        default "rtmp://192.168.1.10:1935/live/stream"
        help
            Source used by 'rtmp pull' when no URL argument is given.

endmenu
```

## adf_examples/protocols/rtsp_cli/main/Kconfig.projbuild
```kconfig
menu "RTSP CLI Example Configuration"

    config RTSP_EXAMPLE_WIFI_SSID
        string "WiFi SSID"
        default "SSID"
        help
            SSID (network name) for the example to connect to.

    config RTSP_EXAMPLE_WIFI_PASSWORD
        string "WiFi Password"
        default "PASSWORD"
        help
            WiFi password (WPA or WPA2) for the example to use.

    config RTSP_EXAMPLE_PUSH_URL
        string "Default push URL"
        default "rtsp://192.168.1.10:8554/live"
        help
            Destination used by 'rtsp push' when no URL argument is given. The
            remote server must accept RTSP ANNOUNCE, SETUP and RECORD.

    config RTSP_EXAMPLE_PULL_URL
        string "Default pull URL"
        default "rtsp://192.168.1.10:8554/live"
        help
            Source used by 'rtsp pull' when no URL argument is given.

endmenu
```

## adf_examples/protocols/rtsp_push/main/Kconfig.projbuild
```kconfig
menu "RTSP Push Example Configuration"

    config RTSP_PUSH_EXAMPLE_WIFI_SSID
        string "WiFi SSID"
        default "SSID"
        help
            SSID (network name) for the example to connect to.

    config RTSP_PUSH_EXAMPLE_WIFI_PASSWORD
        string "WiFi Password"
        default "PASSWORD"
        help
            WiFi password (WPA or WPA2) for the example to use.

    config RTSP_PUSH_EXAMPLE_URL
        string "RTSP push URL"
        default "rtsp://192.168.1.10:8554/live"
        help
            Destination RTSP URL. The remote server must accept ANNOUNCE,
            SETUP and RECORD.

endmenu
```

## adf_examples/protocols/rtsp_push/sdkconfig.defaults
```kconfig
#
# Serial flasher config
#
CONFIG_ESPTOOLPY_FLASHMODE_QIO=y
CONFIG_ESPTOOLPY_FLASHFREQ_80M=y

#
# Partition Table
#
CONFIG_PARTITION_TABLE_CUSTOM=y
CONFIG_PARTITION_TABLE_CUSTOM_FILENAME="partitions.csv"
CONFIG_PARTITION_TABLE_OFFSET=0xA000

#
# Compiler options
#
CONFIG_COMPILER_OPTIMIZATION_PERF=y
CONFIG_ESP_MAIN_TASK_STACK_SIZE=10240

#
# FreeRTOS
#
CONFIG_FREERTOS_HZ=1000
CONFIG_FREERTOS_TASK_CREATE_ALLOW_EXT_MEM=y

#
# ESP PSRAM
#
CONFIG_SPIRAM=y
CONFIG_SPIRAM_MALLOC_ALWAYSINTERNAL=128
CONFIG_SPIRAM_TRY_ALLOCATE_WIFI_LWIP=y

#
# ESP Watchdog
#
CONFIG_ESP_TASK_WDT_EN=y
CONFIG_ESP_TASK_WDT_TIMEOUT_S=30

#
# Experimental features
#
CONFIG_IDF_EXPERIMENTAL_FEATURES=y

#
# RTSP client push only
#
CONFIG_ESP_RTSP_SERVICE_SERVER_SUPPORT=n
CONFIG_ESP_RTSP_SERVICE_SRC_SUPPORT=n
CONFIG_ESP_RTSP_SERVICE_SINK_SUPPORT=y

#
# Capture: plain microphone and camera, no AEC/VAD front end
#
CONFIG_ESP_CAPTURE_ENABLE_AUDIO=y
CONFIG_ESP_CAPTURE_ENABLE_VIDEO=y
CONFIG_ESP_CAPTURE_ENABLE_VIDEO_DECODER=n
CONFIG_ESP_AUDIO_CAPTURE_SERVICE_AI_SRC_ENABLED=n

#
# Codecs used by this example. Unused ones default to y and must be turned off.
#
CONFIG_AUDIO_ENCODER_AAC_SUPPORT=y
CONFIG_AUDIO_ENCODER_G711_SUPPORT=n
CONFIG_AUDIO_ENCODER_PCM_SUPPORT=n
CONFIG_AUDIO_ENCODER_AMRNB_SUPPORT=n
CONFIG_AUDIO_ENCODER_AMRWB_SUPPORT=n
CONFIG_AUDIO_ENCODER_OPUS_SUPPORT=n
CONFIG_AUDIO_ENCODER_ADPCM_SUPPORT=n
CONFIG_AUDIO_ENCODER_ALAC_SUPPORT=n
CONFIG_AUDIO_ENCODER_SBC_SUPPORT=n
CONFIG_AUDIO_ENCODER_LC3_SUPPORT=n
CONFIG_AUDIO_ENCODER_G722_SUPPORT=n
CONFIG_AUDIO_DECODER_AAC_SUPPORT=n
CONFIG_AUDIO_DECODER_G711_SUPPORT=n
CONFIG_AUDIO_DECODER_PCM_SUPPORT=n
CONFIG_AUDIO_DECODER_MP3_SUPPORT=n
CONFIG_AUDIO_DECODER_AMRNB_SUPPORT=n
CONFIG_AUDIO_DECODER_AMRWB_SUPPORT=n
CONFIG_AUDIO_DECODER_FLAC_SUPPORT=n
CONFIG_AUDIO_DECODER_OPUS_SUPPORT=n
CONFIG_AUDIO_DECODER_VORBIS_SUPPORT=n
CONFIG_AUDIO_DECODER_ADPCM_SUPPORT=n
CONFIG_AUDIO_DECODER_ALAC_SUPPORT=n
CONFIG_AUDIO_DECODER_SBC_SUPPORT=n
CONFIG_AUDIO_DECODER_LC3_SUPPORT=n
CONFIG_AUDIO_DECODER_G722_SUPPORT=n
CONFIG_AUDIO_SIMPLE_DEC_WAV_SUPPORT=n
CONFIG_AUDIO_SIMPLE_DEC_M4A_SUPPORT=n
CONFIG_AUDIO_SIMPLE_DEC_TS_SUPPORT=n
CONFIG_AUDIO_SIMPLE_DEC_OGG_SUPPORT=n

#
# Push encodes MJPEG and does not play video. Encoder HW vs SW follows the chip:
# S3 has no JPEG/H264 hardware encoder; P4 keeps JPEG and H264 hardware encoders.
#
CONFIG_VIDEO_DECODER_SW_H264_SUPPORT=n
CONFIG_VIDEO_DECODER_SW_MJPEG_SUPPORT=n
CONFIG_VIDEO_DECODER_HW_MJPEG_SUPPORT=n

#
# Muxer is pulled in by capture, but unused here
#
CONFIG_ESP_MUXER_MP4_SUPPORT=n
CONFIG_ESP_MUXER_WAV_SUPPORT=n
CONFIG_ESP_MUXER_TS_SUPPORT=n
CONFIG_ESP_MUXER_OGG_SUPPORT=n
CONFIG_ESP_MUXER_FLV_SUPPORT=n
CONFIG_ESP_MUXER_CAF_SUPPORT=n
CONFIG_ESP_MUXER_AVI_SUPPORT=n
```

## adf_examples/protocols/rtsp_push/sdkconfig.defaults.esp32p4
```kconfig
#
# ESP System Settings
#
CONFIG_ESP32P4_SELECTS_REV_LESS_V3=n
CONFIG_ESP32P4_REV_MIN_301=y
CONFIG_ESP_CONSOLE_USB_SERIAL_JTAG=y

#
# Serial flasher config
#
CONFIG_ESPTOOLPY_FLASHSIZE_16MB=y

#
# ESP PSRAM
#
CONFIG_SPIRAM_MODE_HEX=y
CONFIG_SPIRAM_SPEED_200M=y

#
# Camera Sensor Configuration
#
CONFIG_CAMERA_SC2336=y
CONFIG_CAMERA_SC2336_MIPI_RAW8_1280X720_30FPS=y
CONFIG_CAMERA_SC2336_MIPI_DEFAULT_FMT_RAW8_1280X720_30FPS=y
CONFIG_ESP_VIDEO_ENABLE_ISP_PIPELINE_CONTROLLER=y

#
# Wi-Fi is provided by an esp_hosted slave on ESP32-P4
#
CONFIG_IDF_SLAVE_TARGET="esp32c6"
CONFIG_SLAVE_IDF_TARGET_ESP32C6=y
```

## adf_examples/protocols/rtsp_push/sdkconfig.defaults.esp32s31
```kconfig
#
# Serial flasher config
#
CONFIG_ESPTOOLPY_FLASHSIZE_16MB=y

#
# ESP PSRAM
#
CONFIG_SPIRAM_MODE_OCT=y
CONFIG_SPIRAM_SPEED_200M=y

#
# Camera Sensor Configuration
#
CONFIG_CAMERA_OV3660=y
CONFIG_CAMERA_OV3660_DVP_JPEG_640X480_25FPS=y
CONFIG_CAMERA_OV3660_DVP_DEFAULT_FMT_JPEG_640X480_25FPS=y
```

## adf_examples/protocols/sip_cli/main/Kconfig.projbuild
```kconfig
menu "SIP CLI Example Configuration"

    comment "Wi-Fi"

    config SIP_EXAMPLE_WIFI_SSID
        string "WiFi SSID"
        default "SSID"
        help
            SSID (network name) for the example to connect to.

    config SIP_EXAMPLE_WIFI_PASSWORD
        string "WiFi Password"
        default "PASSWORD"
        help
            WiFi password (WPA or WPA2) for the example to use.

    comment "SIP account and default peer"

    config SIP_EXAMPLE_USER
        string "SIP user"
        default "1001"
        help
            SIP user name or extension registered on the server.

    config SIP_EXAMPLE_PASSWORD
        string "SIP password"
        default ""
        help
            Password for the SIP account. Leave empty for a server that does
            not authenticate, and for P2P mode where no registrar is involved.

    config SIP_EXAMPLE_SERVER
        string "SIP server"
        default "192.168.1.10"
        help
            Registrar host name or IPv4 address. In P2P mode this is the IP
            address of the peer device instead.

    config SIP_EXAMPLE_PEER_USER
        string "Default peer"
        default "1002"
        help
            Callee used by 'sip call' when no argument is given. May be a user,
            an extension or a full SIP URI.

    comment "Advanced SIP defaults"

    choice SIP_EXAMPLE_TRANSPORT_TYPE
        bool "SIP signaling transport"
        default SIP_EXAMPLE_TRANSPORT_UDP
        help
            Transport used for SIP signaling. TLS needs a registrar that
            listens on the SIPS port and a certificate the device trusts.

        config SIP_EXAMPLE_TRANSPORT_UDP
            bool "UDP"

        config SIP_EXAMPLE_TRANSPORT_TCP
            bool "TCP"

        config SIP_EXAMPLE_TRANSPORT_TLS
            bool "TLS"

    endchoice

    config SIP_EXAMPLE_TRANSPORT
        string
        default "udp" if SIP_EXAMPLE_TRANSPORT_UDP
        default "tcp" if SIP_EXAMPLE_TRANSPORT_TCP
        default "tls" if SIP_EXAMPLE_TRANSPORT_TLS

    config SIP_EXAMPLE_SERVER_PORT
        int "SIP server port"
        default 5060
        range 1 65535
        help
            Port the registrar listens on. Use 5061 or the server-specific
            port when TLS is selected.

endmenu
```

## adf_examples/protocols/sip_cli/sdkconfig.defaults.esp32s3
```kconfig
#
# ESP System Settings
#
CONFIG_ESP_DEFAULT_CPU_FREQ_MHZ_240=y
CONFIG_ESP32S3_INSTRUCTION_CACHE_32KB=y
CONFIG_ESP32S3_DATA_CACHE_64KB=y
CONFIG_ESP32S3_DATA_CACHE_LINE_64B=y

#
# Serial flasher config
#
CONFIG_ESPTOOLPY_FLASHSIZE_16MB=y

#
# ESP PSRAM
#
CONFIG_SPIRAM_MODE_OCT=y
CONFIG_SPIRAM_SPEED_80M=y

#
# Camera Sensor Configuration
#
CONFIG_CAMERA_OV3660=y
CONFIG_CAMERA_OV3660_DVP_JPEG_320X240_25FPS=y
CONFIG_CAMERA_OV3660_DVP_DEFAULT_FMT_JPEG_320X240_25FPS=y
CONFIG_CAMERA_SC030IOT=n
```

## adf_examples/recorder/av_record_live_display/board_overlays/esp32_s31_korvo_1/sdkconfig.defaults.board
```kconfig
CONFIG_SPIRAM=y
CONFIG_SPIRAM_MODE_OCT=y
CONFIG_SPIRAM_SPEED_250M=y

#
# Camera Sensor Configuration
#
CONFIG_CAMERA_OV3660=y
CONFIG_CAMERA_OV3660_DVP_JPEG_640X480_25FPS=y
CONFIG_CAMERA_OV3660_DVP_DEFAULT_FMT_JPEG_640X480_25FPS=y

CONFIG_ESP_CAPTURE_ENABLE_VIDEO_DECODER=y
CONFIG_ESP_CAPTURE_ENABLE_VIDEO_OVERLAY=y
```
