## adf_examples/ai_agent/esp_llm_baidu_agent_app/main/Kconfig.projbuild
```kconfig
menu "Baidu LLM agent application"

    config BAIDU_APP_ID
        string "Baidu application ID"
        default ""

    config BAIDU_USER_ID
        string "Baidu user ID"
        default ""

    config BAIDU_LICENSE_KEY
        string "Baidu license key"
        default ""

    config BAIDU_SERVER_URL
        string "Baidu agent platform URL"
        default ""

    config BAIDU_WORKFLOW
        string "Baidu workflow"
        default "VoiceChat"

    config BAIDU_INSTANCE_ID
        int "Baidu instance ID"
        default 0
        range 0 2147483647
        help
            Instance ID from the Baidu agent platform. 0 means unset.

    choice BAIDU_APP_SCENE
        prompt "Agent scene"
        default BAIDU_APP_SCENE_VOICE_CHAT
        help
            Voice chat is audio only.
            Image understanding links camera JPEG to VIDEO_UP.
            Image generation links VIDEO_DN to the LCD player.
            Multi-modal enables both; the LCD shows VIDEO_DN only.

        config BAIDU_APP_SCENE_VOICE_CHAT
            bool "Voice chat (audio only)"

        config BAIDU_APP_SCENE_IMAGE_UNDERSTANDING
            bool "Image understanding (camera uplink)"
            select ESP_CAPTURE_ENABLE_VIDEO

        config BAIDU_APP_SCENE_IMAGE_GENERATION
            bool "Image generation (video downlink)"

        config BAIDU_APP_SCENE_MULTI_MODAL
            bool "Multi-modal (camera uplink and generated image)"
            select ESP_CAPTURE_ENABLE_VIDEO
    endchoice

    choice BAIDU_VISION_MODE
        prompt "Vision uplink mode"
        default BAIDU_VISION_MODE_IMAGE
        depends on BAIDU_APP_SCENE_IMAGE_UNDERSTANDING || BAIDU_APP_SCENE_MULTI_MODAL
        help
            Image: upload one JPEG when the cloud requests vision.
            Stream: send every captured frame.

        config BAIDU_VISION_MODE_IMAGE
            bool "Image (snapshot on request)"

        config BAIDU_VISION_MODE_STREAM
            bool "Stream (continuous frames)"
    endchoice

    config BAIDU_CAMERA_WIDTH
        int "Camera JPEG width"
        depends on BAIDU_APP_SCENE_IMAGE_UNDERSTANDING || BAIDU_APP_SCENE_MULTI_MODAL
        range 160 1920
        default 320
        help
            Must match an esp-video JPEG sensor mode. Independent of LCD size.

    config BAIDU_CAMERA_HEIGHT
        int "Camera JPEG height"
        depends on BAIDU_APP_SCENE_IMAGE_UNDERSTANDING || BAIDU_APP_SCENE_MULTI_MODAL
        range 120 1080
        default 240

    config BAIDU_CAMERA_FPS
        int "Camera capture FPS"
        depends on BAIDU_APP_SCENE_IMAGE_UNDERSTANDING || BAIDU_APP_SCENE_MULTI_MODAL
        range 1 30
        default 10

    menu "Audio front-end features"

        config BAIDU_AUDIO_NS
            bool "Enable WebRTC noise suppression"
            default n
            help
                Off by default. On ESP32-S31 the NS FFT can starve afe_feed
                (task watchdog) and AFE itself warns that NS reduces ASR
                accuracy. AEC and VAD stay enabled.

        config BAIDU_AUDIO_WN
            bool "Enable WakeNet wake-up"
            default n
            help
                Enable local wake-word detection. AEC and VAD are always on.
                When wake-up is enabled, the local prompt is played and the
                current response is cancelled. Audio uplink stays open.

    endmenu

    config BAIDU_OUTPUT_VOLUME
        int "Audio output volume"
        default 80
        range 0 100

    menu "Wi-Fi"

        config BAIDU_WIFI_SSID
            string "Wi-Fi SSID"
            default "myssid"

        config BAIDU_WIFI_PASSWORD
            string "Wi-Fi password"
            default "mypasswd"

        config BAIDU_WIFI_CONNECT_TIMEOUT_MS
            int "Wi-Fi connection timeout (ms)"
            default 30000
            range 5000 120000

    endmenu

    config BAIDU_RUN_TIME_SEC
        int "Run time before clean shutdown (seconds, 0 runs forever)"
        default 0
        range 0 86400
        help
            0 returns from app_main after start and leaves the agent running.
            A non-zero value waits that many seconds, then exercises the
            complete reverse stop, unlink, and destroy path.

endmenu
```

## adf_examples/ai_agent/esp_llm_baidu_agent_app/sdkconfig.defaults.esp32p4
```kconfig
CONFIG_IDF_TARGET="esp32p4"

#
# Partition / libc
#
CONFIG_PARTITION_TABLE_OFFSET=0xA000
CONFIG_LIBC_NEWLIB=y

#
# Flash / PSRAM
#
CONFIG_ESPTOOLPY_FLASHSIZE_8MB=y
CONFIG_SPIRAM_SPEED_250M=y

#
# ESP32-P4 + ESP-Hosted (C6 slave)
#
CONFIG_IDF_SLAVE_TARGET="esp32c6"
CONFIG_SLAVE_IDF_TARGET_ESP32C6=y
CONFIG_ESP_CONSOLE_UART_DEFAULT=y

#
# Debug: avoid INT WDT during heavy TLS/AFE on P4
#
CONFIG_ESP_INT_WDT_TIMEOUT_MS=1000
CONFIG_ESP_INT_WDT_CHECK_CPU1=y
CONFIG_FREERTOS_CHECK_STACKOVERFLOW_CANARY=y
CONFIG_COMPILER_STACK_CHECK_MODE_NORM=y
CONFIG_ESP_PANIC_HANDLER_IRAM=y
CONFIG_ESP_SYSTEM_PANIC_PRINT_HALT=y

#
# Camera: SC2336 MIPI CSI RAW8 1024x600 @ 30fps
#
CONFIG_CAMERA_SC2336=y
CONFIG_CAMERA_SC2336_AUTO_DETECT_MIPI_INTERFACE_SENSOR=y
CONFIG_CAMERA_SC2336_MIPI_RAW8_1024X600_30FPS=y
CONFIG_CAMERA_SC2336_MIPI_DEFAULT_FMT_RAW8_1024X600_30FPS=y
CONFIG_CAMERA_SC2336_MIPI_IF_FORMAT_INDEX_DEFAULT=11
CONFIG_CAMERA_SC2336_DIG_GAIN_PRIORITY=y
CONFIG_CAMERA_SC2336_DEFAULT_IPA_JSON_CONFIGURATION_FILE=y
CONFIG_ESP_VIDEO_ENABLE_ISP=y
CONFIG_ESP_VIDEO_ENABLE_MIPI_CSI_VIDEO_DEVICE=y
CONFIG_ESP_VIDEO_ENABLE_ISP_VIDEO_DEVICE=y
CONFIG_ESP_VIDEO_ENABLE_ISP_PIPELINE_CONTROLLER=y
```

## adf_examples/ai_agent/esp_llm_coze_agent_app/main/Kconfig.projbuild
```kconfig
menu "Coze LLM agent application"

    config COZE_BOT_ID
        string "Coze bot ID"
        default ""

    config COZE_ACCESS_TOKEN
        string "Coze access token"
        default ""

    config COZE_WS_BASE_URL
        string "Coze WebSocket URL"
        default "wss://ws.coze.cn/v1/chat"

    config COZE_CONV_CREATE_BASE_URL
        string "Coze conversation-create URL"
        default "https://api.coze.cn/v1/conversation/create"

    config COZE_USER_ID
        string "Coze user ID (empty uses adapter default)"
        default ""

    config COZE_VOICE_ID
        string "Coze voice ID"
        default ""
        help
            Leave empty to use the Coze system voice 7426720361733144585.

    menu "Audio front-end features"

        config COZE_AUDIO_VAD
            bool "Enable voice activity detection"
            default y

        config COZE_AUDIO_WN
            bool "Enable WakeNet wake-up"
            default n
            help
                Enable local wake-word detection. When wake-up is enabled, the
                current response is cancelled. Audio uplink stays closed until
                the wake word.

    endmenu

    config COZE_OUTPUT_VOLUME
        int "Audio output volume"
        default 80
        range 0 100

    menu "Wi-Fi"

        config COZE_WIFI_SSID
            string "Wi-Fi SSID"
            default "xtworks"

        config COZE_WIFI_PASSWORD
            string "Wi-Fi password"
            default "esp123456"

        config COZE_WIFI_CONNECT_TIMEOUT_MS
            int "Wi-Fi connection timeout (ms)"
            default 30000
            range 5000 120000

    endmenu

    config COZE_RUN_TIME_SEC
        int "Run time before clean shutdown (seconds, 0 runs forever)"
        default 0
        range 0 86400
        help
            Set a non-zero value to exercise the complete reverse stop,
            unlink, and destroy path after the specified duration.

endmenu
```

## adf_examples/ai_agent/esp_llm_coze_agent_app/sdkconfig.defaults.esp32p4
```kconfig
CONFIG_IDF_TARGET="esp32p4"

#
# Partition / libc
#
CONFIG_PARTITION_TABLE_OFFSET=0xA000
CONFIG_LIBC_NEWLIB=y

#
# Flash / PSRAM
#
CONFIG_ESPTOOLPY_FLASHSIZE_8MB=y
CONFIG_SPIRAM_SPEED_250M=y

#
# ESP32-P4 + ESP-Hosted (C6 slave)
#
CONFIG_IDF_SLAVE_TARGET="esp32c6"
CONFIG_SLAVE_IDF_TARGET_ESP32C6=y
CONFIG_ESP_CONSOLE_UART_DEFAULT=y

#
# Debug: avoid INT WDT during heavy TLS/AFE on P4
#
CONFIG_ESP_INT_WDT_TIMEOUT_MS=1000
CONFIG_ESP_INT_WDT_CHECK_CPU1=y
CONFIG_FREERTOS_CHECK_STACKOVERFLOW_CANARY=y
CONFIG_COMPILER_STACK_CHECK_MODE_NORM=y
CONFIG_ESP_PANIC_HANDLER_IRAM=y
CONFIG_ESP_SYSTEM_PANIC_PRINT_HALT=y
```

## adf_examples/ai_agent/esp_llm_coze_agent_app/sdkconfig.defaults.esp32s3
```kconfig
CONFIG_IDF_TARGET="esp32s3"

#
# Flash / PSRAM (120M) + XIP from PSRAM
#
CONFIG_ESPTOOLPY_FLASHMODE_QIO=y
CONFIG_ESPTOOLPY_FLASHFREQ_120M=y
CONFIG_ESPTOOLPY_FLASHSIZE_16MB=y
CONFIG_SPIRAM_MODE_OCT=y
CONFIG_SPIRAM_SPEED_120M=y
CONFIG_SPIRAM_XIP_FROM_PSRAM=y
CONFIG_SPI_FLASH_HPM_DC_ON=y
CONFIG_BOOTLOADER_FLASH_DC_AWARE=y

#
# ESP System
#
CONFIG_ESP_DEFAULT_CPU_FREQ_MHZ_240=y
CONFIG_ESP32S3_INSTRUCTION_CACHE_32KB=y
CONFIG_ESP_SYSTEM_EVENT_TASK_STACK_SIZE=3072
CONFIG_ESP_INT_WDT_TIMEOUT_MS=800
CONFIG_ESP_TASK_WDT_TIMEOUT_S=25
CONFIG_ESP_WIFI_STATIC_RX_BUFFER_NUM=6
CONFIG_ESP_WIFI_STATIC_TX_BUFFER_NUM=6
CONFIG_ESP_WIFI_RX_BA_WIN=6
CONFIG_ESP_COREDUMP_ENABLE_TO_UART=y

#
# FatFS
#
CONFIG_FATFS_LFN_HEAP=y
CONFIG_FATFS_CODEPAGE_936=y
CONFIG_FATFS_FS_LOCK=3

#
# FreeRTOS debug
#
CONFIG_FREERTOS_VTASKLIST_INCLUDE_COREID=y
CONFIG_FREERTOS_GENERATE_RUN_TIME_STATS=y
```

## adf_examples/ai_agent/esp_llm_tongyi_agent_app/main/Kconfig.projbuild
```kconfig
menu "Tongyi LLM agent application"

    config TONGYI_API_KEY
        string "DashScope API key"
        default ""
        help
            DashScope API key for Tongyi multimodal dialog.

    config TONGYI_WORKSPACE_ID
        string "Tongyi workspace ID"
        default ""
        help
            Tongyi workspace ID (llm-...).

    config TONGYI_APP_ID
        string "Tongyi application ID"
        default ""
        help
            Dialog mode needs a voice-only DashScope app. A vision app ID
            returns "images must not be empty" without a camera.

    choice TONGYI_APP_MODE
        prompt "Application mode"
        default TONGYI_APP_MODE_DIALOG
        help
            Dialog is duplex voice only.
            Vision: LCD camera preview plus a console command that captures
            one JPEG and sends it with esp_llm_service_send_frame(). Tongyi
            VIDEO_UP stays disabled; this is one-shot vision.

        config TONGYI_APP_MODE_DIALOG
            bool "Dialog (audio only)"

        config TONGYI_APP_MODE_VISION
            bool "Vision (LCD preview and console snapshot)"
            select ESP_CAPTURE_ENABLE_VIDEO
            select ESP_CAPTURE_ENABLE_VIDEO_DECODER
            help
                Requires a board with camera and LCD. Type 'snap' or
                'snap <prompt>' in the UART CLI after the agent is ready.
                JPEG camera plus RGB565 LCD preview. Snap still sends JPEG.

    endchoice

    config TONGYI_VISION_CAMERA_WIDTH
        int "Camera JPEG width"
        depends on TONGYI_APP_MODE_VISION
        range 160 1920
        default 320
        help
            JPEG capture width. It must match an esp-video JPEG sensor mode.

    config TONGYI_VISION_CAMERA_HEIGHT
        int "Camera JPEG height"
        depends on TONGYI_APP_MODE_VISION
        range 120 1080
        default 240
        help
            JPEG capture height. It must match an esp-video JPEG sensor mode.

    config TONGYI_VISION_CAMERA_FPS
        int "Camera / LCD preview FPS"
        depends on TONGYI_APP_MODE_VISION
        range 1 30
        default 15
        help
            Camera JPEG / RGB capture rate. LCD writes as fast as S3
            SW JPEG decode plus SPI flush allow (often 12-15 at 320x240).
            Do not treat this as a guaranteed LCD vsync.

    config TONGYI_VISION_PROMPT
        string "Default snapshot prompt"
        depends on TONGYI_APP_MODE_VISION
        default ""
        help
            Used when the snap command has no argument. Empty sends an
            UpdateInfo image only. Non-empty sends RequestToRespond.

    choice TONGYI_DIALOG_MODE
        prompt "Dialog mode"
        default TONGYI_DIALOG_MODE_DIRECT

        config TONGYI_DIALOG_MODE_DIRECT
            bool "Direct conversation (no wake word)"

        config TONGYI_DIALOG_MODE_WAKEUP
            bool "Wake word then conversation"

    endchoice

    menu "Audio front-end features"

        config TONGYI_AUDIO_VAD
            bool "Enable voice activity detection"
            default y

    endmenu

    config TONGYI_OUTPUT_VOLUME
        int "Audio output volume"
        default 80
        range 0 100

    menu "Wi-Fi"

        config TONGYI_WIFI_SSID
            string "Wi-Fi SSID"
            default "myssid"

        config TONGYI_WIFI_PASSWORD
            string "Wi-Fi password"
            default "mypasswd"

        config TONGYI_WIFI_CONNECT_TIMEOUT_MS
            int "Wi-Fi connection timeout (ms)"
            default 30000
            range 5000 120000

    endmenu

    config TONGYI_RUN_TIME_SEC
        int "Run time before clean shutdown (seconds, 0 runs forever)"
        default 0
        range 0 86400
        help
            Set a non-zero value to exercise the complete reverse stop,
            unlink, and destroy path after the specified duration.

endmenu
```

## adf_examples/ai_agent/esp_llm_tongyi_agent_app/sdkconfig.defaults.esp32s3
```kconfig
CONFIG_IDF_TARGET="esp32s3"

#
# Flash / PSRAM (120M) + XIP from PSRAM
#
CONFIG_ESPTOOLPY_FLASHMODE_QIO=y
CONFIG_ESPTOOLPY_FLASHFREQ_120M=y
CONFIG_ESPTOOLPY_FLASHSIZE_16MB=y
CONFIG_SPIRAM_MODE_OCT=y
CONFIG_SPIRAM_SPEED_120M=y
CONFIG_SPIRAM_XIP_FROM_PSRAM=y
CONFIG_SPI_FLASH_HPM_DC_ON=y
CONFIG_BOOTLOADER_FLASH_DC_AWARE=y

#
# ESP System
#
CONFIG_ESP_DEFAULT_CPU_FREQ_MHZ_240=y
CONFIG_ESP32S3_INSTRUCTION_CACHE_32KB=y
CONFIG_ESP_SYSTEM_EVENT_TASK_STACK_SIZE=3072
CONFIG_ESP_INT_WDT_TIMEOUT_MS=800
CONFIG_ESP_TASK_WDT_TIMEOUT_S=25
CONFIG_ESP_WIFI_STATIC_RX_BUFFER_NUM=6
CONFIG_ESP_WIFI_STATIC_TX_BUFFER_NUM=6
CONFIG_ESP_WIFI_RX_BA_WIN=6
CONFIG_ESP_COREDUMP_ENABLE_TO_UART=y

#
# FatFS
#
CONFIG_FATFS_LFN_HEAP=y
CONFIG_FATFS_CODEPAGE_936=y
CONFIG_FATFS_FS_LOCK=3

#
# FreeRTOS debug
#
CONFIG_FREERTOS_VTASKLIST_INCLUDE_COREID=y
CONFIG_FREERTOS_GENERATE_RUN_TIME_STATS=y

#
# Camera: OV3660 DVP JPEG 320x240 @ 25fps (esp32_s3_korvo_2_3)
#
CONFIG_CAMERA_DMA_BUFFER_SIZE_MAX=81920
CONFIG_ESP_SCCB_TRANS_TIMEOUT_DEFAULT=2000
CONFIG_SCCB_HARDWARE_I2C_PORT0=y
CONFIG_CAMERA_OV3660=y
CONFIG_CAMERA_OV3660_AUTO_DETECT_DVP_INTERFACE_SENSOR=y
CONFIG_CAMERA_OV3660_DVP_JPEG_320X240_25FPS=y
CONFIG_CAMERA_OV3660_DVP_DEFAULT_FMT_JPEG_320X240_25FPS=y
CONFIG_CAMERA_OV3660_DVP_IF_FORMAT_INDEX_DEFAULT=6
CONFIG_CAM_CTRL_SPI_ENABLE=n
CONFIG_ESP_VIDEO_ENABLE_DVP_VIDEO_DEVICE=y
CONFIG_TONGYI_VISION_CAMERA_FPS=15
```
