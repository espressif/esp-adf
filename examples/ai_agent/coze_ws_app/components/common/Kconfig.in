## examples/ai_agent/coze_ws_app/components/common/Kconfig.in
```kconfig
menu "Audio Board"

choice AUDIO_BOARD
    prompt "Audio board"
    default ESP32_S3_KORVO2_V3_BOARD
config AUDIO_BOARD_CUSTOM
    bool "Custom audio board"
config ESP32_S3_KORVO2_V3_BOARD
    bool "ESP32-S3-Korvo-2 v3"
config ESP32_S3_KORVO2L_V1_BOARD
    bool "ESP32-S3-Korvo-2L v1"
config ESP32_S3_BOX_3_BOARD
    bool "ESP32-S3-BOX-3"
config ESP32_P4_FUNCTION_EV_BOARD
    bool "ESP32-P4-FUNCTION-EV-BOARD"

endchoice

endmenu
```

## examples/ai_agent/coze_ws_app/main/Kconfig.projbuild
```kconfig
menu "Example Audio Configuration"

rsource "../components/common/Kconfig.in"

#
# Select how the audio conversation is triggered
#
choice
    prompt "Audio Conversation Trigger Mode"
    default CONTINUOUS_CONVERSATION_MODE

config VOICE_WAKEUP_MODE
    bool "Wake Word Mode"
    select SR_WN_WN9_HILEXIN
    help
      System is activated by a predefined wake word (e.g. 'Hi Lexin').

config CONTINUOUS_CONVERSATION_MODE
    bool "Continuous Mode"
    help
      Keeps the system active after the initial trigger for ongoing conversation.

config KEY_PRESS_DIALOG_MODE
    bool "Key Press Mode"
    help
      System is triggered by a physical key press.

endchoice

config COZE_BOT_ID
    string "COZE_BOT_ID"
    default "7239506**************"

config COZE_ACCESS_TOKEN
    string "COZE_ACCESS_TOKEN"
    default "pat_******************"

endmenu
```

## examples/ai_agent/coze_ws_app/sdkconfig.defaults
```kconfig
CONFIG_IDF_CMAKE=y
CONFIG_IDF_TARGET_ARCH_XTENSA=y
CONFIG_IDF_TARGET="esp32s3"
CONFIG_IDF_TARGET_ESP32S3=y
CONFIG_IDF_FIRMWARE_CHIP_ID=0x0009

#
# Serial flasher config
#
CONFIG_ESPTOOLPY_FLASH_MODE_AUTO_DETECT=y
CONFIG_ESPTOOLPY_FLASHMODE_QIO=y
CONFIG_ESPTOOLPY_FLASH_SAMPLE_MODE_STR=y
CONFIG_ESPTOOLPY_FLASHMODE="dio"
CONFIG_ESPTOOLPY_FLASHFREQ_80M=y
CONFIG_ESPTOOLPY_FLASHFREQ="80m"
CONFIG_ESPTOOLPY_FLASHSIZE_8MB=y
CONFIG_ESPTOOLPY_FLASHSIZE="8MB"
# end of Serial flasher config

#
# Compiler options
#
CONFIG_COMPILER_OPTIMIZATION_PERF=y
# end of Compiler options

#
# FAT Filesystem support
#
CONFIG_FATFS_LFN_HEAP=y
# end of FAT Filesystem support

#
# ESP-TLS
#
CONFIG_ESP_TLS_INSECURE=y
CONFIG_ESP_TLS_SKIP_SERVER_CERT_VERIFY=y
# end of ESP-TLS

#
# Audio Codec Device Configuration
#
# CONFIG_CODEC_I2C_BACKWARD_COMPATIBLE is not set
# end of Audio Codec Device Configuration

#
# FREERTOS
#
CONFIG_FREERTOS_HZ=1000
CONFIG_FREERTOS_USE_TRACE_FACILITY=y
CONFIG_FREERTOS_USE_STATS_FORMATTING_FUNCTIONS=y
# CONFIG_FREERTOS_USE_LIST_DATA_INTEGRITY_CHECK_BYTES is not set
CONFIG_FREERTOS_VTASKLIST_INCLUDE_COREID=y
CONFIG_FREERTOS_GENERATE_RUN_TIME_STATS=y
# end of FREERTOS

#
# ESP WebSocket client
#
CONFIG_ESP_WS_CLIENT_ENABLE_DYNAMIC_BUFFER=y
# end of ESP WebSocket client

#
# ESP Audio Simple Player
#
CONFIG_ESP_AUDIO_SIMPLE_PLAYER_FILE_EN=y
CONFIG_ESP_AUDIO_SIMPLE_PLAYER_RESAMPLE_EN=y
CONFIG_AUDIO_SIMPLE_PLAYER_RESAMPLE_DEST_RATE=16000
CONFIG_ESP_AUDIO_SIMPLE_PLAYER_CH_CVT_EN=y
CONFIG_AUDIO_SIMPLE_PLAYER_CH_CVT_DEST=2
CONFIG_ESP_AUDIO_SIMPLE_PLAYER_BIT_CVT_EN=y
CONFIG_AUDIO_SIMPLE_PLAYER_BIT_CVT_DEST_32BIT=y
# end of ESP Audio Simple Player
```

## examples/ai_agent/coze_ws_app/sdkconfig.defaults.esp32c3
```kconfig
CONFIG_IDF_CMAKE=y
CONFIG_IDF_TARGET_ARCH_RISCV=y
CONFIG_IDF_TARGET="esp32c3"
CONFIG_IDF_TARGET_ESP32C3=y

#
# Partition Table
#
CONFIG_PARTITION_TABLE_CUSTOM=y
CONFIG_PARTITION_TABLE_CUSTOM_FILENAME="partitions_lite.csv"
CONFIG_PARTITION_TABLE_FILENAME="partitions_lite.csv"
CONFIG_PARTITION_TABLE_OFFSET=0x8000
CONFIG_PARTITION_TABLE_MD5=y
# end of Partition Table
```

## examples/ai_agent/coze_ws_app/sdkconfig.defaults.esp32p4
```kconfig
CONFIG_IDF_CMAKE=y
CONFIG_IDF_TARGET_ARCH_RISCV=y
CONFIG_IDF_TARGET_ARCH="riscv"
CONFIG_IDF_TARGET="esp32p4"
CONFIG_IDF_TARGET_ESP32P4=y
CONFIG_ESP_DEFAULT_CPU_FREQ_MHZ_360=y
CONFIG_ESP_DEFAULT_CPU_FREQ_MHZ=360
CONFIG_IDF_EXPERIMENTAL_FEATURES=y

#
# Partition Table
#
CONFIG_PARTITION_TABLE_CUSTOM=y
CONFIG_PARTITION_TABLE_CUSTOM_FILENAME="partitions_esp32p4.csv"
CONFIG_PARTITION_TABLE_FILENAME="partitions_esp32p4.csv"
CONFIG_PARTITION_TABLE_OFFSET=0x8000
CONFIG_PARTITION_TABLE_MD5=y
# end of Partition Table

#
# SPI RAM config
#
CONFIG_SPIRAM=y
CONFIG_SPIRAM_SPEED_200M=y
CONFIG_SPIRAM_ALLOW_STACK_EXTERNAL_MEMORY=y
# end of SPI RAM config

#
# Audio Board
#
CONFIG_ESP32_P4_FUNCTION_EV_BOARD=y
# end of Audio Board

#
# WIFI
#
CONFIG_ESP_WIFI_STATIC_RX_BUFFER_NUM=16
CONFIG_ESP_WIFI_DYNAMIC_RX_BUFFER_NUM=64
CONFIG_ESP_WIFI_DYNAMIC_TX_BUFFER_NUM=64
CONFIG_ESP_WIFI_AMPDU_TX_ENABLED=y
CONFIG_ESP_WIFI_TX_BA_WIN=32
CONFIG_ESP_WIFI_AMPDU_RX_ENABLED=y
CONFIG_ESP_WIFI_RX_BA_WIN=32
CONFIG_LWIP_TCP_SND_BUF_DEFAULT=65534
CONFIG_LWIP_TCP_WND_DEFAULT=65534
CONFIG_LWIP_TCP_RECVMBOX_SIZE=64
CONFIG_LWIP_UDP_RECVMBOX_SIZE=64
CONFIG_LWIP_TCPIP_RECVMBOX_SIZE=64
CONFIG_LWIP_TCP_SACK_OUT=y
# end of WIFI

#
# Wi-Fi Remote
#
CONFIG_SLAVE_IDF_TARGET_ESP32C6=y
CONFIG_ESP_WIFI_REMOTE_LIBRARY_HOSTED=y
# end of  Wi-Fi Remote
```

## examples/ai_agent/coze_ws_app/sdkconfig.defaults.esp32s3
```kconfig
CONFIG_IDF_CMAKE=y
CONFIG_IDF_TARGET_ARCH_XTENSA=y
CONFIG_IDF_TARGET="esp32s3"
CONFIG_IDF_TARGET_ESP32S3=y
CONFIG_IDF_FIRMWARE_CHIP_ID=0x0009

#
# Partition Table
#
CONFIG_PARTITION_TABLE_CUSTOM=y
CONFIG_PARTITION_TABLE_CUSTOM_FILENAME="partitions.csv"
CONFIG_PARTITION_TABLE_FILENAME="partitions.csv"
CONFIG_PARTITION_TABLE_OFFSET=0x8000
CONFIG_PARTITION_TABLE_MD5=y
# end of Partition Table

#
# Serial flasher config
#
CONFIG_ESPTOOLPY_FLASHFREQ_120M=y
CONFIG_ESPTOOLPY_FLASHFREQ="80m"
CONFIG_ESPTOOLPY_FLASHMODE_QIO=y
#end of Serial flasher config

#
# ESP Speech Recognition
#
CONFIG_MODEL_IN_FLASH=y
CONFIG_AFE_INTERFACE_V1=y
CONFIG_SR_WN_WN9_HILEXIN=y
CONFIG_SR_MN_CN_MULTINET6_QUANT=y
CONFIG_SR_MN_EN_NONE=y
# end of ESP Speech Recognition

#
# SPI RAM config
#
CONFIG_SPIRAM=y
CONFIG_SPIRAM_MODE_OCT=y
CONFIG_SPIRAM_TYPE_AUTO=y
CONFIG_SPIRAM_ALLOW_STACK_EXTERNAL_MEMORY=y
CONFIG_SPIRAM_CLK_IO=30
CONFIG_SPIRAM_CS_IO=26
CONFIG_SPIRAM_SPEED_120M=y
CONFIG_SOC_SPIRAM_XIP_SUPPORTED=y
CONFIG_SPIRAM_BOOT_INIT=y
CONFIG_SPIRAM_USE_MALLOC=y
CONFIG_SPIRAM_MEMTEST=y
CONFIG_SPIRAM_MALLOC_ALWAYSINTERNAL=128
CONFIG_SPIRAM_MALLOC_RESERVE_INTERNAL=32768
# end of SPI RAM config
# end of ESP PSRAM

#
# ESP System Settings
#
CONFIG_ESP32S3_DEFAULT_CPU_FREQ_240=y

#
# Cache config
#
CONFIG_ESP32S3_INSTRUCTION_CACHE_32KB=y
CONFIG_ESP32S3_INSTRUCTION_CACHE_SIZE=0x8000
CONFIG_ESP32S3_INSTRUCTION_CACHE_8WAYS=y
CONFIG_ESP32S3_ICACHE_ASSOCIATED_WAYS=8
CONFIG_ESP32S3_INSTRUCTION_CACHE_LINE_32B=y
CONFIG_ESP32S3_INSTRUCTION_CACHE_LINE_SIZE=32
CONFIG_ESP32S3_DATA_CACHE_64KB=y
CONFIG_ESP32S3_DATA_CACHE_SIZE=0x10000
CONFIG_ESP32S3_DATA_CACHE_8WAYS=y
CONFIG_ESP32S3_DCACHE_ASSOCIATED_WAYS=8
CONFIG_ESP32S3_DATA_CACHE_LINE_64B=y
CONFIG_ESP32S3_DATA_CACHE_LINE_SIZE=64
# end of Cache config

CONFIG_IDF_EXPERIMENTAL_FEATURES=y
CONFIG_BOOTLOADER_FLASH_DC_AWARE=y
CONFIG_SPI_FLASH_HPM_ENA=y
```

## examples/ai_agent/volc_rtc/main/Kconfig.projbuild
```kconfig
menu "Example Configuration"

config WIFI_SSID
    string "WiFi SSID"
    default "myssid"
    help
        SSID (network name) for the example to connect to.

config WIFI_PASSWORD
    string "WiFi Password"
    default "mypasswod"
    help
        WiFi password (WPA or WPA2) for the example to use.

        Can be left blank if the network has no security set.

choice AUDIO_DECODER_SUPPORT
    prompt "Audio Decoder"
    default AUDIO_SUPPORT_OPUS_DECODER

config AUDIO_SUPPORT_G711A_DECODER
    bool "AUDIUO-G711-DECODER"

config AUDIO_SUPPORT_OPUS_DECODER
    bool "AUDIO-OPUS-DECODER"

config AUDIO_SUPPORT_AAC_DECODER
    bool "AUDIO-AAC-DECODER"

endchoice

choice AUDIO_CONVERSATION_MODE_SUPPORT
    prompt "Conversion Mode"
    default CONTINUOUS_CONVERSATION_MODE

config LANGUAGE_WAKEUP_MODE
    select USE_WAKENET
    select SR_WN_WN9_HILEXIN
    bool "LANGUAGE-WAKEUP-MODE"

config CONTINUOUS_CONVERSATION_MODE
    bool "CONTINUOUS-CONVERSATION-MODE"

endchoice

choice RTC_MODE_CHOICE
    prompt "rtc mode choice"
    default COZE_REQUEST
    help
        Select rtc request mode

    config COZE_REQUEST
        bool "enable coze request"

    config RTC_TOKEN_REQUEST
        bool "enable rtc token request"
endchoice


config COZE_URL
    string "COZE-URL"
    default "http://115.190.92.216:8899"
    depends on COZE_REQUEST

    config COZE_AUTHORIZATION
        string "COZE-AUTHORIZATION"
        default "af78e3067582ac8c04ba20174410bd1"
        depends on COZE_REQUEST
    
    config COZE_BOTID
        string "COZE-BOTID"
        default "ep-20241104163951-sdmjc"
        depends on COZE_REQUEST


config RTC_TOKEN
    depends on RTC_TOKEN_REQUEST
    config APPID
        string "appid"
        depends on RTC_TOKEN_REQUEST
    
    config ROOMID
        string "roomid"
        depends on RTC_TOKEN_REQUEST
    
    config UID
        string "userid"
        depends on RTC_TOKEN_REQUEST

    config TOKEN
        string "token"
        depends on RTC_TOKEN_REQUEST

config ENABLE_RECORDER_DEBUG
    bool "enable recorder debug save to sdcard"
    default "n"
    help
        Save the data processed by AEC to the SD card. The saved file name is "rec.pcm", and by default, 30 seconds' worth of data will be saved.

endmenu
```

## examples/ai_agent/volc_rtc/sdkconfig.defaults.esp32
```kconfig
CONFIG_IDF_CMAKE=y
CONFIG_IDF_TARGET_ARCH_XTENSA=y
CONFIG_IDF_TARGET="esp32"
CONFIG_IDF_TARGET_ESP32=y

#
# Audio Recorder
#
CONFIG_AFE_MIC_NUM=2
# end of Audio Recorder

#
# ESP Speech Recognition
#
CONFIG_MODEL_IN_FLASH=y
CONFIG_AFE_INTERFACE_V1=y
CONFIG_SR_WN_WN9_HILEXIN=n
# end of ESP Speech Recognition

#
# Component config
#

#
# Driver configurations
#
```

## examples/ai_agent/volc_rtc/sdkconfig.defaults.esp32s3
```kconfig
CONFIG_IDF_CMAKE=y
CONFIG_IDF_TARGET_ARCH_XTENSA=y
CONFIG_IDF_TARGET="esp32s3"
CONFIG_IDF_TARGET_ESP32S3=y
CONFIG_IDF_FIRMWARE_CHIP_ID=0x0009

#
# Make experimental features visible
#
CONFIG_IDF_EXPERIMENTAL_FEATURES=y

#
# Serial flasher config
#
CONFIG_BOOTLOADER_FLASH_DC_AWARE=y
CONFIG_ESPTOOLPY_FLASHFREQ_120M=y
CONFIG_SPI_FLASH_HPM_ENA=y
# end of Serial flasher config

#
# Audio HAL
#
CONFIG_ESP32_S3_KORVO2_V3_BOARD=y
# end of Audio HAL

#
# Audio Recorder
#
CONFIG_AFE_MIC_NUM=2
# end of Audio Recorder

#
# ESP Speech Recognition
#
CONFIG_MODEL_IN_FLASH=y
CONFIG_AFE_INTERFACE_V1=y
CONFIG_SR_WN_WN9_HILEXIN=n
# end of ESP Speech Recognition

#
# Component config
#

#
# Driver configurations
#

#
# mbedTLS
#
# CONFIG_MBEDTLS_INTERNAL_MEM_ALLOC is not set
CONFIG_MBEDTLS_EXTERNAL_MEM_ALLOC=y
# CONFIG_MBEDTLS_HARDWARE_AES is not set
# CONFIG_MBEDTLS_HARDWARE_SHA is not set
# end of mbedTLS


#
# ESP32s3-PSRAM
#
CONFIG_SPIRAM_XIP_FROM_PSRAM=y

#
# ESP32S3-Specific
#
# CONFIG_ESP32S3_DEFAULT_CPU_FREQ_80 is not set
# CONFIG_ESP32S3_DEFAULT_CPU_FREQ_160 is not set
CONFIG_ESP32S3_DEFAULT_CPU_FREQ_240=y
CONFIG_ESP32S3_DEFAULT_CPU_FREQ_MHZ=240

#
# Cache config
#
# CONFIG_ESP32S3_INSTRUCTION_CACHE_16KB is not set
CONFIG_ESP32S3_INSTRUCTION_CACHE_32KB=y
CONFIG_ESP32S3_INSTRUCTION_CACHE_SIZE=0x8000
# CONFIG_ESP32S3_INSTRUCTION_CACHE_4WAYS is not set
CONFIG_ESP32S3_INSTRUCTION_CACHE_8WAYS=y
CONFIG_ESP32S3_ICACHE_ASSOCIATED_WAYS=8
CONFIG_ESP32S3_INSTRUCTION_CACHE_LINE_32B=y
CONFIG_ESP32S3_INSTRUCTION_CACHE_LINE_SIZE=32
# CONFIG_ESP32S3_INSTRUCTION_CACHE_WRAP is not set
# CONFIG_ESP32S3_DATA_CACHE_16KB is not set
# CONFIG_ESP32S3_DATA_CACHE_32KB is not set
CONFIG_ESP32S3_DATA_CACHE_64KB=y
CONFIG_ESP32S3_DATA_CACHE_SIZE=0x10000
# CONFIG_ESP32S3_DATA_CACHE_4WAYS is not set
CONFIG_ESP32S3_DATA_CACHE_8WAYS=y
CONFIG_ESP32S3_DCACHE_ASSOCIATED_WAYS=8
# CONFIG_ESP32S3_DATA_CACHE_LINE_32B is not set
CONFIG_ESP32S3_DATA_CACHE_LINE_64B=y
CONFIG_ESP32S3_DATA_CACHE_LINE_SIZE=64
# CONFIG_ESP32S3_DATA_CACHE_WRAP is not set
# end of Cache config

CONFIG_ESP32S3_SPIRAM_SUPPORT=y

#
# SPI RAM config
#
CONFIG_SPIRAM_MODE_OCT=y
CONFIG_SPIRAM_TYPE_AUTO=y
CONFIG_SPIRAM_SPEED_120M=y
CONFIG_SPIRAM=y
CONFIG_SPIRAM_BOOT_INIT=y
CONFIG_SPIRAM_USE_MALLOC=y
CONFIG_SPIRAM_MEMTEST=y
CONFIG_SPIRAM_MALLOC_ALWAYSINTERNAL=4096
CONFIG_SPIRAM_TRY_ALLOCATE_WIFI_LWIP=y
CONFIG_SPIRAM_MALLOC_RESERVE_INTERNAL=32768
# end of SPI RAM config
# end of ESP32S3-Specific
```

## examples/asr/sdkconfig.defaults
```kconfig
#Override some ASR defaults

#
# Serial flasher config
#
CONFIG_FLASHMODE_QIO=y
CONFIG_ESPTOOLPY_FLASHMODE="qio"
CONFIG_ESPTOOLPY_FLASHFREQ_80M=y
CONFIG_ESPTOOLPY_FLASHFREQ="80m"

#
# FreeRTOS
#
CONFIG_FREERTOS_HZ=1000

#
# ESP32-specific
#
CONFIG_ESP32_DEFAULT_CPU_FREQ_240=y

#
# Speech Recognition Configuration
#
CONFIG_SR_MODEL_WN3_QUANT=
CONFIG_SR_MODEL_WN4_QUANT=y
CONFIG_WAKEUP_WORD_LIGHT_CONTROL_CN=
CONFIG_WAKEUP_WORD_SPEECH_CMD_CH=y
```

## examples/audio_processing/pipeline_alc/sdkconfig.defaults.esp32
```kconfig
CONFIG_IDF_CMAKE=y
CONFIG_IDF_TARGET_ARCH_XTENSA=y
CONFIG_IDF_TARGET="esp32"
CONFIG_IDF_TARGET_ESP32=y
CONFIG_IDF_FIRMWARE_CHIP_ID=0x0000

#
# Audio HAL
#
CONFIG_ESP_LYRAT_V4_3_BOARD=y
```

## examples/audio_processing/pipeline_audio_forge/sdkconfig.defaults
```kconfig
# Override some configuration defaults

CONFIG_ESPTOOLPY_FLASHMODE="dio"
CONFIG_ESPTOOLPY_FLASHFREQ_80M=y
CONFIG_ESPTOOLPY_FLASHSIZE_4MB=y
CONFIG_ESPTOOLPY_BAUD_921600B=y
CONFIG_ESPTOOLPY_BAUD=921600
CONFIG_OPTIMIZATION_LEVEL_RELEASE=y
CONFIG_SPIRAM_SUPPORT=y
CONFIG_SPIRAM_BOOT_INIT=y
CONFIG_SPIRAM_USE_MALLOC=y
CONFIG_MAIN_TASK_STACK_SIZE=4096
CONFIG_SPIRAM_TYPE_ESPPSRAM32=y
CONFIG_SPIRAM_SIZE=4194304
CONFIG_SPIRAM_SPEED_80M=y
CONFIG_SPIRAM_MEMTEST=y
CONFIG_SPIRAM_CACHE_WORKAROUND=y
CONFIG_SPIRAM_MALLOC_ALWAYSINTERNAL=16384
CONFIG_SPIRAM_MALLOC_RESERVE_INTERNAL=32768
CONFIG_FREERTOS_HZ=1000
CONFIG_FATFS_CODEPAGE_936=y
CONFIG_FATFS_LFN_HEAP=y
CONFIG_FATFS_MAX_LFN=255
CONFIG_FATFS_FS_LOCK=5
CONFIG_SPIRAM_ALLOW_STACK_EXTERNAL_MEMORY=y
CONFIG_SPIRAM_TRY_ALLOCATE_WIFI_LWIP=y
CONFIG_FREERTOS_ENABLE_BACKWARD_COMPATIBILITY=y


# Increase default app partition size to accommodate audio forge pipeline example
# by providing new partition table in "partitions_audio_forge_example.csv"
CONFIG_PARTITION_TABLE_CUSTOM=y
CONFIG_PARTITION_TABLE_CUSTOM_FILENAME="partitions_audio_forge_example.csv"
CONFIG_PARTITION_TABLE_CUSTOM_APP_BIN_OFFSET=0x10000
CONFIG_PARTITION_TABLE_FILENAME="partitions_audio_forge_example.csv"
CONFIG_APP_OFFSET=0x10000
```

## examples/audio_processing/pipeline_spiffs_amr_resample/sdkconfig.defaults
```kconfig
CONFIG_PARTITION_TABLE_CUSTOM=y
CONFIG_PARTITION_TABLE_CUSTOM_FILENAME="partitions_spiffs_example.csv"
CONFIG_PARTITION_TABLE_FILENAME="partitions_spiffs_example.csv"

CONFIG_FREERTOS_ENABLE_BACKWARD_COMPATIBILITY=y
```

## examples/checks/check_display_led/sdkconfig.defaults.esp32s3
```kconfig
CONFIG_IDF_CMAKE=y
CONFIG_IDF_TARGET_ARCH_XTENSA=y
CONFIG_IDF_TARGET="esp32s3"
CONFIG_IDF_TARGET_ESP32S3=y
CONFIG_IDF_FIRMWARE_CHIP_ID=0x0009

#
# Audio HAL
#
CONFIG_ESP32_S3_KORVO2_V3_BOARD=y
```

## examples/cli/main/Kconfig.projbuild
```kconfig
menu "Example Configuration"

    config EXAMPLE_WIFI_SSID
        string "wifi ssid"
        default "ssid"

    config EXAMPLE_WIFI_PASSWORD
        string "wifi password"
        default "password"
endmenu
```
