## examples/cli/sdkconfig.defaults
```kconfig
# Override some defaults so BT stack is enabled and
# Classic BT is enabled and BT_DRAM_RELEASE is disabled
CONFIG_FREERTOS_USE_TRACE_FACILITY=y
CONFIG_FREERTOS_USE_STATS_FORMATTING_FUNCTIONS=y
CONFIG_FREERTOS_GENERATE_RUN_TIME_STATS=y
CONFIG_FREERTOS_RUN_TIME_STATS_USING_ESP_TIMER=y
CONFIG_FREERTOS_RUN_TIME_STATS_USING_CPU_CLK=y

CONFIG_FREERTOS_ENABLE_BACKWARD_COMPATIBILITY=y
CONFIG_FREERTOS_PLACE_FUNCTIONS_INTO_FLASH=y

#
# Serial flasher config
#
CONFIG_ESPTOOLPY_FLASHSIZE_4MB=y
CONFIG_ESPTOOLPY_FLASHMODE_QIO=y
CONFIG_ESPTOOLPY_FLASHFREQ_80M=y

CONFIG_COMPILER_OPTIMIZATION_SIZE=y

#
# FAT Filesystem support
#
CONFIG_FATFS_CODEPAGE_936=y
CONFIG_FATFS_LFN_HEAP=y
CONFIG_FATFS_FS_LOCK=20

#
# SPI RAM config
#
CONFIG_IDF_EXPERIMENTAL_FEATURES=y
CONFIG_SPIRAM=y
CONFIG_SPIRAM_MALLOC_ALWAYSINTERNAL=2048
CONFIG_SPIRAM_IGNORE_NOTFOUND=y
CONFIG_SPIRAM_ALLOW_STACK_EXTERNAL_MEMORY=y
CONFIG_SPIRAM_TRY_ALLOCATE_WIFI_LWIP=y

# Increase default app partition size to accommodate console example
# by providing new partition table in "partitions_console_example.csv"
CONFIG_PARTITION_TABLE_CUSTOM=y
CONFIG_PARTITION_TABLE_CUSTOM_FILENAME="partitions_console_example.csv"

#
# ESP-IDF System Configuration Paramters
#
CONFIG_ESP_MAIN_TASK_STACK_SIZE=3584
CONFIG_ESP_SYSTEM_EVENT_TASK_STACK_SIZE=3072
CONFIG_MAIN_TASK_STACK_SIZE=4096

CONFIG_ESP_TLS_INSECURE=y
CONFIG_ESP_TLS_SKIP_SERVER_CERT_VERIFY=y

#
# Kernel
#
CONFIG_FREERTOS_VTASKLIST_INCLUDE_COREID=y
CONFIG_FREERTOS_GENERATE_RUN_TIME_STATS=y

#
# mbedTLS
#
CONFIG_MBEDTLS_EXTERNAL_MEM_ALLOC=y

#
# Bluetooth
#
CONFIG_BT_ENABLED=y
CONFIG_BT_GATTC_ENABLE=n
CONFIG_BT_BLE_SMP_ENABLE=n

#
# Controller Options
#
CONFIG_BT_BLE_BLUFI_ENABLE=y
CONFIG_MBEDTLS_HARDWARE_MPI=n
CONFIG_MBEDTLS_DHM_C=y
CONFIG_BT_BLE_42_FEATURES_SUPPORTED=y
```

## examples/cli/sdkconfig.defaults.esp32
```kconfig
CONFIG_IDF_CMAKE=y
CONFIG_IDF_TARGET_ARCH_XTENSA=y
CONFIG_IDF_TARGET="esp32"
CONFIG_IDF_TARGET_ESP32=y
CONFIG_IDF_FIRMWARE_CHIP_ID=0x0000

#
# Audio HAL
#
CONFIG_ESP_LYRAT_V4_3_BOARD=y

#
# ESP System Settings
#
CONFIG_ESP_DEFAULT_CPU_FREQ_MHZ_240=y

#
# Wi-Fi
#
CONFIG_ESP_WIFI_TASK_PINNED_TO_CORE_1=y
```

## examples/cli/sdkconfig.defaults.esp32s2
```kconfig
CONFIG_IDF_CMAKE=y
CONFIG_IDF_TARGET_ARCH_XTENSA=y
CONFIG_IDF_TARGET="esp32s2"
CONFIG_IDF_TARGET_ESP32S2=y
CONFIG_IDF_FIRMWARE_CHIP_ID=0x0002

#
# SPI RAM config
#
CONFIG_ESP32S2_SPIRAM_SUPPORT=y

#
# Audio HAL
#
CONFIG_ESP32_S2_KALUGA_1_V1_2_BOARD=y
```

## examples/cli/sdkconfig.defaults.esp32s3
```kconfig
CONFIG_IDF_CMAKE=y
CONFIG_IDF_TARGET_ARCH_XTENSA=y
CONFIG_IDF_TARGET="esp32s3"
CONFIG_IDF_TARGET_ESP32S3=y
CONFIG_IDF_FIRMWARE_CHIP_ID=0x0009

#
# Audio HAL
#
CONFIG_ESP32_S3_KORVO2_V3_BOARD=y

#
# ESP System Settings
#
CONFIG_ESP_DEFAULT_CPU_FREQ_MHZ_240=y

#
# ESP PSRAM
#
CONFIG_SPIRAM=y

#
# SPI RAM config
#
CONFIG_SPIRAM_MODE_OCT=y
CONFIG_ESP32S3_SPIRAM_SUPPORT=y
CONFIG_SPIRAM_ALLOW_STACK_EXTERNAL_MEMORY=y
CONFIG_SPIRAM_SPEED_80M=y

#
# Wi-Fi
#
CONFIG_ESP_WIFI_TASK_PINNED_TO_CORE_1=y
```

## examples/cloud_services/google_translate_device/main/Kconfig.projbuild
```kconfig
menu "Example Configuration"

config WIFI_SSID
    string "WiFi SSID"
	default "myssid"
	help
		SSID (network name) for the example to connect to.

config WIFI_PASSWORD
    string "WiFi Password"
	default "mypassword"
	help
		WiFi password (WPA or WPA2) for the example to use.
		Can be left blank if the network has no security set.

config GOOGLE_API_KEY
    string "Google Cloud API Key"
    default "api-key"
    help
        Google Cloud API Key

        The key may be obtained from https://cloud.google.com/docs/authentication/api-keys

endmenu
```

## examples/display/dual_eyes/components/storage/Kconfig.projbuild
```kconfig
menu "Storage Configuration"

    config SDMMC_CMD_PIN
        int "CMD GPIO number"
        default 42 if IDF_TARGET_ESP32S3

    config SDMMC_CLK_PIN
        int "CLK GPIO number"
        default 2 if IDF_TARGET_ESP32S3

    config SDMMC_D0_PIN
        int "D0 GPIO number"
        default 1 if IDF_TARGET_ESP32S3

    config SDMMC_D1_PIN
        int "D1 GPIO number"
        default -1 if IDF_TARGET_ESP32S3

    config SDMMC_D2_PIN
        int "D2 GPIO number"
        default -1 if IDF_TARGET_ESP32S3

    config SDMMC_D3_PIN
        int "D3 GPIO number"
        default -1 if IDF_TARGET_ESP32S3

endmenu
```

## examples/display/dual_eyes/sdkconfig.defaults
```kconfig
# System config
CONFIG_BOOTLOADER_LOG_LEVEL_NONE=y
CONFIG_COMPILER_OPTIMIZATION_PERF=y
CONFIG_FREERTOS_HZ=1000
CONFIG_FREERTOS_VTASKLIST_INCLUDE_COREID=y
CONFIG_FREERTOS_GENERATE_RUN_TIME_STATS=y
CONFIG_PARTITION_TABLE_CUSTOM=y
CONFIG_ESPTOOLPY_FLASHMODE_QIO=y
CONFIG_ESPTOOLPY_FLASHFREQ_80M=y

# LVGL v8
CONFIG_LV_USE_LOG=y
CONFIG_LV_LOG_LEVEL_USER=y
CONFIG_LV_LOG_PRINTF=y
CONFIG_LV_COLOR_16_SWAP=y
CONFIG_LV_COLOR_SCREEN_TRANSP=y
CONFIG_LV_MEM_CUSTOM=y
CONFIG_LV_MEMCPY_MEMSET_STD=y
CONFIG_LV_FONT_MONTSERRAT_10=y
CONFIG_LV_FONT_MONTSERRAT_12=y
CONFIG_LV_FONT_MONTSERRAT_16=y
CONFIG_LV_FONT_MONTSERRAT_18=y
CONFIG_LV_FONT_MONTSERRAT_20=y
CONFIG_LV_USE_DEMO_WIDGETS=y
CONFIG_LV_USE_DEMO_STRESS=n
CONFIG_LV_USE_DEMO_MUSIC=y
CONFIG_LV_DEMO_MUSIC_AUTO_PLAY=y
CONFIG_IDF_EXPERIMENTAL_FEATURES=y
CONFIG_LV_USE_DEMO_BENCHMARK=y
CONFIG_LV_DEMO_BENCHMARK_RGB565A8=y
CONFIG_LV_USE_PERF_MONITOR=n
CONFIG_LV_ATTRIBUTE_FAST_MEM_USE_IRAM=y

#
# 3rd Party Libraries
#
CONFIG_LV_USE_FS_STDIO=y
CONFIG_LV_FS_STDIO_LETTER=68
CONFIG_LV_FS_STDIO_PATH=""
CONFIG_LV_FS_STDIO_CACHE_SIZE=65535
CONFIG_LV_USE_GIF=y

#
# LittleFS
#
CONFIG_LITTLEFS_CACHE_SIZE=4096

#
# FAT Filesystem support
#
CONFIG_FATFS_VFS_FSTAT_BLKSIZE=4096
CONFIG_FATFS_LFN_HEAP=y
```

## examples/display/dual_eyes/sdkconfig.defaults.esp32s3
```kconfig
CONFIG_IDF_TARGET="esp32s3"
CONFIG_ESP_DEFAULT_CPU_FREQ_MHZ_240=y
CONFIG_ESP32S3_DATA_CACHE_LINE_64B=y
CONFIG_ESP_CONSOLE_USB_SERIAL_JTAG=y

# Flash config
CONFIG_IDF_EXPERIMENTAL_FEATURES=y
CONFIG_ESPTOOLPY_FLASHSIZE_16MB=y
CONFIG_BOOTLOADER_FLASH_DC_AWARE=y
CONFIG_ESPTOOLPY_FLASHFREQ_120M=y
CONFIG_SPI_FLASH_HPM_ENA=y

# Psram config
CONFIG_SPIRAM=y
CONFIG_SPIRAM_MEMTEST=n
CONFIG_SPIRAM_MODE_OCT=y
CONFIG_SPIRAM_XIP_FROM_PSRAM=y
CONFIG_SPIRAM_TRY_ALLOCATE_WIFI_LWIP=y
CONFIG_SPIRAM_MALLOC_ALWAYSINTERNAL=64
CONFIG_SPIRAM_SPEED_120M=y
CONFIG_SPIRAM_TIMING_TUNING_POINT_VIA_TEMPERATURE_SENSOR=y
CONFIG_SPIRAM_TIMING_MEASURE_TEMPERATURE_INTERVAL_SECOND=5
```
