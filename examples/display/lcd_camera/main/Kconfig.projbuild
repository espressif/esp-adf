## examples/ota/main/Kconfig.projbuild
```kconfig
menu "OTA App Configuration"

config WIFI_SSID
    string "WiFi SSID"
    default "myssid"
    help
	SSID (network name) for the example to connect to.

config WIFI_PASSWORD
    string "WiFi Password"
    default "mypassword"
    help
	WiFi password (WPA or WPA2) for the example to use.

config FIRMWARE_UPGRADE_URI
    string "firmware upgrade uri"
    default "https://192.168.0.3:8070/hello-world.bin"
    help
        URI of the firmware
        image.

config DATA_UPGRADE_URI
    string "data image upgrade uri"
    default "file://sdcard/flash_tone.bin"
    help
        URI of the data image
        image.

config DATA_PARTITION_LABEL
    string "data partition label"
    default "flash_tone"
    help
        data partition's label.

config FORCE_CHECK_FIRMWARE_VERSION_NUMBER
    bool "Forece check the firmware version number when OTA start"
    default n
    help
        If this option is set, mandatory check the firmware version number

endmenu
```

## examples/ota/sdkconfig.defaults
```kconfig
#
# Serial flasher config
#
CONFIG_ESPTOOLPY_FLASHSIZE_4MB=y

CONFIG_FREERTOS_ENABLE_BACKWARD_COMPATIBILITY=y

#
# Partition Table
#
CONFIG_PARTITION_TABLE_CUSTOM=y
CONFIG_PARTITION_TABLE_CUSTOM_FILENAME="partitions.csv"
CONFIG_PARTITION_TABLE_FILENAME="partitions.csv"
CONFIG_PARTITION_TABLE_OFFSET=0x8000
CONFIG_PARTITION_TABLE_MD5=y

#
# Wi-Fi
#
CONFIG_ESP32_WIFI_STATIC_TX_BUFFER_NUM=6
CONFIG_ESP32_WIFI_TX_BA_WIN=6
CONFIG_ESP32_WIFI_CACHE_TX_BUFFER_NUM=16
CONFIG_ESP32_WIFI_STATIC_RX_BUFFER_NUM=16
CONFIG_ESP32_WIFI_DYNAMIC_RX_BUFFER_NUM=128
CONFIG_ESP32_WIFI_RX_BA_WIN=32
CONFIG_ESP32_WIFI_IRAM_OPT=y
CONFIG_ESP32_WIFI_RX_IRAM_OPT=y
CONFIG_ESP32_WIFI_TASK_PINNED_TO_CORE_1=y

#
# LWIP
#
CONFIG_LWIP_TCPIP_RECVMBOX_SIZE=64
CONFIG_LWIP_IRAM_OPTIMIZATION=y

#
# TCP
#
CONFIG_LWIP_TCP_SND_BUF_DEFAULT=5744
CONFIG_LWIP_TCP_WND_DEFAULT=65535
CONFIG_LWIP_TCP_RECVMBOX_SIZE=64

#
# Optimize
#
CONFIG_COMPILER_OPTIMIZATION_PERF=y

#
# FAT Filesystem support
#
CONFIG_FATFS_LFN_HEAP=y
CONFIG_FATFS_API_ENCODING_UTF_8=y

#
# Mbedtls
#
CONFIG_MBEDTLS_INTERNAL_MEM_ALLOC=y
CONFIG_ESP_TLS_INSECURE=y
CONFIG_ESP_TLS_SKIP_SERVER_CERT_VERIFY=y

CONFIG_ESP_SYSTEM_EVENT_TASK_STACK_SIZE=3072
```

## examples/ota/sdkconfig.defaults.esp32s3
```kconfig
CONFIG_IDF_CMAKE=y
CONFIG_IDF_TARGET_ARCH_XTENSA=y
CONFIG_IDF_TARGET="esp32s3"
CONFIG_IDF_TARGET_ESP32S3=y
CONFIG_IDF_FIRMWARE_CHIP_ID=0x0009

#
# SDK tool configuration
#
CONFIG_SDK_TOOLPREFIX="xtensa-esp32s3-elf-"
# CONFIG_SDK_TOOLCHAIN_SUPPORTS_TIME_WIDE_64_BITS is not set
# end of SDK tool configuration

#
# Audio HAL
#
CONFIG_ESP32_S3_KORVO2_V3_BOARD=y

#
# ESP32S3-Specific
#
CONFIG_ESP32S3_DEFAULT_CPU_FREQ_240=y
CONFIG_ESP32S3_DATA_CACHE_LINE_64B=y
CONFIG_ESP32S3_SPIRAM_SUPPORT=y
CONFIG_SPIRAM_MODE_OCT=y
CONFIG_SPIRAM_ALLOW_STACK_EXTERNAL_MEMORY=y
CONFIG_SPIRAM_SPEED_80M=y
CONFIG_SPIRAM_MALLOC_ALWAYSINTERNAL=1024
CONFIG_SPIRAM_TRY_ALLOCATE_WIFI_LWIP=y
```

## examples/player/pipeline_a2dp_source_stream/main/Kconfig.projbuild
```kconfig
menu "Example Configuration"

config BT_REMOTE_NAME
    string "BT remote device name"
	default "ESP_SINK_STREAM_DEMO"
	help
		BT_REMOTE_NAME (Bluetooth device name) for the example to connect to.

endmenu
```

## examples/player/pipeline_a2dp_source_stream/sdkconfig.defaults.esp32
```kconfig
CONFIG_IDF_CMAKE=y
CONFIG_IDF_TARGET_ARCH_XTENSA=y
CONFIG_IDF_TARGET="esp32"
CONFIG_IDF_TARGET_ESP32=y
CONFIG_IDF_FIRMWARE_CHIP_ID=0x0000

#
# Audio HAL
#
CONFIG_ESP_LYRAT_V4_3_BOARD=y

#
# ESP32-specific
#
CONFIG_ESP32_DEFAULT_CPU_FREQ_240=y
CONFIG_ESP32_DEFAULT_CPU_FREQ_MHZ=240
```

## examples/player/pipeline_bt_sink/sdkconfig.defaults
```kconfig
# Override some defaults so BT stack is enabled and
# Classic BT is enabled and BT_DRAM_RELEASE is disabled
CONFIG_BT_ENABLED=y
CONFIG_BTDM_CONTROLLER_MODE_BTDM=y
CONFIG_BLUEDROID_ENABLED=y
CONFIG_CLASSIC_BT_ENABLED=y
CONFIG_A2DP_ENABLE=y
CONFIG_A2DP_SINK_TASK_STACK_SIZE=2048

# Increase default app partition size to accommodate BT
# by providing new partition table in "partitions_bt_sink_example.csv"
CONFIG_PARTITION_TABLE_CUSTOM=y
CONFIG_PARTITION_TABLE_CUSTOM_FILENAME="partitions_bt_sink_example.csv"
CONFIG_PARTITION_TABLE_CUSTOM_APP_BIN_OFFSET=0x10000
CONFIG_PARTITION_TABLE_FILENAME="partitions_bt_sink_example.csv"
CONFIG_APP_OFFSET=0x10000
```

## examples/player/pipeline_bt_source/sdkconfig.defaults
```kconfig
# Override some defaults so BT stack is enabled and
# Classic BT is enabled
CONFIG_BT_ENABLED=y
CONFIG_BTDM_CONTROLLER_MODE_BTDM=y
CONFIG_BTDM_CTRL_PINNED_TO_CORE_1=y
CONFIG_BTDM_CONTROLLER_MODEM_SLEEP=y
CONFIG_BLUEDROID_ENABLED=y
CONFIG_BLUEDROID_PINNED_TO_CORE_1=y
CONFIG_BLUEDROID_PINNED_TO_CORE=1
CONFIG_CLASSIC_BT_ENABLED=y
CONFIG_A2DP_ENABLE=y
CONFIG_BT_ALLOCATION_FROM_SPIRAM_FIRST=y
CONFIG_BT_BLE_DYNAMIC_ENV_MEMORY=y
CONFIG_SPIRAM=y
CONFIG_BT_BLE_BLUFI_ENABLE=y
CONFIG_SPIRAM_ALLOW_STACK_EXTERNAL_MEMORY=y
CONFIG_FREERTOS_ENABLE_BACKWARD_COMPATIBILITY=y
CONFIG_MBEDTLS_DHM_C=y
CONFIG_ESPTOOLPY_FLASHSIZE_4MB=y
CONFIG_ESPTOOLPY_FLASHFREQ_80M=y
# Increase default app partition size to accommodate BT
# by providing new partition table in "partitions_bt_source_example.csv"
CONFIG_PARTITION_TABLE_CUSTOM=y
CONFIG_PARTITION_TABLE_CUSTOM_FILENAME="partitions_bt_source_example.csv"
CONFIG_SW_COEXIST_ENABLE=y

#
# Port
#
CONFIG_FREERTOS_PLACE_FUNCTIONS_INTO_FLASH=y
# end of Port
```
