## examples/display/lcd_camera/main/Kconfig.projbuild
```kconfig
menu "Example Configuration"

choice CAMERA_CAPTURE_DATA_FORMAT
    prompt "camera capture data format"
    default CAMERA_DATA_FORMAT_RGB565

config CAMERA_DATA_FORMAT_YUV422
    bool "YUV422"

config CAMERA_DATA_FORMAT_RGB565
    bool "RGB565"

endchoice
endmenu
```

## examples/display/led_pixels/components/led_board/Kconfig.projbuild
```kconfig
menu "LED Board"

choice CUSTOMER_AUDIO_BOARD
    prompt "LED board"
    default ESP32_C3_DEVKITM_1
    help
        Select an led board to use with the ESP-ADF

config ESP32_C3_DEVKITM_1
    bool "ESP32 C3 DevKitM-1"

endchoice

endmenu
```

## examples/display/led_pixels/main/Kconfig.projbuild
```kconfig
menu "Example Configuration"

    config EXAMPLE_LED_TX_CHANNEL
        int "SPI/RMT TX channel"
        range 0 10
        default 0
    config EXAMPLE_LED_CTRL_IO
        int "LED ctrl IO"
        range 0 30
        default 7
    config EXAMPLE_TOTAL_LEDS
        int "Total number of LEDs"
        default 16

    menu "Audio"
        choice EXAMPLE_REC_TYPE
            prompt "Audio capture types"
            default EXAMPLE_ADC_REC_TYPE

            config EXAMPLE_ADC_REC_TYPE
                bool "ADC"
                help
                    ADC recording using esp32c3-lyra

            config EXAMPLE_I2S_REC_TYPE
                bool "I2S"
                help
                    I2S recording using esp32c3
        endchoice

        config EXAMPLE_AUDIO_SAMPLE
            int "Audio sampling rate"
            default 16000
        config EXAMPLE_AUDIO_EFFECTIVE_RESOLUTION_BITS
            int "Audio effective resolution bits"
            default 12
        config EXAMPLE_N_SAMPLE
            int "The number of sample points to use for each calculation. Also used for FFT calculations"
            default 256
        config EXAMPLE_DEFAULT_AUDIO_MIN_RMS
            int "Min audio Root-Mean-Square threshold"
            default 12
        config EXAMPLE_DEFAULT_AUDIO_MAX_RMS
            int "Max audio Root-Mean-Square threshold"
            default 64
        choice EXAMPLE_VOL_CALC_TYPES
            prompt "Volume calculate types"
            default EXAMPLE_VOL_DYNAMIC_CALC_TYPE

            config EXAMPLE_VOL_STATIC_CALC_TYPE
                bool "Volume staic calculate"
                help
                    Fixed 'rms_max'

            config EXAMPLE_VOL_DYNAMIC_CALC_TYPE
                bool "Volume dynamic calculation"
                help
                    If the audio frame Root-Mean-Square Value is greater than "variable_rms_max", "variable_rms_max" will be refreshed.
                    Of course, when the signal is small, in order to display the small signal, "variable_rms_max" will quickly fall back to the default setting.
        endchoice

        config EXAMPLE_IIR_HPF_FILTER
            bool "IIR filter"
            default false
        config EXAMPLE_CUT_OFF_FREQ
            depends on EXAMPLE_IIR_HPF_FILTER
            int "Cut-off frequency"
            default 100
        config EXAMPLE_Q_FACTOR
            depends on EXAMPLE_IIR_HPF_FILTER
            int "Q factor of filter"
            default 1
        config EXAMPLE_FFT
            bool "FFT operation"
            default false
        choice EXAMPLE_FFT_TYPE
            depends on EXAMPLE_FFT
            prompt "FFT types"
            default EXAMPLE_FC32_TYPE

            config EXAMPLE_SC16_TYPE
                bool "SR16"
                help
                    sr16

            config EXAMPLE_FC32_TYPE
                bool "FC32"
                help
                    fc32
        endchoice
        config EXAMPLE_DATA_DEBUG
            bool "Date debug"
            default false
        config EXAMPLE_SOURCE_DATA_DEBUG
            depends on EXAMPLE_DATA_DEBUG
            bool "Source data debug"
            default false
        config EXAMPLE_FFT_DEBUG
            depends on EXAMPLE_DATA_DEBUG
            bool "FFT debug"
            default false
    endmenu

endmenu
```

## examples/display/led_pixels/sdkconfig.defaults
```kconfig
#
# FreeRTOS
#
CONFIG_FREERTOS_UNICORE=y
CONFIG_FREERTOS_NO_AFFINITY=0x7FFFFFFF
CONFIG_FREERTOS_TICK_SUPPORT_SYSTIMER=y
CONFIG_FREERTOS_CORETIMER_SYSTIMER_LVL1=y
CONFIG_FREERTOS_SYSTICK_USES_SYSTIMER=y
CONFIG_FREERTOS_OPTIMIZED_SCHEDULER=y
CONFIG_FREERTOS_HZ=1000
CONFIG_FREERTOS_ENABLE_BACKWARD_COMPATIBILITY=y

# end of FreeRTOS
```

## examples/display/music_player/sdkconfig.defaults
```kconfig
CONFIG_LV_FONT_MONTSERRAT_12=y
CONFIG_LV_FONT_MONTSERRAT_16=y

#
# Color settings
#
# CONFIG_LV_COLOR_DEPTH_32 is not set
CONFIG_LV_COLOR_DEPTH_16=y
# CONFIG_LV_COLOR_DEPTH_8 is not set
# CONFIG_LV_COLOR_DEPTH_1 is not set
CONFIG_LV_COLOR_DEPTH=16
CONFIG_LV_COLOR_16_SWAP=y
CONFIG_LV_COLOR_MIX_ROUND_OFS=128
CONFIG_LV_COLOR_CHROMA_KEY_HEX=0x00FF00
# end of Color settings

#
# Memory settings
#
CONFIG_LV_MEM_CUSTOM=y
CONFIG_LV_MEM_CUSTOM_INCLUDE="stdlib.h"
CONFIG_LV_MEM_BUF_MAX_NUM=16
CONFIG_LV_MEMCPY_MEMSET_STD=y
# end of Memory settings

#
# HAL Settings
#
CONFIG_LV_DISP_DEF_REFR_PERIOD=30
CONFIG_LV_INDEV_DEF_READ_PERIOD=30
# CONFIG_LV_TICK_CUSTOM is not set
CONFIG_LV_DPI_DEF=130
# end of HAL Settings
```

## examples/dueros/main/Kconfig.projbuild
```kconfig
menu "Example Configuration"

choice WIFI_SETTING_TYPE
    prompt "WiFi Setting type"
    default WIFI_STATIC_CONFIG
    help
        Select WiFi setting method

    config WIFI_STATIC_CONFIG
        bool "WiFi static configuration"

    config ESP_SMARTCONFIG
        bool "ESP smartconfig"

    config AIRKISS_ENCRYPT
        bool "Airkiss encrypt"

    config DUER_WIFI_CONFIG
        bool "Lightduer DIPB WiFi config"
        select BT_ENABLED
        select BT_BLE_42_FEATURES_SUPPORTED
endchoice

config WIFI_SSID
    string "WiFi SSID"
    depends on WIFI_STATIC_CONFIG
    default "myssid"
    help
        SSID (network name) for the example to connect to.

config WIFI_PASSWORD
    string "WiFi Password"
    depends on WIFI_STATIC_CONFIG
    default "myssid"
    help
        WiFi password (WPA or WPA2) for the example to use.

        Can be left blank if the network has no security set.

config AIRKISS_APPID
    string "Airkiss APP ID"
    depends on AIRKISS_ENCRYPT
    default "gh_9e2cff3dfa51"
    help
        The airkiss application id.

config AIRKISS_DEVICEID
    string "Airkiss device ID"
    depends on AIRKISS_ENCRYPT
    default "122475"
    help
        The airkiss device id.

config DUER_AIRKISS_KEY
    string "DuerOS airkiss key"
    depends on AIRKISS_ENCRYPT
    default "Enter dueros aes key string"
    help
        The key used to encrypt ssid and password with AES method.

config DUER_CLIENT_ID
    string "Duer client id"
    depends on DUER_WIFI_CONFIG
    default "client id"
    help
        The duer client id.

config DUER_ECC_PUB_KEY
    string "Duer ECC public key"
    depends on DUER_WIFI_CONFIG
    default "ecc public key"
    help
        The key used to encrypt.

endmenu
```

## examples/dueros/sdkconfig.defaults
```kconfig
#
# Serial flasher config
#
CONFIG_ESPTOOLPY_FLASHMODE_QIO=y
CONFIG_ESPTOOLPY_FLASHFREQ_80M=y
CONFIG_ESPTOOLPY_FLASHFREQ="80m"
# end of Serial flasher config

CONFIG_FREERTOS_ENABLE_BACKWARD_COMPATIBILITY=y

#
# Compiler options
#
CONFIG_COMPILER_OPTIMIZATION_PERF=y

#
# Wi-Fi
#
CONFIG_ESP_WIFI_STATIC_RX_BUFFER_NUM=16
CONFIG_ESP_WIFI_DYNAMIC_RX_BUFFER_NUM=32
CONFIG_ESP_WIFI_STATIC_TX_BUFFER=y
CONFIG_ESP_WIFI_TX_BUFFER_TYPE=0
CONFIG_ESP_WIFI_STATIC_TX_BUFFER_NUM=16
CONFIG_ESP_WIFI_CACHE_TX_BUFFER_NUM=32
# CONFIG_ESP_WIFI_CSI_ENABLED is not set
CONFIG_ESP_WIFI_AMPDU_TX_ENABLED=y
CONFIG_ESP_WIFI_TX_BA_WIN=6
CONFIG_ESP_WIFI_AMPDU_RX_ENABLED=y
CONFIG_ESP_WIFI_RX_BA_WIN=16
CONFIG_ESP_WIFI_NVS_ENABLED=y
CONFIG_ESP_WIFI_TASK_PINNED_TO_CORE_0=y
# CONFIG_ESP_WIFI_TASK_PINNED_TO_CORE_1 is not set
CONFIG_ESP_WIFI_SOFTAP_BEACON_MAX_LEN=752
CONFIG_ESP_WIFI_MGMT_SBUF_NUM=32
# CONFIG_ESP_WIFI_IRAM_OPT is not set
# CONFIG_ESP_WIFI_RX_IRAM_OPT is not set
CONFIG_ESP_WIFI_ENABLE_WPA3_SAE=y
# end of Wi-Fi

#
# FreeRTOS
#
CONFIG_FREERTOS_PLACE_FUNCTIONS_INTO_FLASH=y

CONFIG_MBEDTLS_SSL_PROTO_DTLS=y
CONFIG_MBEDTLS_DHM_C=y
```

## examples/dueros/sdkconfig.defaults.esp32
```kconfig
#
# Serial flasher config
#
CONFIG_ESPTOOLPY_FLASHSIZE_4MB=y
CONFIG_ESPTOOLPY_FLASHSIZE="4MB"

#
# Partition Table
#
# CONFIG_PARTITION_TABLE_SINGLE_APP is not set
# CONFIG_PARTITION_TABLE_SINGLE_APP_LARGE is not set
# CONFIG_PARTITION_TABLE_TWO_OTA is not set
CONFIG_PARTITION_TABLE_CUSTOM=y
CONFIG_PARTITION_TABLE_CUSTOM_FILENAME="partitions_dueros_example.csv"
CONFIG_PARTITION_TABLE_FILENAME="partitions_dueros_example.csv"
CONFIG_PARTITION_TABLE_MD5=y
# end of Partition Table

#
# Audio HAL
#
CONFIG_ESP_LYRAT_MINI_V1_1_BOARD=y
# end of Audio HAL

#
# ESP Speech Recognition
#
CONFIG_AFE_INTERFACE_V1=y
# end of ESP Speech Recognition

#
# ADF Features
#
CONFIG_ESP_DISPATCHER_DELEGATE_TASK_CORE=1

#
# Component config
#

#
# ESP32-specific
#
CONFIG_ESP32_ECO3_CACHE_LOCK_FIX=y
CONFIG_ESP32_REV_MIN_0=y
CONFIG_ESP32_REV_MIN=0
CONFIG_ESP32_DEFAULT_CPU_FREQ_240=y
CONFIG_ESP32_DEFAULT_CPU_FREQ_MHZ=240
CONFIG_ESP32_SPIRAM_SUPPORT=y

#
# SPI RAM config
#
CONFIG_SPIRAM_SPEED_80M=y
CONFIG_SPIRAM=y
CONFIG_SPIRAM_BOOT_INIT=y
CONFIG_SPIRAM_TRY_ALLOCATE_WIFI_LWIP=y
CONFIG_SPIRAM_ALLOW_BSS_SEG_EXTERNAL_MEMORY=y
CONFIG_SPIRAM_CACHE_WORKAROUND=y
CONFIG_SPIRAM_MALLOC_ALWAYSINTERNAL=4096
CONFIG_SPIRAM_ALLOW_STACK_EXTERNAL_MEMORY=y

#
# SPIRAM workaround libraries placement
#
# CONFIG_SPIRAM_CACHE_LIBJMP_IN_IRAM is not set
# CONFIG_SPIRAM_CACHE_LIBMATH_IN_IRAM is not set
# CONFIG_SPIRAM_CACHE_LIBNUMPARSER_IN_IRAM is not set
# CONFIG_SPIRAM_CACHE_LIBIO_IN_IRAM is not set
# CONFIG_SPIRAM_CACHE_LIBTIME_IN_IRAM is not set
# CONFIG_SPIRAM_CACHE_LIBCHAR_IN_IRAM is not set
# CONFIG_SPIRAM_CACHE_LIBMEM_IN_IRAM is not set
# CONFIG_SPIRAM_CACHE_LIBSTR_IN_IRAM is not set
# CONFIG_SPIRAM_CACHE_LIBRAND_IN_IRAM is not set
# CONFIG_SPIRAM_CACHE_LIBENV_IN_IRAM is not set
# CONFIG_SPIRAM_CACHE_LIBFILE_IN_IRAM is not set
# CONFIG_SPIRAM_CACHE_LIBMISC_IN_IRAM is not set
# end of SPIRAM workaround libraries placement

#
# FreeRTOS
#
CONFIG_FREERTOS_TIMER_TASK_PRIORITY=10
CONFIG_FREERTOS_USE_TRACE_FACILITY=y
CONFIG_FREERTOS_USE_STATS_FORMATTING_FUNCTIONS=y
CONFIG_FREERTOS_VTASKLIST_INCLUDE_COREID=y
CONFIG_FREERTOS_GENERATE_RUN_TIME_STATS=y
CONFIG_FREERTOS_RUN_TIME_STATS_USING_ESP_TIMER=y

#
# mbedTLS
#
CONFIG_MBEDTLS_EXTERNAL_MEM_ALLOC=y
CONFIG_MBEDTLS_ECP_RESTARTABLE=y

#
# ESP-TLS
#
CONFIG_ESP_TLS_USING_MBEDTLS=y
CONFIG_ESP_TLS_INSECURE=y
CONFIG_ESP_TLS_SKIP_SERVER_CERT_VERIFY=y
```

## examples/dueros/sdkconfig.defaults.esp32p4
```kconfig
#
# Partition Table
#
# CONFIG_PARTITION_TABLE_SINGLE_APP is not set
# CONFIG_PARTITION_TABLE_SINGLE_APP_LARGE is not set
# CONFIG_PARTITION_TABLE_TWO_OTA is not set
CONFIG_PARTITION_TABLE_CUSTOM=y
CONFIG_PARTITION_TABLE_CUSTOM_FILENAME="partitions.csv"
CONFIG_PARTITION_TABLE_FILENAME="partitions.csv"
CONFIG_PARTITION_TABLE_MD5=y
# end of Partition Table

CONFIG_IDF_CMAKE=y
CONFIG_IDF_TARGET_ARCH_RISCV=y
CONFIG_IDF_TARGET_ARCH="riscv"
CONFIG_IDF_TARGET="esp32p4"
CONFIG_IDF_TARGET_ESP32P4=y
CONFIG_ESP_DEFAULT_CPU_FREQ_MHZ_360=y
CONFIG_ESP_DEFAULT_CPU_FREQ_MHZ=360
CONFIG_IDF_EXPERIMENTAL_FEATURES=y

#
# SPI RAM config
#
CONFIG_SPIRAM=y
CONFIG_SPIRAM_SPEED_200M=y
CONFIG_SPIRAM_ALLOW_STACK_EXTERNAL_MEMORY=y
# end of SPI RAM config

#
# Serial flasher config
#
CONFIG_ESPTOOLPY_FLASHSIZE_8MB=y
CONFIG_ESPTOOLPY_FLASHSIZE="8MB"
# end of Serial flasher config

#
# Audio HAL
#
CONFIG_ESP32_P4_FUNCTION_EV_BOARD=y
# end of Audio HAL

#
# mbedTLS
#
CONFIG_MBEDTLS_EXTERNAL_MEM_ALLOC=y
CONFIG_MBEDTLS_ECP_RESTARTABLE=y
# end of mbedTLS

#
# ESP-TLS
#
CONFIG_ESP_TLS_USING_MBEDTLS=y
CONFIG_ESP_TLS_INSECURE=y
CONFIG_ESP_TLS_SKIP_SERVER_CERT_VERIFY=y
# end of ESP-TLS

#
# DSP Library
#
CONFIG_DSP_OPTIMIZED=y
CONFIG_DSP_OPTIMIZATION=0
CONFIG_DSP_MAX_FFT_SIZE_4096=y
CONFIG_DSP_MAX_FFT_SIZE=4096
# end of DSP Library

#
# ESP Speech Recognition
#
CONFIG_MODEL_IN_FLASH=y
CONFIG_AFE_INTERFACE_V1=y
CONFIG_SR_WN_WN9_HILEXIN=y
CONFIG_SR_MN_CN_MULTINET7_QUANT=y
CONFIG_SR_MN_EN_NONE=y
# end of ESP Speech Recognition

CONFIG_MBEDTLS_ECP_RESTARTABLE=y

CONFIG_SLAVE_IDF_TARGET_ESP32C6=y
CONFIG_ESP_WIFI_REMOTE_LIBRARY_HOSTED=y
```

## examples/filter/pipeline_spiffs_amr_resample/sdkconfig.defaults
```kconfig
CONFIG_PARTITION_TABLE_CUSTOM=y
CONFIG_PARTITION_TABLE_CUSTOM_FILENAME="partitions_spiffs_example.csv"
CONFIG_PARTITION_TABLE_FILENAME="partitions_spiffs_example.csv"
CONFIG_PARTITION_TABLE_OFFSET=0x8000
```

## examples/get-started/pipeline_a2dp_sink_and_hfp/sdkconfig.defaults
```kconfig
# Override some defaults so BT stack is enabled and
# Classic BT is enabled and BT_DRAM_RELEASE is disabled
CONFIG_BT_ENABLED=y
CONFIG_BLUEDROID_ENABLED=y
CONFIG_CLASSIC_BT_ENABLED=y
CONFIG_A2DP_ENABLE=y
CONFIG_A2DP_SINK_ENABLE=y


CONFIG_BTDM_CONTROLLER_MODE_BTDM=y
CONFIG_BTDM_CONTROLLER_BR_EDR_MAX_SYNC_CONN=2
CONFIG_BTDM_CONTROLLER_BR_EDR_MAX_SYNC_CONN_EFF=2
CONFIG_HFP_ENABLE=y
CONFIG_HFP_AUDIO_DATA_PATH_HCI=y

CONFIG_FREERTOS_ENABLE_BACKWARD_COMPATIBILITY=y

CONFIG_ESPTOOLPY_FLASHSIZE_4MB=y

# Increase default app partition size to accommodate BT
# by providing new partition table in "partitions_bt_sink_example.csv"
CONFIG_PARTITION_TABLE_CUSTOM=y
CONFIG_PARTITION_TABLE_CUSTOM_FILENAME="partitions_bt_sink_example.csv"
CONFIG_PARTITION_TABLE_CUSTOM_APP_BIN_OFFSET=0x10000
CONFIG_PARTITION_TABLE_FILENAME="partitions_bt_sink_example.csv"
CONFIG_APP_OFFSET=0x10000
```

## examples/get-started/play_mp3_control/components/my_board/Kconfig.projbuild
```kconfig
menu "My Audio Board"

choice CUSTOMER_AUDIO_BOARD
    prompt "My audio board"
    default MY_BOARD_V1_0
    help
        Select an audio board to use with the ESP-ADF

config MY_BOARD_V1_0
    bool "My board v1.0"

endchoice

endmenu
```

## examples/korvo_du1906/main/Kconfig.projbuild
```kconfig
menu "Example Configuration"

config WIFI_SSID
    string "WiFi SSID"
    default "myssid"
    help
        SSID (network name) for the example to connect to.

config WIFI_PASSWORD
    string "WiFi Password"
    default "myssid"
    help
        WiFi password (WPA or WPA2) for the example to use.

        Can be left blank if the network has no security set.

choice WIFI_SETTING_TYPE
    prompt "WiFi Setting type"
    default ESP_SMARTCONFIG
    help
        Select wifi setting method

config ESP_SMARTCONFIG
    bool "Enable esp smartconfig"

config ESP_BLUFI
    bool "Enable espressif blufi"

config AIRKISS_ENCRYPT
    bool "Enable airkiss encrypt"

config AIRKISS_APPID
    string "Airkiss APP ID"
    depends on AIRKISS_ENCRYPT
    default "Your APP ID"
    help
        The airkiss application id.

config AIRKISS_DEVICEID
    string "Airkiss device ID"
    depends on AIRKISS_ENCRYPT
    default "Your device ID"
    help
        The airkiss device id.

config AIRKISS_KEY
    string "The airkiss key"
    depends on AIRKISS_ENCRYPT
    default "Enter aes key string"
    help
        The key used to encrypt ssid and password with AES method.

endchoice
endmenu
```
