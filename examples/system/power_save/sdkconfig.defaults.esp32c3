## examples/system/power_save/sdkconfig.defaults.esp32c3
```kconfig
CONFIG_IDF_CMAKE=y
CONFIG_IDF_TARGET_ARCH_RISCV=y
CONFIG_IDF_TARGET="esp32c3"
CONFIG_IDF_TARGET_ESP32C3=y
CONFIG_IDF_FIRMWARE_CHIP_ID=0x0005

#
# Audio HAL
#
CONFIG_ESP32_C3_LYRA_V2_BOARD=y

#
# ESP32C3-Specific
#
# CONFIG_ESP32C3_DEFAULT_CPU_FREQ_80 is not set
CONFIG_ESP32C3_DEFAULT_CPU_FREQ_160=y
CONFIG_ESP32C3_DEFAULT_CPU_FREQ_MHZ=160
CONFIG_ESP32C3_RTC_CLK_SRC_EXT_CRYS=y

#
# Sleep Config
#
# CONFIG_ESP_SLEEP_POWER_DOWN_FLASH is not set
CONFIG_ESP_SLEEP_GPIO_RESET_WORKAROUND=y
CONFIG_ESP_SLEEP_FLASH_LEAKAGE_WORKAROUND=y
CONFIG_ESP_SLEEP_MSPI_NEED_ALL_IO_PU=y
# end of Sleep Config

#
# ESP System Settings
#
CONFIG_ESP_SYSTEM_RTC_EXT_XTAL=y
```

## examples/system/power_save/sdkconfig.defaults.esp32s2
```kconfig
CONFIG_IDF_CMAKE=y
CONFIG_IDF_TARGET_ARCH_XTENSA=y
CONFIG_IDF_TARGET="esp32s2"
CONFIG_IDF_TARGET_ESP32S2=y
CONFIG_IDF_FIRMWARE_CHIP_ID=0x0002

#
# Audio HAL
#
CONFIG_ESP32_S2_KALUGA_1_V1_2_BOARD=y

#
# ESP32S2-specific
#
CONFIG_ESP32S2_DEFAULT_CPU_FREQ_240=y
CONFIG_ESP32S2_DEFAULT_CPU_FREQ_MHZ=240
CONFIG_ESP32S2_SPIRAM_SUPPORT=y
CONFIG_ESP32S2_RTC_CLK_SRC_EXT_CRYS=y

#
# SPI RAM config
#
## Save internal mem for mbedTLS
CONFIG_SPIRAM_MALLOC_ALWAYSINTERNAL=1024

#
# Sleep Config
#
CONFIG_ESP_SLEEP_RTC_BUS_ISO_WORKAROUND=y
CONFIG_ESP_SLEEP_GPIO_RESET_WORKAROUND=y
CONFIG_ESP_SLEEP_PSRAM_LEAKAGE_WORKAROUND=y
CONFIG_ESP_SLEEP_FLASH_LEAKAGE_WORKAROUND=y
CONFIG_ESP_SLEEP_MSPI_NEED_ALL_IO_PU=y
# end of Sleep Config

CONFIG_ESP_SYSTEM_RTC_EXT_XTAL=y

CONFIG_ESP_PHY_ENABLE_USB=n
```

## examples/useed/useed_toy_printer/main/Kconfig.projbuild
```kconfig
menu "Useed Toy Printer Config"

menu "Wifi Config"

config WIFI_SSID
    string "WiFi SSID"
	default "useedtech"
	help
		SSID (network name) for the example to connect to.

config WIFI_PASSWORD
    string "WiFi Password"
	default "useedtech2555"
	help
		WiFi password (WPA or WPA2) for the example to use.

		Can be left blank if the network has no security set.
        
endmenu

endmenu
```
