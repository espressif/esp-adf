## examples/advanced_examples/voip/main/Kconfig.projbuild
```kconfig
menu "VoIP App Configuration"

choice VOIP_CODEC
    prompt "SIP Codec"
    default SIP_CODEC_G711A
    help
        sip codec

config SIP_CODEC_G711A
    bool "G711 PCMA"
config SIP_CODEC_G711U
    bool "G711 PCMU"
endchoice

config WIFI_SSID
    string "WiFi SSID"
    default "myssid"
    help
    SSID (network name) for the example to connect to.

config WIFI_PASSWORD
    string "WiFi Password"
    default "mypassword"
    help
    WiFi password (WPA or WPA2) for the example to use.

config SIP_URI
    string "SIP URI"
    default "udp://100:100@192.168.1.123:5060"
    help
    The SIP URI with username, password, address, port and transport type

endmenu
```

## examples/advanced_examples/voip/sdkconfig.defaults
```kconfig
# Serial flash
CONFIG_FLASHMODE_QIO=y
CONFIG_ESPTOOLPY_FLASHFREQ_80M=y
CONFIG_ESPTOOLPY_PORT="/dev/ttyUSB0"
CONFIG_ESPTOOLPY_BAUD_OTHER=y
CONFIG_ESPTOOLPY_BAUD_OTHER_VAL=1497600
CONFIG_ESPTOOLPY_COMPRESSED=y
CONFIG_ESPTOOLPY_FLASHSIZE_4MB=y
CONFIG_OPTIMIZATION_LEVEL_RELEASE=y

#
# ESP32-specific
#
CONFIG_ESP32_DEFAULT_CPU_FREQ_240=y
CONFIG_ESP32_DEFAULT_CPU_FREQ_MHZ=240
CONFIG_FREERTOS_IDLE_TASK_STACKSIZE=1024

#
# SPI RAM config
#
CONFIG_SPIRAM_SUPPORT=y
CONFIG_SPIRAM_BOOT_INIT=y
CONFIG_SPIRAM_USE_MALLOC=y
CONFIG_SPIRAM_SPEED_80M=y
CONFIG_SPIRAM_MALLOC_ALWAYSINTERNAL=4096
CONFIG_SPIRAM_MALLOC_RESERVE_INTERNAL=18432
CONFIG_SPIRAM_ALLOW_BSS_SEG_EXTERNAL_MEMORY=y
CONFIG_SPIRAM_ALLOW_STACK_EXTERNAL_MEMORY=y
CONFIG_WIFI_LWIP_ALLOCATION_FROM_SPIRAM_FIRST=y

#
# Wi-Fi
#
CONFIG_ESP32_WIFI_STATIC_RX_BUFFER_NUM=9
CONFIG_ESP32_WIFI_DYNAMIC_RX_BUFFER_NUM=128
CONFIG_ESP32_WIFI_STATIC_TX_BUFFER_NUM=9
CONFIG_ESP32_WIFI_IRAM_OPT=n
CONFIG_ESP32_WIFI_RX_IRAM_OPT=n
CONFIG_MBEDTLS_EXTERNAL_MEM_ALLOC=y

#
# UDP
#
CONFIG_LWIP_MAX_UDP_PCBS=64
CONFIG_UDP_RECVMBOX_SIZE=64
CONFIG_TCPIP_TASK_STACK_SIZE=2560

# Increase default app partition size to accommodate voip example
# by providing new partition table in "partitions_voip_example.csv"
CONFIG_PARTITION_TABLE_CUSTOM=y
CONFIG_PARTITION_TABLE_CUSTOM_FILENAME="partitions_voip_example.csv"
CONFIG_PARTITION_TABLE_CUSTOM_APP_BIN_OFFSET=0x10000
CONFIG_PARTITION_TABLE_FILENAME="partitions_voip_example.csv"
CONFIG_APP_OFFSET=0x10000

#
# Certificate Bundle
#
# CONFIG_MBEDTLS_ROM_MD5 is not set

CONFIG_ESP_TLS_INSECURE=y
CONFIG_ESP_TLS_SKIP_SERVER_CERT_VERIFY=y

CONFIG_ESP_SYSTEM_EVENT_TASK_STACK_SIZE=3072
```

## examples/advanced_examples/voip/sdkconfig.defaults.esp32s3
```kconfig
CONFIG_IDF_TARGET="esp32s3"
CONFIG_IDF_TARGET_ESP32S3=y

#
# Serial flasher config
#
CONFIG_ESPTOOLPY_FLASHFREQ_80M=y
CONFIG_ESPTOOLPY_FLASHFREQ="80m"

#
# ESP32S3-Specific
#
CONFIG_ESP32S3_DEFAULT_CPU_FREQ_240=y
CONFIG_ESP32S3_DEFAULT_CPU_FREQ_MHZ=240

#
# SPI RAM config
#
CONFIG_ESP32S3_SPIRAM_SUPPORT=y
CONFIG_SPIRAM_MODE_OCT=y
CONFIG_SPIRAM_TYPE_AUTO=y
CONFIG_SPIRAM_SIZE=-1
CONFIG_SPIRAM_SPEED_80M=y
CONFIG_SPIRAM_TRY_ALLOCATE_WIFI_LWIP=y

#
# Wi-Fi
#
CONFIG_ESP32_WIFI_STATIC_RX_BUFFER_NUM=9
CONFIG_ESP32_WIFI_DYNAMIC_RX_BUFFER_NUM=128
CONFIG_ESP32_WIFI_STATIC_TX_BUFFER_NUM=9
CONFIG_ESP32_WIFI_IRAM_OPT=n
CONFIG_ESP32_WIFI_RX_IRAM_OPT=n
CONFIG_MBEDTLS_EXTERNAL_MEM_ALLOC=y

#
# UDP
#
CONFIG_LWIP_MAX_UDP_PCBS=64
CONFIG_UDP_RECVMBOX_SIZE=64
CONFIG_TCPIP_TASK_STACK_SIZE=2560

# Increase default app partition size to accommodate voip example
# by providing new partition table in "partitions_voip_example.csv"
CONFIG_PARTITION_TABLE_CUSTOM=y
CONFIG_PARTITION_TABLE_CUSTOM_FILENAME="partitions_voip_example.csv"
CONFIG_PARTITION_TABLE_CUSTOM_APP_BIN_OFFSET=0x10000
CONFIG_PARTITION_TABLE_FILENAME="partitions_voip_example.csv"
CONFIG_APP_OFFSET=0x10000

#
# Certificate Bundle
#
# CONFIG_MBEDTLS_ROM_MD5 is not set

CONFIG_ESP_TLS_INSECURE=y
CONFIG_ESP_TLS_SKIP_SERVER_CERT_VERIFY=y

CONFIG_ESP_SYSTEM_EVENT_TASK_STACK_SIZE=3072
```

## examples/advanced_examples/wifi_bt_ble_coex/sdkconfig.defaults
```kconfig
CONFIG_PARTITION_TABLE_CUSTOM=y
CONFIG_PARTITION_TABLE_CUSTOM_FILENAME="partitions.csv"
CONFIG_PARTITION_TABLE_FILENAME="partitions.csv"
CONFIG_PARTITION_TABLE_OFFSET=0x8000
CONFIG_PARTITION_TABLE_MD5=y
CONFIG_BT_ENABLED=y
CONFIG_BTDM_CONTROLLER_MODE_BTDM=y
CONFIG_BTDM_CONTROLLER_BLE_MAX_CONN=3
CONFIG_BTDM_CONTROLLER_BR_EDR_MAX_ACL_CONN=2
CONFIG_BTDM_CONTROLLER_BR_EDR_MAX_SYNC_CONN=2
CONFIG_BTDM_CTRL_BR_EDR_SCO_DATA_PATH_EFF=0
CONFIG_BTDM_CONTROLLER_BLE_MAX_CONN_EFF=3
CONFIG_BTDM_CONTROLLER_BR_EDR_MAX_ACL_CONN_EFF=2
CONFIG_BTDM_CONTROLLER_BR_EDR_MAX_SYNC_CONN_EFF=2
CONFIG_BTDM_CONTROLLER_PINNED_TO_CORE_1=y
CONFIG_BTDM_CONTROLLER_PINNED_TO_CORE=1
CONFIG_BTDM_CONTROLLER_HCI_MODE_VHCI=y
CONFIG_BLE_SCAN_DUPLICATE=y
CONFIG_SCAN_DUPLICATE_BY_DEVICE_ADDR=y
CONFIG_SCAN_DUPLICATE_TYPE=0
CONFIG_DUPLICATE_SCAN_CACHE_SIZE=200
CONFIG_BTDM_CONTROLLER_FULL_SCAN_SUPPORTED=y
CONFIG_BLE_ADV_REPORT_FLOW_CONTROL_SUPPORTED=y
CONFIG_BLE_ADV_REPORT_FLOW_CONTROL_NUM=100
CONFIG_BLE_ADV_REPORT_DISCARD_THRSHOLD=20
CONFIG_BLUEDROID_ENABLED=y
CONFIG_BLUEDROID_PINNED_TO_CORE_1=y
CONFIG_BLUEDROID_PINNED_TO_CORE=1
CONFIG_BTC_TASK_STACK_SIZE=3072
CONFIG_BTU_TASK_STACK_SIZE=4512
CONFIG_CLASSIC_BT_ENABLED=y
CONFIG_A2DP_ENABLE=y
CONFIG_A2DP_SINK_TASK_STACK_SIZE=2048
CONFIG_A2DP_SOURCE_TASK_STACK_SIZE=0
CONFIG_HFP_ENABLE=y
CONFIG_HFP_CLIENT_ENABLE=y
CONFIG_HFP_AUDIO_DATA_PATH_HCI=y
CONFIG_BT_SSP_ENABLED=y
CONFIG_GATTS_ENABLE=y
CONFIG_GATTS_SEND_SERVICE_CHANGE_AUTO=y
CONFIG_GATTS_SEND_SERVICE_CHANGE_MODE=0
CONFIG_GATTC_ENABLE=y
CONFIG_BLE_SMP_ENABLE=y
CONFIG_BT_BLE_BLUFI_ENABLE=y

CONFIG_ESP32_WIFI_STATIC_RX_BUFFER_NUM=9
CONFIG_ESP32_WIFI_STATIC_TX_BUFFER_NUM=11
CONFIG_ESP_TLS_INSECURE=y
CONFIG_ESP_TLS_SKIP_SERVER_CERT_VERIFY=y
CONFIG_MBEDTLS_DEFAULT_MEM_ALLOC=y

CONFIG_ESP_SYSTEM_EVENT_TASK_STACK_SIZE=3072

CONFIG_ESPTOOLPY_FLASHMODE_QIO=y
CONFIG_ESPTOOLPY_FLASHMODE="dio"
CONFIG_ESPTOOLPY_FLASHFREQ_80M=y
CONFIG_ESPTOOLPY_FLASHSIZE_8MB=y
CONFIG_ESPTOOLPY_FLASHSIZE_DETECT=y
CONFIG_ESP32_DEFAULT_CPU_FREQ_240=y
CONFIG_ESP32_DEFAULT_CPU_FREQ_MHZ=240
CONFIG_COMPILER_OPTIMIZATION_SIZE=y

CONFIG_SPIRAM_TYPE_AUTO=y
CONFIG_SPIRAM_SPEED_80M=y
CONFIG_SPIRAM=y
CONFIG_ESP32_SPIRAM_SUPPORT=y
CONFIG_SPIRAM_BOOT_INIT=y
CONFIG_SPIRAM_MALLOC_ALWAYSINTERNAL=2048
CONFIG_SPIRAM_TRY_ALLOCATE_WIFI_LWIP=y
CONFIG_SPIRAM_ALLOW_BSS_SEG_EXTERNAL_MEMORY=y
CONFIG_SPIRAM_ALLOW_NOINIT_SEG_EXTERNAL_MEMORY=y
CONFIG_SPIRAM_CACHE_WORKAROUND=y
CONFIG_SPIRAM_CACHE_WORKAROUND_STRATEGY_MEMW=y
CONFIG_SPIRAM_ALLOW_STACK_EXTERNAL_MEMORY=y

CONFIG_FREERTOS_ENABLE_BACKWARD_COMPATIBILITY=y
CONFIG_MBEDTLS_DHM_C=y

#
# SPIRAM workaround libraries placement
#
CONFIG_SPIRAM_CACHE_LIBJMP_IN_IRAM=y
# CONFIG_SPIRAM_CACHE_LIBMATH_IN_IRAM is not set
# CONFIG_SPIRAM_CACHE_LIBNUMPARSER_IN_IRAM is not set
# CONFIG_SPIRAM_CACHE_LIBIO_IN_IRAM is not set
# CONFIG_SPIRAM_CACHE_LIBTIME_IN_IRAM is not set
# CONFIG_SPIRAM_CACHE_LIBCHAR_IN_IRAM is not set
# CONFIG_SPIRAM_CACHE_LIBMEM_IN_IRAM is not set
# CONFIG_SPIRAM_CACHE_LIBSTR_IN_IRAM is not set
# CONFIG_SPIRAM_CACHE_LIBRAND_IN_IRAM is not set
CONFIG_SPIRAM_CACHE_LIBENV_IN_IRAM=y
# CONFIG_SPIRAM_CACHE_LIBFILE_IN_IRAM is not set
CONFIG_SPIRAM_CACHE_LIBMISC_IN_IRAM=y
# end of SPIRAM workaround libraries placement
```

## examples/ai_agent/baidu_rtc/solutions/voice_assistant_app/main/Kconfig.projbuild
```kconfig
menu "Example Configuration"

    config BAIDU_APP_ID
        string "Baidu App ID"
        default "appid**********"
        help
            Baidu application ID for authentication.

    config BAIDU_USER_ID
        string "Baidu User ID"
        default "userid**********"
        help
            Baidu user ID for identification.

    config BAIDU_WORKFLOW
        string "Baidu Workflow"
        default "workflow**********"
        help
            Baidu workflow configuration.

    config BAIDU_LICENSE_KEY
        string "Baidu License Key"
        default "key**********"
        help
            Baidu license key for authorization.

    config BAIDU_INSTANCE_ID
        int "Baidu Instance ID"
        default 123456
        help
            Baidu instance ID (integer value).

    config SERVER_URL
        string "Server URL"
        default "http://192.168.3.73:8936/api/v1/aiagent"
        help
            Please refer to the README file in the brtc directory to set up the server, and then obtain the relevant URLs.

endmenu
```
