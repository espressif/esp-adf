## examples/advanced_examples/aec/sdkconfig.defaults.esp32s3
```kconfig
CONFIG_IDF_TARGET="esp32s3"
CONFIG_IDF_TARGET_ESP32S3=y

#
# ESP32S3-Specific
#
CONFIG_ESP32S3_DEFAULT_CPU_FREQ_240=y
CONFIG_ESP32S3_DEFAULT_CPU_FREQ_MHZ=240

#
# SPI RAM config
#
CONFIG_ESP32S3_SPIRAM_SUPPORT=y
CONFIG_SPIRAM_MODE_OCT=y
CONFIG_SPIRAM_TYPE_AUTO=y
CONFIG_SPIRAM_SPEED_80M=y
CONFIG_SPIRAM_TRY_ALLOCATE_WIFI_LWIP=y

# Increase default app partition size to accommodate this example
CONFIG_ESP_TLS_INSECURE=y
CONFIG_ESP_TLS_SKIP_SERVER_CERT_VERIFY=y
CONFIG_ESP_SYSTEM_EVENT_TASK_STACK_SIZE=3072

#
# Audio HAL
#
CONFIG_ESP32_S3_KORVO2_V3_BOARD=y

#
# Serial flasher config
#
CONFIG_ESPTOOLPY_FLASHMODE_QIO=y
CONFIG_ESPTOOLPY_FLASH_SAMPLE_MODE_STR=y
CONFIG_ESPTOOLPY_FLASHMODE="dio"
CONFIG_ESPTOOLPY_FLASHFREQ_80M=y
CONFIG_ESPTOOLPY_FLASHFREQ="80m"
CONFIG_ESPTOOLPY_FLASHSIZE_8MB=y
CONFIG_ESPTOOLPY_FLASHSIZE="8MB"
CONFIG_ESPTOOLPY_HEADER_FLASHSIZE_UPDATE=y
CONFIG_ESPTOOLPY_BEFORE_RESET=y
CONFIG_ESPTOOLPY_BEFORE="default_reset"
CONFIG_ESPTOOLPY_AFTER_RESET=y
CONFIG_ESPTOOLPY_AFTER="hard_reset"
CONFIG_ESPTOOLPY_MONITOR_BAUD=115200
# end of Serial flasher config

#
# ESP Speech Recognition
#
CONFIG_MODEL_IN_FLASH=y
CONFIG_AFE_INTERFACE_V1=y
CONFIG_SR_NSN_NSNET2=y
CONFIG_SR_WN_WN9_HILEXIN=y
CONFIG_SR_MN_CN_MULTINET6_QUANT=y
CONFIG_SR_MN_EN_NONE=y
# end of ESP Speech Recognition
```

## examples/advanced_examples/algorithm/sdkconfig.defaults
```kconfig
# Override some defaults

#
# Serial flasher config
#
CONFIG_FLASHMODE_QIO=y
CONFIG_ESPTOOLPY_FLASHMODE="qio"
CONFIG_ESPTOOLPY_FLASHFREQ_80M=y
CONFIG_ESPTOOLPY_FLASHFREQ="80m"
CONFIG_ESPTOOLPY_FLASHSIZE_4MB=y
CONFIG_ESPTOOLPY_FLASHSIZE="4MB"
CONFIG_ESPTOOLPY_HEADER_FLASHSIZE_UPDATE=y

#
# FreeRTOS
#
CONFIG_FREERTOS_HZ=1000
CONFIG_FREERTOS_ENABLE_BACKWARD_COMPATIBILITY=y

#
# SPI RAM config
#
CONFIG_SPIRAM=y
CONFIG_SPIRAM_BOOT_INIT=y
CONFIG_SPIRAM_USE_MALLOC=y
CONFIG_SPIRAM_ALLOW_STACK_EXTERNAL_MEMORY=y
CONFIG_SPIRAM_TRY_ALLOCATE_WIFI_LWIP=y

# Increase default app partition size to accommodate this example
# by providing new partition table in "partitions_algo.csv"
CONFIG_PARTITION_TABLE_CUSTOM=y
CONFIG_PARTITION_TABLE_CUSTOM_FILENAME="partitions_algo.csv"

#
# FAT Filesystem support
#
CONFIG_FATFS_CODEPAGE_936=y
CONFIG_FATFS_LFN_HEAP=y
CONFIG_FATFS_MAX_LFN=255
CONFIG_FATFS_FS_LOCK=5
```

## examples/advanced_examples/algorithm/sdkconfig.defaults.esp32
```kconfig
#
# Default config
#
CONFIG_IDF_TARGET_ARCH_XTENSA=y
CONFIG_IDF_TARGET="esp32"
CONFIG_IDF_TARGET_ESP32=y
CONFIG_IDF_FIRMWARE_CHIP_ID=0x0000

#
# Audio HAL
#
CONFIG_ESP_LYRAT_V4_3_BOARD=y

#
# ESP32-specific
#
CONFIG_ESP32_DEFAULT_CPU_FREQ_240=y
CONFIG_ESP32_DEFAULT_CPU_FREQ_MHZ=240

#
# Serial flasher config
#
CONFIG_ESPTOOLPY_FLASHMODE_QIO=y
CONFIG_ESPTOOLPY_FLASH_SAMPLE_MODE_STR=y
CONFIG_ESPTOOLPY_FLASHMODE="dio"
CONFIG_ESPTOOLPY_FLASHFREQ_80M=y
CONFIG_ESPTOOLPY_FLASHFREQ="80m"
CONFIG_ESPTOOLPY_FLASHSIZE_8MB=y
CONFIG_ESPTOOLPY_FLASHSIZE="8MB"
CONFIG_ESPTOOLPY_HEADER_FLASHSIZE_UPDATE=y
CONFIG_ESPTOOLPY_BEFORE_RESET=y
CONFIG_ESPTOOLPY_BEFORE="default_reset"
CONFIG_ESPTOOLPY_AFTER_RESET=y
CONFIG_ESPTOOLPY_AFTER="hard_reset"
CONFIG_ESPTOOLPY_MONITOR_BAUD=115200
# end of Serial flasher config

CONFIG_SPIRAM_SPEED_80M=y
```

## examples/advanced_examples/algorithm/sdkconfig.defaults.esp32p4
```kconfig
CONFIG_IDF_CMAKE=y
CONFIG_IDF_TARGET_ARCH_RISCV=y
CONFIG_IDF_TARGET_ARCH="riscv"
CONFIG_IDF_TARGET="esp32p4"
CONFIG_IDF_TARGET_ESP32P4=y
CONFIG_ESP_DEFAULT_CPU_FREQ_MHZ_360=y
CONFIG_ESP_DEFAULT_CPU_FREQ_MHZ=360
CONFIG_IDF_EXPERIMENTAL_FEATURES=y

#
# SPI RAM config
#
CONFIG_SPIRAM=y
CONFIG_SPIRAM_SPEED_200M=y
CONFIG_SPIRAM_ALLOW_STACK_EXTERNAL_MEMORY=y

#
# Serial flasher config
#
CONFIG_ESPTOOLPY_FLASHMODE_QIO=y
CONFIG_ESPTOOLPY_FLASH_SAMPLE_MODE_STR=y
CONFIG_ESPTOOLPY_FLASHMODE="dio"
CONFIG_ESPTOOLPY_FLASHFREQ_80M=y
CONFIG_ESPTOOLPY_FLASHFREQ="80m"
CONFIG_ESPTOOLPY_FLASHSIZE_8MB=y
CONFIG_ESPTOOLPY_FLASHSIZE="8MB"
CONFIG_ESPTOOLPY_HEADER_FLASHSIZE_UPDATE=y
CONFIG_ESPTOOLPY_BEFORE_RESET=y
CONFIG_ESPTOOLPY_BEFORE="default_reset"
CONFIG_ESPTOOLPY_AFTER_RESET=y
CONFIG_ESPTOOLPY_AFTER="hard_reset"
CONFIG_ESPTOOLPY_MONITOR_BAUD=115200
# end of Serial flasher config

#
# Audio HAL
#
CONFIG_ESP32_P4_FUNCTION_EV_BOARD=y
# end of Audio HAL

#
# DSP Library
#
CONFIG_DSP_OPTIMIZED=y
CONFIG_DSP_OPTIMIZATION=0
CONFIG_DSP_MAX_FFT_SIZE_4096=y
CONFIG_DSP_MAX_FFT_SIZE=4096
# end of DSP Library
```

## examples/advanced_examples/algorithm/sdkconfig.defaults.esp32s3
```kconfig
CONFIG_IDF_TARGET="esp32s3"
CONFIG_IDF_TARGET_ESP32S3=y

#
# ESP32S3-Specific
#
CONFIG_ESP32S3_DEFAULT_CPU_FREQ_240=y
CONFIG_ESP32S3_DEFAULT_CPU_FREQ_MHZ=240

#
# SPI RAM config
#
CONFIG_ESP32S3_SPIRAM_SUPPORT=y
CONFIG_SPIRAM_MODE_OCT=y
CONFIG_SPIRAM_TYPE_AUTO=y
CONFIG_SPIRAM_SIZE=-1
CONFIG_SPIRAM_SPEED_80M=y
CONFIG_SPIRAM_TRY_ALLOCATE_WIFI_LWIP=y

# Increase default app partition size to accommodate this example
# by providing new partition table in "partitions_algo.csv"
CONFIG_ESP_TLS_INSECURE=y
CONFIG_ESP_TLS_SKIP_SERVER_CERT_VERIFY=y
CONFIG_ESP_SYSTEM_EVENT_TASK_STACK_SIZE=3072

#
# Audio HAL
#
CONFIG_ESP32_S3_KORVO2_V3_BOARD=y
```

## examples/advanced_examples/audio_mixer_tone/main/Kconfig.projbuild
```kconfig
menu "Example Configuration"

    config AUDIO_SAMPLE_RATE
        int "audio sample rate"
        default 44100
        help
            Number of samples per second

    config AUDIO_CHANNELS
        int "audio channel count"
        default 2
        help
            Number of audio channels

    config AUDIO_BITS
        int "audio bits"
        default 16
        help
            Number of audio bits per sample

endmenu
```

## examples/advanced_examples/dlna/sdkconfig.defaults
```kconfig
#
# Serial flasher config
#
CONFIG_ESPTOOLPY_FLASHMODE="qio"
CONFIG_ESPTOOLPY_FLASHFREQ_80M=y
CONFIG_ESPTOOLPY_FLASHSIZE_4MB=y
CONFIG_OPTIMIZATION_LEVEL_RELEASE=y
CONFIG_ESPTOOLPY_FLASHSIZE_4MB=y

CONFIG_FREERTOS_ENABLE_BACKWARD_COMPATIBILITY=y

#
# SPI RAM config
#
CONFIG_SPIRAM=y
CONFIG_SPIRAM_BOOT_INIT=y
CONFIG_SPIRAM_USE_MALLOC=y
CONFIG_SPIRAM_SPEED_80M=y
CONFIG_SPIRAM_ALLOW_STACK_EXTERNAL_MEMORY=y
CONFIG_SPIRAM_TRY_ALLOCATE_WIFI_LWIP=y
CONFIG_SPIRAM_TRY_ALLOCATE_WIFI_LWIP=y

# Increase default app partition size to accommodate console example
# by providing new partition table in "partitions_dlna_example.csv"
CONFIG_PARTITION_TABLE_CUSTOM=y
CONFIG_PARTITION_TABLE_CUSTOM_FILENAME="partitions_dlna_example.csv"

CONFIG_ESP_TLS_INSECURE=y
CONFIG_ESP_TLS_SKIP_SERVER_CERT_VERIFY=y

CONFIG_ESP_SYSTEM_EVENT_TASK_STACK_SIZE=3072
```

## examples/advanced_examples/downmix_pipeline/sdkconfig.defaults
```kconfig
# Override some downmix pipeline defaults




CONFIG_ESP32_DEFAULT_CPU_FREQ_240=y
CONFIG_ESPTOOLPY_FLASHMODE="dio"
CONFIG_ESPTOOLPY_FLASHFREQ_80M=y
CONFIG_ESPTOOLPY_FLASHSIZE_4MB=y
CONFIG_ESPTOOLPY_BAUD_921600B=y
CONFIG_ESPTOOLPY_BAUD=921600
CONFIG_OPTIMIZATION_LEVEL_RELEASE=y
CONFIG_SPIRAM_SUPPORT=y
CONFIG_SPIRAM_BOOT_INIT=y
CONFIG_SPIRAM_USE_MALLOC=y
CONFIG_SPIRAM_TYPE_AUTO=y
CONFIG_SPIRAM_SPEED_80M=y
CONFIG_SPIRAM_MEMTEST=y
CONFIG_SPIRAM_CACHE_WORKAROUND=y
CONFIG_SPIRAM_MALLOC_ALWAYSINTERNAL=16384
CONFIG_WIFI_LWIP_ALLOCATION_FROM_SPIRAM_FIRST=y
CONFIG_SPIRAM_MALLOC_RESERVE_INTERNAL=32768
CONFIG_SPIRAM_ALLOW_BSS_SEG_EXTERNAL_MEMORY=y
CONFIG_FREERTOS_HZ=1000


# Increase default app partition size to accommodate downmix pipeline example
# by providing new partition table in "partitions_downmix_example.csv"
CONFIG_PARTITION_TABLE_CUSTOM=y
CONFIG_PARTITION_TABLE_CUSTOM_FILENAME="partitions_downmix_example.csv"
CONFIG_PARTITION_TABLE_CUSTOM_APP_BIN_OFFSET=0x10000
CONFIG_PARTITION_TABLE_FILENAME="partitions_downmix_example.csv"
CONFIG_APP_OFFSET=0x10000
```

## examples/advanced_examples/downmix_pipeline/sdkconfig.defaults.esp32
```kconfig
CONFIG_IDF_CMAKE=y
CONFIG_IDF_TARGET_ARCH_XTENSA=y
CONFIG_IDF_TARGET="esp32"
CONFIG_IDF_TARGET_ESP32=y
CONFIG_IDF_FIRMWARE_CHIP_ID=0x0000
CONFIG_ESP32_DEFAULT_CPU_FREQ_240=y

#
# SPI RAM config
#
CONFIG_SPIRAM_ALLOW_BSS_SEG_EXTERNAL_MEMORY=y
CONFIG_SPIRAM_TYPE_AUTO=y
CONFIG_SPIRAM_SPEED_80M=y

#
# Audio HAL
#
CONFIG_ESP_LYRAT_V4_3_BOARD=y
```

## examples/advanced_examples/esp_dispatcher_dueros/main/Kconfig.projbuild
```kconfig
menu "Example Configuration"

config WIFI_SSID
    string "WiFi SSID"
    default "myssid"
    help
        SSID (network name) for the example to connect to.

config WIFI_PASSWORD
    string "WiFi Password"
    default "myssid"
    help
        WiFi password (WPA or WPA2) for the example to use.

        Can be left blank if the network has no security set.

choice WIFI_SETTING_TYPE
    prompt "WiFi Setting type"
    default ESP_BLUFI_PROVISIONING
    help
        Select wifi setting method

config ESP_BLUFI_PROVISIONING
    bool "Enable esp blufi provisioning"

config ESP_SMARTCONFIG
    bool "Enable esp smartconfig"

config AIRKISS_ENCRYPT
    bool "Enable airkiss encrypt"

config AIRKISS_APPID
    string "Airkiss APP ID"
    depends on AIRKISS_ENCRYPT
    default "gh_9e2cff3dfa51"
    help
        The airkiss application id.

config AIRKISS_DEVICEID
    string "Airkiss device ID"
    depends on AIRKISS_ENCRYPT
    default "122475"
    help
        The airkiss device id.

config DUER_AIRKISS_KEY
    string "DuerOS airkiss key"
    depends on AIRKISS_ENCRYPT
    default "Enter dueros aes key string"
    help
        The key used to encrypt ssid and password with AES method.

endchoice

endmenu
```

## examples/advanced_examples/flexible_pipeline/sdkconfig.defaults
```kconfig
# Override some flexible pipeline defaults

CONFIG_ESPTOOLPY_FLASHMODE="dio"
CONFIG_ESPTOOLPY_FLASHFREQ_80M=y
CONFIG_ESPTOOLPY_FLASHSIZE_4MB=y
CONFIG_OPTIMIZATION_LEVEL_RELEASE=y
CONFIG_SPIRAM=y
CONFIG_SPIRAM_BOOT_INIT=y
CONFIG_SPIRAM_USE_MALLOC=y
CONFIG_SPIRAM_TYPE_ESPPSRAM32=y
CONFIG_SPIRAM_SPEED_80M=y
CONFIG_SPIRAM_MEMTEST=y
CONFIG_SPIRAM_MALLOC_ALWAYSINTERNAL=16384
CONFIG_SPIRAM_TRY_ALLOCATE_WIFI_LWIP=y
CONFIG_SPIRAM_MALLOC_RESERVE_INTERNAL=32768
CONFIG_FREERTOS_HZ=1000
CONFIG_FREERTOS_ENABLE_BACKWARD_COMPATIBILITY=y
CONFIG_SPIRAM_ALLOW_STACK_EXTERNAL_MEMORY=y
CONFIG_SPIRAM_TRY_ALLOCATE_WIFI_LWIP=y

# Increase default app partition size to accommodate flexible pipeline example
# by providing new partition table in "partitions_flexible_example.csv"
CONFIG_PARTITION_TABLE_CUSTOM=y
CONFIG_PARTITION_TABLE_CUSTOM_FILENAME="partitions_flexible_example.csv"
```

## examples/advanced_examples/http_play_and_save_to_file/sdkconfig.defaults
```kconfig
# Override some http play and save file defaults

CONFIG_ESPTOOLPY_FLASHMODE="dio"
CONFIG_ESPTOOLPY_FLASHFREQ_80M=y
CONFIG_ESPTOOLPY_FLASHSIZE_4MB=y
CONFIG_ESPTOOLPY_BAUD_921600B=y
CONFIG_ESPTOOLPY_BAUD=921600
CONFIG_OPTIMIZATION_LEVEL_RELEASE=y
CONFIG_SPIRAM_SUPPORT=y
CONFIG_SPIRAM_IGNORE_NOTFOUND=y
CONFIG_SPIRAM_BOOT_INIT=y
CONFIG_SPIRAM_USE_MALLOC=y
CONFIG_SPIRAM_TYPE_ESPPSRAM32=y
CONFIG_SPIRAM_SIZE=4194304
CONFIG_SPIRAM_SPEED_80M=y
CONFIG_SPIRAM_MEMTEST=y
CONFIG_SPIRAM_CACHE_WORKAROUND=y
CONFIG_SPIRAM_MALLOC_ALWAYSINTERNAL=16384
CONFIG_WIFI_LWIP_ALLOCATION_FROM_SPIRAM_FIRST=y
CONFIG_SPIRAM_MALLOC_RESERVE_INTERNAL=32768
CONFIG_FREERTOS_HZ=1000

#
# FAT Filesystem support
#
CONFIG_FATFS_CODEPAGE_936=y
CONFIG_FATFS_LFN_HEAP=y
CONFIG_FATFS_API_ENCODING_ANSI_OEM=y
CONFIG_FATFS_FS_LOCK=3
CONFIG_FATFS_TIMEOUT_MS=10000
CONFIG_FATFS_PER_FILE_CACHE=y


# Increase default app partition size to accommodate http play and save file example
# by providing new partition table in "partitions_play_and_save_file.csv"
CONFIG_PARTITION_TABLE_CUSTOM=y
CONFIG_PARTITION_TABLE_CUSTOM_FILENAME="partitions_play_and_save_file.csv"
CONFIG_PARTITION_TABLE_CUSTOM_APP_BIN_OFFSET=0x10000
CONFIG_PARTITION_TABLE_FILENAME="partitions_play_and_save_file.csv"
CONFIG_APP_OFFSET=0x10000
```

## examples/advanced_examples/multi-room/sdkconfig.defaults
```kconfig
#
# Serial flasher config
#
CONFIG_ESPTOOLPY_FLASHMODE_QIO=y
CONFIG_ESPTOOLPY_FLASHFREQ_80M=y
CONFIG_ESPTOOLPY_FLASHSIZE_4MB=y
CONFIG_OPTIMIZATION_LEVEL_RELEASE=y
CONFIG_ESPTOOLPY_FLASHSIZE_4MB=y

CONFIG_FREERTOS_ENABLE_BACKWARD_COMPATIBILITY=y

#
# SPI RAM config
#
CONFIG_SPIRAM=y
CONFIG_SPIRAM_BOOT_INIT=y
CONFIG_SPIRAM_USE_MALLOC=y
CONFIG_SPIRAM_SPEED_80M=y
CONFIG_SPIRAM_ALLOW_BSS_SEG_EXTERNAL_MEMORY=y
CONFIG_SPIRAM_ALLOW_STACK_EXTERNAL_MEMORY=y
CONFIG_SPIRAM_TRY_ALLOCATE_WIFI_LWIP=y
CONFIG_SPIRAM_TRY_ALLOCATE_WIFI_LWIP=y

#
# UDP
#
CONFIG_LWIP_MAX_UDP_PCBS=128
CONFIG_LWIP_UDP_RECVMBOX_SIZE=64
CONFIG_UDP_RECVMBOX_SIZE=64

#
# FreeRTOS
#
CONFIG_FREERTOS_HZ=1000

# Increase default app partition size to accommodate console example
# by providing new partition table in "partitions_mrm_example.csv"
CONFIG_PARTITION_TABLE_CUSTOM=y
CONFIG_PARTITION_TABLE_CUSTOM_FILENAME="partitions_mrm_example.csv"

CONFIG_ESP_TLS_INSECURE=y
CONFIG_ESP_TLS_SKIP_SERVER_CERT_VERIFY=y

CONFIG_ESP_SYSTEM_EVENT_TASK_STACK_SIZE=3072
```

## examples/advanced_examples/nvs_dispatcher/sdkconfig.defaults
```kconfig
#
# ESP32-specific
#
CONFIG_SPIRAM=y

#
# SPI RAM config
#
CONFIG_SPIRAM_ALLOW_STACK_EXTERNAL_MEMORY=y
CONFIG_SPIRAM_TRY_ALLOCATE_WIFI_LWIP=y
CONFIG_FREERTOS_ENABLE_BACKWARD_COMPATIBILITY=y
```

## examples/advanced_examples/record_while_play/main/Kconfig.projbuild
```kconfig
menu "Example Configuration"

config WIFI_SSID
    string "WiFi SSID"
	default "myssid"
	help
		SSID (network name) for the example to connect to.

config WIFI_PASSWORD
    string "WiFi Password"
    default "mypassword"
	help
		WiFi password (WPA or WPA2) for the example to use.

		Can be left blank if the network has no security set.


choice INPUT_STREAM
	prompt "Input stream selection"
	default INPUT_STREAM_ASR
	help 
		Choose the input stream

config INPUT_STREAM_ASR
	bool "record for ASR"
config INPUT_STREAM_FILE
	bool "record and save to sdcard"
endchoice

choice OUTPUT_STREAM
	prompt "Output stream selection"
	default OUTPUT_STREAM_HTTP
	help 
		Choose the output stream
config OUTPUT_STREAM_HTTP
	bool "play music from http"
config OUTPUT_STREAM_SDCARD
	bool "play music from sdacrd"
endchoice

endmenu
```

## examples/advanced_examples/record_while_play/sdkconfig.defaults
```kconfig
#
# Serial flasher config
#
CONFIG_FLASHMODE_QIO=y
CONFIG_ESPTOOLPY_FLASHMODE="qio"
CONFIG_ESPTOOLPY_FLASHFREQ_80M=y
CONFIG_ESPTOOLPY_FLASHFREQ="80m"
CONFIG_ESPTOOLPY_FLASHSIZE_4MB=y
CONFIG_ESPTOOLPY_FLASHSIZE="4MB"

#
# partition
#
CONFIG_PARTITION_TABLE_CUSTOM=y
CONFIG_PARTITION_TABLE_FILENAME="partitions.csv"

#
# FreeRTOS
#
CONFIG_FREERTOS_HZ=1000

#
# ESP32-specific
#
CONFIG_ESP32_DEFAULT_CPU_FREQ_240=y

#
# SPI RAM
#
CONFIG_SPIRAM_SUPPORT=y
CONFIG_SPIRAM_BOOT_INIT=y
CONFIG_SPIRAM_SPEED_80M=y


#
# ESP Speech Recognition
#
CONFIG_SR_MODEL_WN5_QUANT=y
CONFIG_SR_WN5_HILEXIN=y
CONFIG_SINGLE_RECOGNITION=y
CONFIG_SR_CHINESE=y
CONFIG_SPEECH_COMMANDS_NUM=20
```

## examples/advanced_examples/rtmp/sdkconfig.defaults
```kconfig
#
# Flash
#
CONFIG_ESPTOOLPY_FLASHMODE="dio"
CONFIG_ESPTOOLPY_FLASHFREQ_80M=y
CONFIG_ESPTOOLPY_FLASHMODE="dio"
CONFIG_ESPTOOLPY_FLASHFREQ="80m"
CONFIG_ESPTOOLPY_FLASHSIZE_DETECT=y
CONFIG_ESPTOOLPY_COMPRESSED=y
CONFIG_ESPTOOLPY_FLASHSIZE_4MB=y

# Increase default app partition size to accommodate rtmp example
# Partitions
#
CONFIG_PARTITION_TABLE_CUSTOM=y
CONFIG_PARTITION_TABLE_CUSTOM_FILENAME="partitions_rtmp_example.csv"
CONFIG_PARTITION_TABLE_CUSTOM_APP_BIN_OFFSET=0x10000
CONFIG_PARTITION_TABLE_FILENAME="partitions_rtmp_example.csv"
CONFIG_APP_OFFSET=0x10000

#
# Wi-Fi
#
CONFIG_ESP32_WIFI_DYNAMIC_RX_BUFFER_NUM=64
CONFIG_ESP32_WIFI_STATIC_TX_BUFFER_NUM=32
CONFIG_ESP32_WIFI_TASK_PINNED_TO_CORE_0=y

#
# LWIP
#
CONFIG_LWIP_TCPIP_RECVMBOX_SIZE=64

#
# TCP
#
CONFIG_LWIP_TCP_SND_BUF_DEFAULT=65535
CONFIG_LWIP_TCP_WND_DEFAULT=65535
CONFIG_LWIP_TCP_RECVMBOX_SIZE=64

#
# Camera configuration
#
CONFIG_SCCB_HARDWARE_I2C_PORT0=y
CONFIG_CAMERA_TASK_STACK_SIZE=4096
```
