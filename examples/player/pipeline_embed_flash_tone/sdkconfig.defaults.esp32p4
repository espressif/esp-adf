## examples/player/pipeline_embed_flash_tone/sdkconfig.defaults.esp32p4
```kconfig
CONFIG_IDF_CMAKE=y
CONFIG_IDF_TARGET_ARCH_RISCV=y
CONFIG_IDF_TARGET_ARCH="riscv"
CONFIG_IDF_TARGET="esp32p4"
CONFIG_IDF_TARGET_ESP32P4=y
CONFIG_ESP32P4_SELECTS_REV_LESS_V3=n
CONFIG_ESP_DEFAULT_CPU_FREQ_MHZ_360=y
CONFIG_ESP_DEFAULT_CPU_FREQ_MHZ=360
CONFIG_IDF_EXPERIMENTAL_FEATURES=y

#
# SPI RAM config
#
CONFIG_SPIRAM=y
CONFIG_SPIRAM_SPEED_200M=y
CONFIG_SPIRAM_ALLOW_STACK_EXTERNAL_MEMORY=y

#
# Audio HAL
#
CONFIG_ESP32_P4_FUNCTION_EV_BOARD=y

#
# Console: ESP32-P4-Function-EV is driven over USB-Serial/JTAG in CI (/dev/ttyACM*),
# so route the console there instead of the UART bridge (/dev/ttyUSB*).
#
CONFIG_ESP_CONSOLE_USB_SERIAL_JTAG=y
```

## examples/player/pipeline_flash_tone/sdkconfig.defaults
```kconfig
# Override some Flash defaults


# by providing new partition table in "partitions_flash_tone.csv"
CONFIG_ESPTOOLPY_FLASHSIZE_4MB=y

CONFIG_PARTITION_TABLE_CUSTOM=y
CONFIG_PARTITION_TABLE_CUSTOM_FILENAME="partitions_flash_tone.csv"

CONFIG_FREERTOS_ENABLE_BACKWARD_COMPATIBILITY=y
```

## examples/player/pipeline_flash_tone/sdkconfig.defaults.esp32c3
```kconfig
CONFIG_IDF_CMAKE=y
CONFIG_IDF_TARGET_ARCH_RISCV=y
CONFIG_IDF_TARGET="esp32c3"
CONFIG_IDF_TARGET_ESP32C3=y
CONFIG_IDF_FIRMWARE_CHIP_ID=0x0005

#
# Audio HAL
#
CONFIG_ESP32_C3_LYRA_V2_BOARD=y
```

## examples/player/pipeline_http_mp3/sdkconfig.defaults
```kconfig
CONFIG_PARTITION_TABLE_CUSTOM=y
CONFIG_PARTITION_TABLE_CUSTOM_FILENAME="partitions.csv"
CONFIG_ESPTOOLPY_FLASHSIZE_4MB=y

CONFIG_ESP_TLS_INSECURE=y
CONFIG_ESP_TLS_SKIP_SERVER_CERT_VERIFY=y

CONFIG_ESP_SYSTEM_EVENT_TASK_STACK_SIZE=3072
CONFIG_FREERTOS_ENABLE_BACKWARD_COMPATIBILITY=y
```

## examples/player/pipeline_http_mp3/sdkconfig.defaults.esp32s2
```kconfig
CONFIG_IDF_CMAKE=y
CONFIG_IDF_TARGET_ARCH_XTENSA=y
CONFIG_IDF_TARGET="esp32s2"
CONFIG_IDF_TARGET_ESP32S2=y
CONFIG_IDF_FIRMWARE_CHIP_ID=0x0002

#
# SPI RAM config
#
CONFIG_ESP32S2_SPIRAM_SUPPORT=y
CONFIG_SPIRAM_MALLOC_ALWAYSINTERNAL=1024
CONFIG_SPIRAM_BOOT_INIT=y
CONFIG_SPIRAM_ALLOW_STACK_EXTERNAL_MEMORY=y
CONFIG_SPIRAM_USE_MALLOC=y
CONFIG_SPIRAM_TRY_ALLOCATE_WIFI_LWIP=y
CONFIG_SPIRAM_TYPE_AUTO=y

#
# Audio HAL
#
CONFIG_ESP32_S2_KALUGA_1_V1_2_BOARD=y
```

## examples/player/pipeline_http_select_decoder/sdkconfig.defaults
```kconfig
# Enable SPIRAM to accommodate AAC decoder
CONFIG_SPIRAM_SUPPORT=y

# Increase default app partition size to accommodate SPIRAM
# by providing new partition table in "partitions_http_select_decoder_example.csv"
CONFIG_PARTITION_TABLE_CUSTOM=y
CONFIG_PARTITION_TABLE_CUSTOM_FILENAME="partitions_http_select_decoder_example.csv"
CONFIG_PARTITION_TABLE_CUSTOM_APP_BIN_OFFSET=0x10000
CONFIG_PARTITION_TABLE_FILENAME="partitions_http_select_decoder_example.csv"
CONFIG_APP_OFFSET=0x10000
```

## examples/player/pipeline_http_select_decoder/sdkconfig.defaults.esp32
```kconfig
# Override some defaults

#
# Serial flasher config
#
CONFIG_FLASHMODE_QIO=y
CONFIG_ESPTOOLPY_FLASHSIZE_4MB=y
CONFIG_ESPTOOLPY_FLASHFREQ_80M=y

#
# ESP32-specific
#
CONFIG_ESP32_DEFAULT_CPU_FREQ_240=y
CONFIG_ESP32_DEFAULT_CPU_FREQ_MHZ=240
CONFIG_SPIRAM_SUPPORT=y

#
# Audio HAL
#
CONFIG_ESP_LYRAT_V4_3_BOARD=y
# end of Audio HAL
```

## examples/player/pipeline_living_stream/sdkconfig.defaults
```kconfig
# Override some defaults

#
# Serial flasher config
#
CONFIG_FLASHMODE_QIO=y
CONFIG_ESPTOOLPY_BAUD_2MB=y
CONFIG_ESPTOOLPY_FLASHSIZE_4MB=y
CONFIG_ESPTOOLPY_FLASHFREQ_80M=y

CONFIG_FREERTOS_ENABLE_BACKWARD_COMPATIBILITY=y

#
# ESP32-specific
#
CONFIG_ESP32_DEFAULT_CPU_FREQ_240=y
CONFIG_ESP32_DEFAULT_CPU_FREQ_MHZ=240
CONFIG_SPIRAM_SUPPORT=y

#
# SPI RAM config
#
CONFIG_SPIRAM_BOOT_INIT=y
CONFIG_SPIRAM_USE_MALLOC=y
CONFIG_SPIRAM_IGNORE_NOTFOUND=y
CONFIG_SPIRAM_SPEED_80M=y
CONFIG_SPIRAM_ALLOW_STACK_EXTERNAL_MEMORY=y
CONFIG_SPIRAM_TRY_ALLOCATE_WIFI_LWIP=y

# Increase default app partition size to accommodate living example
# by providing new partition table in "partitions_living_example.csv"
CONFIG_PARTITION_TABLE_CUSTOM=y
CONFIG_PARTITION_TABLE_CUSTOM_FILENAME="partitions_living_example.csv"
CONFIG_PARTITION_TABLE_CUSTOM_APP_BIN_OFFSET=0x10000
CONFIG_PARTITION_TABLE_FILENAME="partitions_living_example.csv"
CONFIG_APP_OFFSET=0x10000

CONFIG_ESP_TLS_INSECURE=y
CONFIG_ESP_TLS_SKIP_SERVER_CERT_VERIFY=y

CONFIG_ESP_SYSTEM_EVENT_TASK_STACK_SIZE=3072
```

## examples/player/pipeline_living_stream/sdkconfig.defaults.esp32c6
```kconfig
#
# Default config
#
CONFIG_IDF_TARGET_ARCH_RISCV=y
CONFIG_IDF_TARGET_ARCH="riscv"
CONFIG_IDF_TARGET="esp32c6"
CONFIG_IDF_TARGET_ESP32C6=y
CONFIG_IDF_FIRMWARE_CHIP_ID=0x000D

#
# Audio HAL
#
CONFIG_ESP32_C6_DEVKIT_BOARD=y
```

## examples/player/pipeline_loop_playback_without_gap/main/Kconfig.projbuild
```kconfig
menu "Example Configuration"

choice AUDIO_DECODER_SUPPORT
    prompt "Audio Decoder"
    default AUDIO_SUPPORT_MP3_DECODER
    help
        Select an audio decoder to playback music

config AUDIO_SUPPORT_MP3_DECODER
    bool "ESP-MP3-DECODER"

config AUDIO_SUPPORT_WAV_DECODER
    bool "ESP-WAV-DECODER"

config AUDIO_SUPPORT_AAC_DECODER
    bool "ESP-AAC-DECODER"

endchoice

endmenu
```

## examples/player/pipeline_loop_playback_without_gap/sdkconfig.defaults
```kconfig
#
# Bootloader config
#
CONFIG_BOOTLOADER_OFFSET_IN_FLASH=0x1000
CONFIG_BOOTLOADER_COMPILER_OPTIMIZATION_SIZE=y

CONFIG_FREERTOS_ENABLE_BACKWARD_COMPATIBILITY=y

#
# Serial flasher config
#
CONFIG_ESPTOOLPY_FLASHSIZE_DETECT=y
CONFIG_ESPTOOLPY_BEFORE_RESET=y
# end of Serial flasher config

#
# Partition Table
#
CONFIG_PARTITION_TABLE_SINGLE_APP=y
CONFIG_PARTITION_TABLE_OFFSET=0x8000
CONFIG_PARTITION_TABLE_MD5=y
# end of Partition Table

#
# FAT Filesystem support
#
CONFIG_FATFS_CODEPAGE_936=y
CONFIG_FATFS_CODEPAGE=936
CONFIG_FATFS_LFN_HEAP=y
CONFIG_FATFS_MAX_LFN=255
CONFIG_FATFS_API_ENCODING_UTF_8=y
CONFIG_FATFS_FS_LOCK=0
CONFIG_FATFS_TIMEOUT_MS=10000
CONFIG_FATFS_PER_FILE_CACHE=y
# end of FAT Filesystem support
```

## examples/player/pipeline_play_mp3_with_dac_or_pwm/main/Kconfig.projbuild
```kconfig
menu "Example Configuration"

config PWM_RIGHT_OUTPUT_GPIO_NUM
    int "PWM Stream Right Output GPIO NUM"
    default 18
    help
        GPIO number to use for PWM stream driver.

config PWM_LEFT_OUTPUT_GPIO_NUM
    int "PWM Stream Left Output GPIO NUM"
    default 23
    help
        GPIO number to use for PWM stream driver.

endmenu
```

## examples/player/pipeline_play_mp3_with_dac_or_pwm/sdkconfig.defaults
```kconfig
#
# Bootloader config
#
CONFIG_BOOTLOADER_OFFSET_IN_FLASH=0x1000
CONFIG_BOOTLOADER_COMPILER_OPTIMIZATION_SIZE=y

CONFIG_FREERTOS_ENABLE_BACKWARD_COMPATIBILITY=y

#
# Serial flasher config
#
CONFIG_ESPTOOLPY_FLASHSIZE_DETECT=y
CONFIG_ESPTOOLPY_BEFORE_RESET=y
# end of Serial flasher config

#
# Partition Table
#
CONFIG_PARTITION_TABLE_SINGLE_APP=y
CONFIG_PARTITION_TABLE_OFFSET=0x8000
CONFIG_PARTITION_TABLE_MD5=y
# end of Partition Table
```

## examples/player/pipeline_play_sdcard_muisc/main/Kconfig.projbuild
```kconfig
menu "Example Configuration"

choice AUDIO_DECODER_SUPPORT
    prompt "Audio Decoder"
    default AUDIO_SUPPORT_MP3_DECODER
    help
        Select an audio decoder to decode sdcard music

config AUDIO_SUPPORT_TS_DECODER
    bool "ESP-TS-DECODER"

config AUDIO_SUPPORT_M4A_DECODER
    bool "ESP-M4A-DECODER"

config AUDIO_SUPPORT_MP3_DECODER
    bool "ESP-MP3-DECODER"

config AUDIO_SUPPORT_MP4_DECODER
    bool "ESP-MP4-DECODER"

config AUDIO_SUPPORT_AMRNB_DECODER
    bool "ESP-AMRNB-DECODER"

config AUDIO_SUPPORT_AMRWB_DECODER
    bool "ESP-AMRWB-DECODER"

config AUDIO_SUPPORT_WAV_DECODER
    bool "ESP-WAV-DECODER"

config AUDIO_SUPPORT_OPUS_DECODER
    bool "ESP-OPUS-DECODER"

config AUDIO_SUPPORT_OGG_DECODER
    bool "ESP-OGG-DECODER"

config AUDIO_SUPPORT_AAC_DECODER
    bool "ESP-AAC-DECODER"

config AUDIO_SUPPORT_FLAC_DECODER
    bool "ESP-FLAC-DECODER"

endchoice

endmenu
```

## examples/player/pipeline_play_sdcard_music/sdkconfig.defaults.esp32p4
```kconfig
CONFIG_IDF_CMAKE=y
CONFIG_IDF_TARGET_ARCH_RISCV=y
CONFIG_IDF_TARGET_ARCH="riscv"
CONFIG_IDF_TARGET="esp32p4"
CONFIG_IDF_TARGET_ESP32P4=y
CONFIG_ESP_DEFAULT_CPU_FREQ_MHZ_360=y
CONFIG_ESP_DEFAULT_CPU_FREQ_MHZ=360
CONFIG_IDF_EXPERIMENTAL_FEATURES=y

#
# SPI RAM config
#
CONFIG_SPIRAM=y
CONFIG_SPIRAM_SPEED_200M=y
CONFIG_SPIRAM_ALLOW_STACK_EXTERNAL_MEMORY=y

#
# Audio HAL
#
CONFIG_ESP32_P4_FUNCTION_EV_BOARD=y
```

## examples/player/pipeline_sdcard_mp3_control/sdkconfig.defaults
```kconfig
# CONFIG_FATFS_CODEPAGE_DYNAMIC is not set
# CONFIG_FATFS_CODEPAGE_437 is not set
# CONFIG_FATFS_CODEPAGE_720 is not set
# CONFIG_FATFS_CODEPAGE_737 is not set
# CONFIG_FATFS_CODEPAGE_771 is not set
# CONFIG_FATFS_CODEPAGE_775 is not set
# CONFIG_FATFS_CODEPAGE_850 is not set
# CONFIG_FATFS_CODEPAGE_852 is not set
# CONFIG_FATFS_CODEPAGE_855 is not set
# CONFIG_FATFS_CODEPAGE_857 is not set
# CONFIG_FATFS_CODEPAGE_860 is not set
# CONFIG_FATFS_CODEPAGE_861 is not set
# CONFIG_FATFS_CODEPAGE_862 is not set
# CONFIG_FATFS_CODEPAGE_863 is not set
# CONFIG_FATFS_CODEPAGE_864 is not set
# CONFIG_FATFS_CODEPAGE_865 is not set
# CONFIG_FATFS_CODEPAGE_866 is not set
# CONFIG_FATFS_CODEPAGE_869 is not set
# CONFIG_FATFS_CODEPAGE_932 is not set
CONFIG_FATFS_CODEPAGE_936=y
# CONFIG_FATFS_CODEPAGE_949 is not set
# CONFIG_FATFS_CODEPAGE_950 is not set
CONFIG_FATFS_CODEPAGE=936
# CONFIG_FATFS_LFN_NONE is not set
CONFIG_FATFS_LFN_HEAP=y
# CONFIG_FATFS_LFN_STACK is not set
CONFIG_FATFS_MAX_LFN=255
# CONFIG_FATFS_API_ENCODING_ANSI_OEM is not set
# CONFIG_FATFS_API_ENCODING_UTF_16 is not set
CONFIG_FATFS_API_ENCODING_UTF_8=y
CONFIG_FATFS_FS_LOCK=0
CONFIG_FATFS_TIMEOUT_MS=10000
CONFIG_FATFS_PER_FILE_CACHE=y
```

## examples/player/pipeline_sdcard_mp3_control/sdkconfig.defaults.esp32
```kconfig
CONFIG_IDF_CMAKE=y
CONFIG_IDF_TARGET_ARCH_XTENSA=y
CONFIG_IDF_TARGET="esp32"
CONFIG_IDF_TARGET_ESP32=y
CONFIG_IDF_FIRMWARE_CHIP_ID=0x0000

#
# Audio HAL
#
CONFIG_ESP_LYRAT_V4_3_BOARD=y

#
# SPI RAM config
#
CONFIG_SPIRAM=y
CONFIG_SPIRAM_BOOT_INIT=y
CONFIG_SPIRAM_USE_MALLOC=y
CONFIG_SPIRAM_SPEED_80M=y
CONFIG_SPIRAM_ALLOW_STACK_EXTERNAL_MEMORY=y
CONFIG_SPIRAM_TRY_ALLOCATE_WIFI_LWIP=y
```

## examples/player/pipeline_spiffs_mp3/sdkconfig.defaults
```kconfig
# Override some Spiffs defaults

#
# Serial flasher config
#
CONFIG_ESPTOOLPY_FLASHMODE_QIO=y
CONFIG_ESPTOOLPY_FLASHFREQ_80M=y
CONFIG_ESPTOOLPY_FLASHSIZE_4MB=y

CONFIG_FREERTOS_ENABLE_BACKWARD_COMPATIBILITY=y

#
# Partition Table
#
CONFIG_PARTITION_TABLE_CUSTOM=y
CONFIG_PARTITION_TABLE_CUSTOM_FILENAME="partitions.csv"
CONFIG_PARTITION_TABLE_FILENAME="partitions.csv"
CONFIG_PARTITION_TABLE_OFFSET=0x8000
CONFIG_PARTITION_TABLE_MD5=y
```

## examples/protocols/components/av_record/Kconfig.projbuild
```kconfig
menu "AV Record Configuration"

config DVP_CAMERA_SUPPORT
    bool "Support for DVP camera"
    default y

config USB_CAMERA_SUPPORT
    bool "Support for USB camera"
    default n

config USB_CAMERA_POWER_GPIO
    int
    prompt "USB Camera Power GPIO" if USB_CAMERA_SUPPORT
    depends on USB_CAMERA_SUPPORT
    default 48
    range -1 64
    help
        Set USB Camera Power GPIO, -1 for not used.

config USB_CAMERA_FRAME_BUFFER_SIZE
    int
    prompt "USB Camera Frame Buffer Size" if USB_CAMERA_SUPPORT
    depends on USB_CAMERA_SUPPORT
    default 32768
    range 4096 128000
    help
        Set USB Camera frame buffer size.

endmenu
```

## examples/protocols/esp-rtc/main/Kconfig.projbuild
```kconfig
menu "ESP-RTC App Configuration"

config WIFI_SSID
    string "WiFi SSID"
    default "myssid"
    help
    SSID (network name) for the example to connect to.

config WIFI_PASSWORD
    string "WiFi Password"
    default "mypassword"
    help
    WiFi password (WPA or WPA2) for the example to use.

config SIP_URI
    string "SIP URI"
    default "udp://100:100@192.168.1.123:5060"
    help
    The SIP URI with username, password, address, port and transport type

endmenu
```

## examples/protocols/esp-rtc/sdkconfig.defaults.esp32
```kconfig
#
# ESP32-specific
#
CONFIG_ESP32_DEFAULT_CPU_FREQ_240=y
CONFIG_ESP32_DEFAULT_CPU_FREQ_MHZ=240
```

## examples/protocols/esp-rtc/sdkconfig.defaults.esp32s3
```kconfig
CONFIG_IDF_TARGET="esp32s3"
CONFIG_IDF_TARGET_ESP32S3=y

#
# Serial flasher config
#
CONFIG_ESPTOOLPY_FLASHFREQ_80M=y
CONFIG_ESPTOOLPY_FLASHFREQ="80m"

#
# ESP32S3-Specific
#
CONFIG_ESP32S3_DEFAULT_CPU_FREQ_240=y
CONFIG_ESP32S3_DEFAULT_CPU_FREQ_MHZ=240

#
# Audio HAL
#
CONFIG_ESP32_S3_KORVO2_V3_BOARD=y

#
# SPI RAM config
#
CONFIG_ESP32S3_SPIRAM_SUPPORT=y
CONFIG_SPIRAM_MODE_OCT=y
CONFIG_SPIRAM_TYPE_AUTO=y
CONFIG_SPIRAM_SPEED_80M=y
CONFIG_SPIRAM_TRY_ALLOCATE_WIFI_LWIP=y
```

## examples/protocols/esp-rtsp/sdkconfig.defaults.esp32
```kconfig
#
# ESP32-specific
#
CONFIG_ESP32_DEFAULT_CPU_FREQ_240=y
CONFIG_ESP32_DEFAULT_CPU_FREQ_MHZ=240

#
# SPI RAM config
#
CONFIG_SPIRAM=y
CONFIG_SPIRAM_BOOT_INIT=y
CONFIG_SPIRAM_USE_MALLOC=y
CONFIG_SPIRAM_SPEED_80M=y
CONFIG_SPIRAM_RODATA=y
CONFIG_SPIRAM_FETCH_INSTRUCTIONS=y
CONFIG_SPIRAM_MALLOC_ALWAYSINTERNAL=2048
CONFIG_SPIRAM_MALLOC_RESERVE_INTERNAL=18432
CONFIG_SPIRAM_ALLOW_BSS_SEG_EXTERNAL_MEMORY=y
CONFIG_SPIRAM_ALLOW_STACK_EXTERNAL_MEMORY=y
CONFIG_SPIRAM_TRY_ALLOCATE_WIFI_LWIP=y
```
