## examples/protocols/rtmp/main/Kconfig.projbuild
```kconfig
menu "RTMP APP Configuration"

choice RTMP_APP_MODE
    prompt "Choose RTMP APP Work Mode"
    default RTMP_APP_MODE_PUSHER
    help
        RTMP support PUSHER, SOURCE, SERVER and PUSHER_SERVER mode.
        In PUSHER_SERVER mode it both supports PUSHER and SERVER.

config RTMP_APP_MODE_PUSHER
    bool "PUSHER only"

config RTMP_APP_MODE_SOURCE
    bool "SOURCE only"

config RTMP_APP_MODE_SERVER
    bool "SERVER only"

config RTMP_APP_MODE_PUSHER_SERVER
    bool "SERVER and PUSHER"

endchoice

config WIFI_SSID
    string "WiFi SSID"
    default "my_ssid"
    help
    SSID (network name) for the example to connect to.

config WIFI_PASSWORD
    string "WiFi Password"
    default "my_password"
    help
    WiFi password (WPA or WPA2) for the example to use.

config RTMP_SERVER_URI
    string "RTMP Server URI"
    default "rtmp://127.0.0.1:1935/live/stream"
    help
    The RTMP server URI with port, app name, stream name

endmenu
```

## examples/protocols/rtmp/sdkconfig.defaults
```kconfig
#
# Flash
#
CONFIG_ESPTOOLPY_FLASHMODE="dio"
CONFIG_ESPTOOLPY_FLASHFREQ_80M=y
CONFIG_ESPTOOLPY_FLASHMODE="dio"
CONFIG_ESPTOOLPY_FLASHFREQ="80m"
CONFIG_ESPTOOLPY_FLASHSIZE_DETECT=y
CONFIG_ESPTOOLPY_COMPRESSED=y
CONFIG_ESPTOOLPY_FLASHSIZE_4MB=y

CONFIG_FREERTOS_ENABLE_BACKWARD_COMPATIBILITY=y

# Increase default app partition size to accommodate rtmp example
# Partitions
#
CONFIG_PARTITION_TABLE_CUSTOM=y
CONFIG_PARTITION_TABLE_CUSTOM_FILENAME="partitions_rtmp_example.csv"
CONFIG_PARTITION_TABLE_CUSTOM_APP_BIN_OFFSET=0x10000
CONFIG_PARTITION_TABLE_FILENAME="partitions_rtmp_example.csv"
CONFIG_APP_OFFSET=0x10000

#
# Wi-Fi
#
CONFIG_ESP32_WIFI_DYNAMIC_RX_BUFFER_NUM=64
CONFIG_ESP32_WIFI_STATIC_TX_BUFFER_NUM=32
CONFIG_ESP32_WIFI_TASK_PINNED_TO_CORE_0=y
CONFIG_ESP32_WIFI_STATIC_RX_BUFFER_NUM=16
CONFIG_ESP32_WIFI_DYNAMIC_RX_BUFFER_NUM=128
CONFIG_ESP32_WIFI_STATIC_TX_BUFFER_NUM=16
CONFIG_ESP32_WIFI_TX_BA_WIN=32
CONFIG_ESP32_WIFI_RX_BA_WIN=32

#
# LWIP
#
CONFIG_LWIP_TCPIP_RECVMBOX_SIZE=64

#
# TCP
#
CONFIG_LWIP_TCP_SND_BUF_DEFAULT=65535
CONFIG_LWIP_TCP_WND_DEFAULT=65535
CONFIG_LWIP_TCP_RECVMBOX_SIZE=64

#
# Camera configuration
#
CONFIG_SCCB_HARDWARE_I2C_PORT0=y
CONFIG_CAMERA_TASK_STACK_SIZE=4096


#
# Optimize
#
CONFIG_COMPILER_OPTIMIZATION_PERF=y

#
# SPIRam
#
CONFIG_SPIRAM_SPEED_80M=y
CONFIG_SPIRAM_TRY_ALLOCATE_WIFI_LWIP=y
CONFIG_SPIRAM_ALLOW_STACK_EXTERNAL_MEMORY=y


#
# FreeRTOS
#
CONFIG_FREERTOS_HZ=1000
CONFIG_FREERTOS_USE_TRACE_FACILITY=y
CONFIG_FREERTOS_USE_STATS_FORMATTING_FUNCTIONS=y
CONFIG_FREERTOS_VTASKLIST_INCLUDE_COREID=y
CONFIG_FREERTOS_GENERATE_RUN_TIME_STATS=y
CONFIG_FREERTOS_RUN_TIME_STATS_USING_ESP_TIMER=y
CONFIG_FREERTOS_TASK_FUNCTION_WRAPPER=y

#
# Mbedtls
#
CONFIG_MBEDTLS_EXTERNAL_MEM_ALLOC=y
CONFIG_ESP_TLS_SERVER=y
CONFIG_ESP_TLS_INSECURE=y
CONFIG_ESP_TLS_SKIP_SERVER_CERT_VERIFY=y
```

## examples/protocols/voip/sdkconfig.defaults
```kconfig
# Serial flash
CONFIG_FLASHMODE_QIO=y
CONFIG_ESPTOOLPY_FLASHFREQ_80M=y
CONFIG_ESPTOOLPY_FLASHSIZE_4MB=y
CONFIG_SPI_FLASH_ROM_IMPL=y

CONFIG_FREERTOS_ENABLE_BACKWARD_COMPATIBILITY=y

#
# Partition Table
#
CONFIG_PARTITION_TABLE_CUSTOM=y
CONFIG_PARTITION_TABLE_CUSTOM_FILENAME="partitions_voip_example.csv"
CONFIG_PARTITION_TABLE_FILENAME="partitions_voip_example.csv"

#
# Wi-Fi
#
CONFIG_ESP_WIFI_STATIC_RX_BUFFER_NUM=9
CONFIG_ESP_WIFI_DYNAMIC_RX_BUFFER_NUM=128
CONFIG_ESP_WIFI_STATIC_TX_BUFFER_NUM=9
CONFIG_ESP_WIFI_IRAM_OPT=n
CONFIG_ESP_WIFI_RX_IRAM_OPT=n
CONFIG_MBEDTLS_EXTERNAL_MEM_ALLOC=y

#
# LWIP
#
CONFIG_UDP_RECVMBOX_SIZE=64
CONFIG_LWIP_MAX_UDP_PCBS=64
CONFIG_LWIP_TCP_SND_BUF_DEFAULT=65535
CONFIG_LWIP_TCP_WND_DEFAULT=65535
CONFIG_LWIP_TCP_RECVMBOX_SIZE=64
CONFIG_LWIP_TCPIP_RECVMBOX_SIZE=64

#
# ESP Speech Recognition
#
CONFIG_MODEL_IN_FLASH=y
CONFIG_AFE_INTERFACE_V1=y
# end of ESP Speech Recognition

#
# FreeRTOS
#
CONFIG_FREERTOS_HZ=1000
CONFIG_FREERTOS_USE_TRACE_FACILITY=y
CONFIG_FREERTOS_USE_STATS_FORMATTING_FUNCTIONS=y
CONFIG_FREERTOS_VTASKLIST_INCLUDE_COREID=y
CONFIG_FREERTOS_GENERATE_RUN_TIME_STATS=y
CONFIG_FREERTOS_PLACE_FUNCTIONS_INTO_FLASH=y

#
# Certificate Bundle
#
# CONFIG_MBEDTLS_ROM_MD5 is not set
CONFIG_ESP_TLS_INSECURE=y
CONFIG_ESP_TLS_SKIP_SERVER_CERT_VERIFY=y

#
# Other
#
CONFIG_ESP_SYSTEM_EVENT_TASK_STACK_SIZE=3072
CONFIG_CAMERA_CONVERTER_ENABLED=y
```

## examples/protocols/voip/sdkconfig.defaults.esp32
```kconfig
CONFIG_IDF_CMAKE=y
CONFIG_IDF_TARGET_ARCH_XTENSA=y
CONFIG_IDF_TARGET="esp32"
CONFIG_IDF_TARGET_ESP32=y
CONFIG_IDF_FIRMWARE_CHIP_ID=0x0000

#
# Audio HAL
#
CONFIG_ESP_LYRAT_V4_3_BOARD=y

#
# ESP32-specific
#
CONFIG_ESP32_DEFAULT_CPU_FREQ_240=y
CONFIG_ESP32_DEFAULT_CPU_FREQ_MHZ=240

#
# SPI RAM config
#
CONFIG_SPIRAM=y
CONFIG_SPIRAM_BOOT_INIT=y
CONFIG_SPIRAM_USE_MALLOC=y
CONFIG_SPIRAM_SPEED_80M=y
CONFIG_SPIRAM_MALLOC_ALWAYSINTERNAL=2048
CONFIG_SPIRAM_MALLOC_RESERVE_INTERNAL=18432
CONFIG_SPIRAM_ALLOW_BSS_SEG_EXTERNAL_MEMORY=y
CONFIG_SPIRAM_ALLOW_STACK_EXTERNAL_MEMORY=y
CONFIG_SPIRAM_TRY_ALLOCATE_WIFI_LWIP=y
```

## examples/protocols/voip/sdkconfig.defaults.esp32s3
```kconfig
CONFIG_IDF_TARGET="esp32s3"
CONFIG_IDF_TARGET_ESP32S3=y

#
# Serial flasher config
#
CONFIG_ESPTOOLPY_FLASHFREQ_80M=y
CONFIG_ESPTOOLPY_FLASHFREQ="80m"

#
# ESP32S3-Specific
#
CONFIG_ESP32S3_DEFAULT_CPU_FREQ_240=y
CONFIG_ESP32S3_DEFAULT_CPU_FREQ_MHZ=240

#
# Audio HAL
#
CONFIG_ESP32_S3_KORVO2_V3_BOARD=y

#
# SPI RAM config
#
CONFIG_ESP32S3_SPIRAM_SUPPORT=y
CONFIG_SPIRAM_MODE_OCT=y
CONFIG_SPIRAM_TYPE_AUTO=y
CONFIG_SPIRAM_SPEED_80M=y
CONFIG_SPIRAM_TRY_ALLOCATE_WIFI_LWIP=y

#
# SPI RAM config
#
CONFIG_SPIRAM=y
CONFIG_SPIRAM_BOOT_INIT=y
CONFIG_SPIRAM_USE_MALLOC=y
CONFIG_SPIRAM_SPEED_80M=y
CONFIG_SPIRAM_RODATA=y
CONFIG_SPIRAM_FETCH_INSTRUCTIONS=y
CONFIG_SPIRAM_MALLOC_ALWAYSINTERNAL=2048
CONFIG_SPIRAM_MALLOC_RESERVE_INTERNAL=18432
CONFIG_SPIRAM_ALLOW_BSS_SEG_EXTERNAL_MEMORY=y
CONFIG_SPIRAM_ALLOW_STACK_EXTERNAL_MEMORY=y
CONFIG_SPIRAM_TRY_ALLOCATE_WIFI_LWIP=y
```

## examples/recorder/element_cb_sdcard_amr/sdkconfig.defaults
```kconfig
#
# Serial flasher config
#
CONFIG_ESPTOOLPY_BAUD_2MB=y
CONFIG_ESPTOOLPY_BAUD=2000000
CONFIG_ESPTOOLPY_FLASHFREQ_80M=y
CONFIG_FLASHMODE_QIO=y

#
# ESP32-specific
#
CONFIG_ESP32_DEFAULT_CPU_FREQ_240=y
CONFIG_ESP32_DEFAULT_CPU_FREQ_MHZ=240
CONFIG_SPIRAM_SUPPORT=y
CONFIG_SPIRAM_ALLOW_STACK_EXTERNAL_MEMORY=y
CONFIG_FREERTOS_ENABLE_BACKWARD_COMPATIBILITY=y

#
# SPI RAM config
#
CONFIG_SPIRAM_BOOT_INIT=y
CONFIG_SPIRAM_USE_MALLOC=y
CONFIG_SPIRAM_TYPE_AUTO=y
CONFIG_SPIRAM_SPEED_80M=y
CONFIG_SPIRAM_MEMTEST=y
CONFIG_SPIRAM_CACHE_WORKAROUND=y
CONFIG_SPIRAM_ALLOW_STACK_EXTERNAL_MEMORY=y

#
# FAT Filesystem support
#
CONFIG_FATFS_CODEPAGE_936=y
CONFIG_FATFS_LFN_HEAP=y
CONFIG_FATFS_MAX_LFN=255
CONFIG_FATFS_FS_LOCK=5
CONFIG_FATFS_ALLOC_PREFER_EXTRAM=y
```

## examples/recorder/element_wav_amr_sdcard/sdkconfig.defaults
```kconfig
#
# Serial flasher config
#
CONFIG_ESPTOOLPY_FLASHFREQ_80M=y
CONFIG_FLASHMODE_QIO=y

CONFIG_FREERTOS_ENABLE_BACKWARD_COMPATIBILITY=y

#
# ESP32-specific
#
CONFIG_SPIRAM=y

#
# SPI RAM config
#
CONFIG_SPIRAM_BOOT_INIT=y
CONFIG_SPIRAM_USE_MALLOC=y
CONFIG_SPIRAM_MEMTEST=y
CONFIG_SPIRAM_ALLOW_STACK_EXTERNAL_MEMORY=y

#
# FAT Filesystem support
#
CONFIG_FATFS_CODEPAGE_936=y
CONFIG_FATFS_LFN_HEAP=y
CONFIG_FATFS_MAX_LFN=255
CONFIG_FATFS_FS_LOCK=5
```

## examples/recorder/pipeline_amr_sdcard/main/Kconfig.projbuild
```kconfig
menu "Example configuration"
choice AUDIO_TYPE
    prompt "Audio encoder file type"
    default CHOICE_AMR_NB
    help
        Select a file type to save recording
config CHOICE_AMR_NB
    bool "amrnb"
config CHOICE_AMR_WB
    bool "amrwb"
endchoice
endmenu
```

## examples/recorder/pipeline_amr_sdcard/sdkconfig.defaults
```kconfig
# Override some defaults
CONFIG_ESP32_DEFAULT_CPU_FREQ_240=y
CONFIG_FREERTOS_HZ=1000
CONFIG_FATFS_CODEPAGE_936=y
CONFIG_FATFS_LFN_HEAP=y
CONFIG_FATFS_MAX_LFN=255
CONFIG_FATFS_FS_LOCK=5
```

## examples/recorder/pipeline_raw_http/sdkconfig.defaults
```kconfig
#
# Bootloader config
#
CONFIG_BOOTLOADER_OFFSET_IN_FLASH=0x1000
CONFIG_BOOTLOADER_COMPILER_OPTIMIZATION_SIZE=y

#
# Serial flasher config
#
CONFIG_ESPTOOLPY_HEADER_FLASHSIZE_UPDATE=y
CONFIG_ESPTOOLPY_BEFORE_RESET=y
CONFIG_ESPTOOLPY_FLASHFREQ_80M=y
CONFIG_ESPTOOLPY_FLASHSIZE_4MB=y
CONFIG_OPTIMIZATION_LEVEL_RELEASE=y
CONFIG_ESPTOOLPY_FLASHSIZE_4MB=y
# end of Serial flasher config

CONFIG_FREERTOS_ENABLE_BACKWARD_COMPATIBILITY=y

#
# Partition Table
#
CONFIG_PARTITION_TABLE_CUSTOM=y
CONFIG_PARTITION_TABLE_CUSTOM_FILENAME="partitions_raw_http_example.csv"
CONFIG_PARTITION_TABLE_FILENAME="partitions_raw_http_example.csv"
CONFIG_PARTITION_TABLE_MD5=y
# end of Partition Table
```

## examples/recorder/pipeline_recording_to_sdcard/main/Kconfig.projbuild
```kconfig
menu "Example configuration"

choice ENCODER_TYPE
    prompt "Encoding type of recording file"
    default CHOICE_WAV_ENCODER
    help
        Select a file type to save recording

config CHOICE_WAV_ENCODER
    bool "wav encoder"

config CHOICE_OPUS_ENCODER
    bool "opus encoder"

config CHOICE_AAC_ENCODER
    bool "aac encoder"

config CHOICE_AMR_NB_ENCODER
    bool "amrnb encoder"

config CHOICE_AMR_WB_ENCODER
    bool "amrwb encoder"

endchoice
endmenu
```

## examples/recorder/pipeline_recording_to_sdcard/sdkconfig.defaults
```kconfig
#
# Serial flasher config
#
CONFIG_ESPTOOLPY_FLASHMODE_QIO=y
CONFIG_ESPTOOLPY_FLASHMODE="qio"
CONFIG_ESPTOOLPY_FLASHFREQ_80M=y
CONFIG_ESPTOOLPY_FLASHSIZE_4MB=y

#
# ESP32-specific
#
CONFIG_FREERTOS_HZ=1000

CONFIG_FREERTOS_ENABLE_BACKWARD_COMPATIBILITY=y

#
# FAT Filesystem support
#
CONFIG_FATFS_CODEPAGE_936=y
CONFIG_FATFS_LFN_HEAP=y
CONFIG_FATFS_MAX_LFN=255
CONFIG_FATFS_FS_LOCK=5

#
# SPI RAM config
#
CONFIG_SPIRAM=y
CONFIG_SPIRAM_BOOT_INIT=y
CONFIG_SPIRAM_USE_MALLOC=y
CONFIG_SPIRAM_SPEED_80M=y
CONFIG_SPIRAM_ALLOW_STACK_EXTERNAL_MEMORY=y
```

## examples/recorder/pipeline_recording_to_sdcard/sdkconfig.defaults.esp32s3
```kconfig
CONFIG_IDF_CMAKE=y
CONFIG_IDF_TARGET_ARCH_XTENSA=y
CONFIG_IDF_TARGET="esp32s3"
CONFIG_IDF_TARGET_ESP32S3=y
CONFIG_IDF_FIRMWARE_CHIP_ID=0x0009

#
# SPI RAM config
#
CONFIG_ESP32S3_SPIRAM_SUPPORT=y
CONFIG_SPIRAM_MODE_OCT=y

#
# Audio HAL
#
CONFIG_ESP32_S3_KORVO2_V3_BOARD=y
```

## examples/recorder/pipeline_wav_amr_sdcard/sdkconfig.defaults
```kconfig
# Override some defaults
CONFIG_FREERTOS_HZ=1000
CONFIG_FATFS_CODEPAGE_936=y
CONFIG_FATFS_LFN_HEAP=y
CONFIG_FATFS_MAX_LFN=255
CONFIG_FATFS_FS_LOCK=5
CONFIG_FREERTOS_ENABLE_BACKWARD_COMPATIBILITY=y
```

## examples/speech_recognition/wwe/sdkconfig.defaults
```kconfig
#
# Serial flasher config
#
CONFIG_ESPTOOLPY_FLASHMODE_QIO=y
CONFIG_ESPTOOLPY_FLASH_SAMPLE_MODE_STR=y
CONFIG_ESPTOOLPY_FLASHFREQ_80M=y
CONFIG_ESPTOOLPY_FLASHFREQ="80m"
CONFIG_ESPTOOLPY_HEADER_FLASHSIZE_UPDATE=y
# end of Serial flasher config

CONFIG_FREERTOS_ENABLE_BACKWARD_COMPATIBILITY=y

#
# Compiler options
#
CONFIG_COMPILER_OPTIMIZATION_PERF=y

#
# ESP WDT CONFIG
#
# CONFIG_TASK_WDT_PANIC is not set
CONFIG_TASK_WDT_TIMEOUT_S=10
```

## examples/speech_recognition/wwe/sdkconfig.defaults.esp32
```kconfig
#
# Serial flasher config
#
CONFIG_ESPTOOLPY_FLASHSIZE_4MB=y
CONFIG_ESPTOOLPY_FLASHSIZE="4MB"
# end of Serial flasher config

#
# Partition Table
#
# CONFIG_PARTITION_TABLE_SINGLE_APP is not set
# CONFIG_PARTITION_TABLE_SINGLE_APP_LARGE is not set
# CONFIG_PARTITION_TABLE_TWO_OTA is not set
CONFIG_PARTITION_TABLE_CUSTOM=y
CONFIG_PARTITION_TABLE_CUSTOM_FILENAME="partitions_esp32.csv"
CONFIG_PARTITION_TABLE_FILENAME="partitions_esp32.csv"
CONFIG_PARTITION_TABLE_MD5=y
# end of Partition Table

#
# Audio HAL
#
CONFIG_ESP_LYRAT_MINI_V1_1_BOARD=y

#
# Audio Recorder
#
CONFIG_AFE_MIC_NUM=1
# end of Audio Recorder

#
# ESP Speech Recognition
#
CONFIG_USE_WAKENET=y
CONFIG_SR_WN_WN5_HILEXIN=y
# CONFIG_USE_MULTINET is not set

#
# ESP32-specific
#
CONFIG_ESP32_ECO3_CACHE_LOCK_FIX=y
CONFIG_ESP32_REV_MIN_0=y
CONFIG_ESP32_REV_MIN=0
CONFIG_ESP32_DEFAULT_CPU_FREQ_240=y
CONFIG_ESP32_DEFAULT_CPU_FREQ_MHZ=240
CONFIG_ESP32_SPIRAM_SUPPORT=y

#
# SPI RAM config
#
CONFIG_SPIRAM_SPEED_80M=y
CONFIG_SPIRAM=y
CONFIG_SPIRAM_BOOT_INIT=y
CONFIG_SPIRAM_ALLOW_BSS_SEG_EXTERNAL_MEMORY=y
CONFIG_SPIRAM_CACHE_WORKAROUND=y
CONFIG_SPIRAM_MALLOC_ALWAYSINTERNAL=4096
CONFIG_SPIRAM_ALLOW_STACK_EXTERNAL_MEMORY=y
```

## examples/speech_recognition/wwe/sdkconfig.defaults.esp32p4
```kconfig
CONFIG_IDF_CMAKE=y
CONFIG_IDF_TARGET_ARCH_RISCV=y
CONFIG_IDF_TARGET_ARCH="riscv"
CONFIG_IDF_TARGET="esp32p4"
CONFIG_IDF_TARGET_ESP32P4=y
CONFIG_ESP_DEFAULT_CPU_FREQ_MHZ_360=y
CONFIG_ESP_DEFAULT_CPU_FREQ_MHZ=360
CONFIG_IDF_EXPERIMENTAL_FEATURES=y

#
# SPI RAM config
#
CONFIG_SPIRAM=y
CONFIG_SPIRAM_SPEED_200M=y
CONFIG_SPIRAM_ALLOW_STACK_EXTERNAL_MEMORY=y

#
# Serial flasher config
#
CONFIG_ESPTOOLPY_FLASHSIZE_8MB=y
CONFIG_ESPTOOLPY_FLASHSIZE="8MB"
# end of Serial flasher config

#
# Partition Table
#
# CONFIG_PARTITION_TABLE_SINGLE_APP is not set
# CONFIG_PARTITION_TABLE_SINGLE_APP_LARGE is not set
# CONFIG_PARTITION_TABLE_TWO_OTA is not set
CONFIG_PARTITION_TABLE_CUSTOM=y
CONFIG_PARTITION_TABLE_CUSTOM_FILENAME="partitions.csv"
CONFIG_PARTITION_TABLE_FILENAME="partitions.csv"
CONFIG_PARTITION_TABLE_MD5=y
# end of Partition Table

#
# Audio HAL
#
CONFIG_ESP32_P4_FUNCTION_EV_BOARD=y

#
# DSP Library
#
CONFIG_DSP_ANSI=y
CONFIG_DSP_OPTIMIZATION=0
# CONFIG_DSP_MAX_FFT_SIZE_512 is not set
# CONFIG_DSP_MAX_FFT_SIZE_1024 is not set
# CONFIG_DSP_MAX_FFT_SIZE_2048 is not set
CONFIG_DSP_MAX_FFT_SIZE_4096=y
# CONFIG_DSP_MAX_FFT_SIZE_8192 is not set
# CONFIG_DSP_MAX_FFT_SIZE_16384 is not set
# CONFIG_DSP_MAX_FFT_SIZE_32768 is not set
CONFIG_DSP_MAX_FFT_SIZE=4096
# end of DSP Library
# end of Component config

#
# ESP Speech Recognition
#
CONFIG_MODEL_IN_FLASH=y
# CONFIG_MODEL_IN_SDCARD is not set
CONFIG_USE_AFE=y
CONFIG_AFE_INTERFACE_V1=y
CONFIG_USE_WAKENET=y
# CONFIG_SR_WN_WN8_ALEXA is not set
CONFIG_SR_WN_WN9_HILEXIN=y
# CONFIG_SR_WN_WN9_XIAOAITONGXUE is not set
# CONFIG_SR_WN_WN9_ALEXA is not set
# CONFIG_SR_WN_WN9_HIESP is not set
# CONFIG_SR_WN_WN9_NIHAOXIAOZHI is not set
# CONFIG_SR_WN_WN9_CUSTOMWORD is not set
# CONFIG_SR_WN_LOAD_MULIT_WORD is not set
CONFIG_USE_MULTINET=y
# CONFIG_SR_MN_CN_NONE is not set
# CONFIG_SR_MN_CN_MULTINET5_RECOGNITION_QUANT8 is not set
# CONFIG_SR_MN_CN_MULTINET6_QUANT
CONFIG_SR_MN_CN_MULTINET7_QUANT=y
# CONFIG_SR_MN_CN_MULTINET6_AC_QUANT is not set
CONFIG_SR_MN_EN_NONE=y
# CONFIG_SR_MN_EN_MULTINET5_SINGLE_RECOGNITION_QUANT8 is not set
# CONFIG_SR_MN_EN_MULTINET6_QUANT is not set
# CONFIG_SR_MN_EN_MULTINET7_QUANT is not set
# end of ESP Speech Recognition
```
