## examples/system/power_save/sdkconfig.defaults
```kconfig
### Startup time optimization for esp32.
### The user needs to ensure that there is no warning output at startup.
# CONFIG_BOOTLOADER_LOG_LEVEL_NONE=y
# CONFIG_LOG_DEFAULT_LEVEL_WARN=y
# CONFIG_SPIRAM_MEMTEST=n

#
# Serial flasher config
#
CONFIG_ESPTOOLPY_FLASHSIZE_4MB=y

#
# SPI RAM config
#
CONFIG_MAIN_TASK_STACK_SIZE=3072
CONFIG_SPIRAM_SUPPORT=y
CONFIG_SPIRAM_IGNORE_NOTFOUND=y
CONFIG_SPIRAM_ALLOW_STACK_EXTERNAL_MEMORY=y
CONFIG_SPIRAM_SPEED_80M=y
CONFIG_SPIRAM_TRY_ALLOCATE_WIFI_LWIP=y

# Increase default app partition size to accommodate console example
# by providing new partition table in "power_save.csv"
CONFIG_PARTITION_TABLE_CUSTOM=y
CONFIG_PARTITION_TABLE_CUSTOM_FILENAME="power_save.csv"
CONFIG_PARTITION_TABLE_CUSTOM_APP_BIN_OFFSET=0x10000
CONFIG_PARTITION_TABLE_FILENAME="power_save.csv"
CONFIG_APP_OFFSET=0x10000


CONFIG_ESP_TLS_INSECURE=y
CONFIG_ESP_TLS_SKIP_SERVER_CERT_VERIFY=y
CONFIG_ESP_SYSTEM_EVENT_TASK_STACK_SIZE=3072

CONFIG_FREERTOS_ENABLE_BACKWARD_COMPATIBILITY=y

#
# PHY
#
CONFIG_ESP_PHY_MAC_BB_PD=y
CONFIG_ESP_PHY_ENABLE_USB=y
# end of PHY

#
# Power Management
#
CONFIG_PM_ENABLE=y
# CONFIG_PM_DFS_INIT_AUTO is not set
# CONFIG_PM_PROFILING is not set
# CONFIG_PM_TRACE is not set
CONFIG_PM_SLP_IRAM_OPT=y
CONFIG_PM_RTOS_IDLE_OPT=y
CONFIG_PM_SLP_DISABLE_GPIO=y
CONFIG_PM_POWER_DOWN_CPU_IN_LIGHT_SLEEP=y
CONFIG_PM_POWER_DOWN_TAGMEM_IN_LIGHT_SLEEP=y
# end of Power Management

#
# Wi-Fi
#
# Enable wifi sleep iram optimization
CONFIG_ESP_WIFI_SLP_IRAM_OPT=y
CONFIG_ESP32_WIFI_IRAM_OPT=n
CONFIG_ESP32_WIFI_RX_IRAM_OPT=n
CONFIG_ESP_WIFI_SLP_DEFAULT_MIN_ACTIVE_TIME=12
CONFIG_ESP_WIFI_SLP_DEFAULT_MAX_ACTIVE_TIME=60
CONFIG_ESP_WIFI_STA_DISCONNECTED_PM_ENABLE=y
CONFIG_ESP_WIFI_SOFTAP_SUPPORT=n
CONFIG_ESP_WIFI_SLP_BEACON_LOST_OPT=y
CONFIG_ESP_WIFI_SLP_BEACON_LOST_TIMEOUT=12
CONFIG_ESP_WIFI_SLP_BEACON_LOST_THRESHOLD=5
CONFIG_ESP_WIFI_SLP_PHY_ON_DELTA_EARLY_TIME=2
CONFIG_ESP_WIFI_SLP_PHY_OFF_DELTA_TIMEOUT_TIME=1
# end of Wi-Fi

#
# FreeRTOS
#
CONFIG_FREERTOS_HZ=1000
# Enable tickless idle mode
CONFIG_FREERTOS_USE_TICKLESS_IDLE=y
CONFIG_FREERTOS_GENERATE_RUN_TIME_STATS=y
# end of FreeRTOS

#
# LWIP
#
CONFIG_LWIP_IP6_FRAG=n
CONFIG_LWIP_ESP_GRATUITOUS_ARP=n
CONFIG_LWIP_DHCPS=n
CONFIG_LWIP_IPV6=n
CONFIG_LWIP_DHCP_COARSE_TIMER_SECS=10

#
# TCP
#
CONFIG_LWIP_TCP_MSL=60000
CONFIG_LWIP_TCP_FIN_WAIT_TIMEOUT=20000

# Use RTC timer as reference
CONFIG_PM_USE_RTC_TIMER_REF=y
# Disable all GPIO at light sleep
CONFIG_GPIO_ESP32_SUPPORT_SWITCH_SLP_PULL=y
```

## examples/system/power_save/sdkconfig.defaults.esp32
```kconfig
CONFIG_IDF_CMAKE=y
CONFIG_IDF_TARGET_ARCH_XTENSA=y
CONFIG_IDF_TARGET="esp32"
CONFIG_IDF_TARGET_ESP32=y
CONFIG_IDF_FIRMWARE_CHIP_ID=0x0000

#
# Audio HAL
#
CONFIG_ESP_LYRAT_V4_3_BOARD=y

#
# Sleep Config
#
CONFIG_ESP_SLEEP_RTC_BUS_ISO_WORKAROUND=y
CONFIG_ESP_SLEEP_GPIO_RESET_WORKAROUND=y
CONFIG_ESP_SLEEP_PSRAM_LEAKAGE_WORKAROUND=y
CONFIG_ESP_SLEEP_FLASH_LEAKAGE_WORKAROUND=y
CONFIG_ESP_SLEEP_MSPI_NEED_ALL_IO_PU=y
# end of Sleep Config

#
# ESP32-specific
#
CONFIG_ESP32_DEFAULT_CPU_FREQ_240=y
CONFIG_ESP32_DEFAULT_CPU_FREQ_MHZ=240
CONFIG_ESP32_RTC_CLK_SRC_EXT_CRYS=y
CONFIG_ESP32_RTC_EXT_CRYST_ADDIT_CURRENT=y
CONFIG_ESP32_TIME_SYSCALL_USE_RTC_FRC1=y
```
