## examples/speech_recognition/wwe/sdkconfig.defaults.esp32s3
```kconfig
CONFIG_IDF_CMAKE=y
CONFIG_IDF_TARGET_ARCH_XTENSA=y
CONFIG_IDF_TARGET="esp32s3"
CONFIG_IDF_TARGET_ESP32S3=y
CONFIG_IDF_FIRMWARE_CHIP_ID=0x0009

#
# SDK tool configuration
#
CONFIG_SDK_TOOLPREFIX="xtensa-esp32s3-elf-"

#
# Serial flasher config
#
CONFIG_ESPTOOLPY_BAUD_OTHER_VAL=115200
CONFIG_ESPTOOLPY_FLASHMODE_QIO=y
CONFIG_ESPTOOLPY_FLASHFREQ_80M=y
CONFIG_ESPTOOLPY_FLASHFREQ="80m"
CONFIG_ESPTOOLPY_FLASHSIZE_8MB=y

# end of Serial flasher config

#
# Partition Table
#
# CONFIG_PARTITION_TABLE_SINGLE_APP is not set
# CONFIG_PARTITION_TABLE_SINGLE_APP_LARGE is not set
# CONFIG_PARTITION_TABLE_TWO_OTA is not set
CONFIG_PARTITION_TABLE_CUSTOM=y
CONFIG_PARTITION_TABLE_CUSTOM_FILENAME="partitions.csv"
CONFIG_PARTITION_TABLE_FILENAME="partitions.csv"
CONFIG_PARTITION_TABLE_OFFSET=0x8000
CONFIG_PARTITION_TABLE_MD5=y
# end of Partition Table

#
# Audio HAL
#
CONFIG_ESP32_S3_KORVO2_V3_BOARD=y
# end of Audio HAL

#
# Audio Recorder
#
CONFIG_AFE_MIC_NUM=2
# end of Audio Recorder

#
# ESP Speech Recognition
#
CONFIG_MODEL_IN_SPIFFS=y
# CONFIG_MODEL_IN_SDCARD is not set
CONFIG_USE_WAKENET=y
# CONFIG_SR_WN_MODEL_WN7_QUANT is not set
CONFIG_SR_WN_MODEL_WN7_QUANT8=y
# CONFIG_SR_WN_MODEL_WN8_QUANT is not set
# CONFIG_SR_WN_MODEL_WN8_QUANT8 is not set
# CONFIG_SR_WN_WN7_XIAOAITONGXUE is not set
# CONFIG_SR_WN_WN7_ALEXA is not set
CONFIG_SR_WN_WN7_HILEXIN=y
CONFIG_USE_MULTINET=y
CONFIG_SR_MN_CHINESE=y
# CONFIG_SR_MN_ENGLISH is not set
CONFIG_SR_MN_CN_MULTINET3_SINGLE_RECOGNITION=y
# CONFIG_SR_MN_CN_MULTINET3_CONTINUOUS_RECOGNITION is not set
# CONFIG_SR_MN_CN_MULTINET4_SINGLE_RECOGNITION is not set

#
# Add speech commands
#
CONFIG_CN_SPEECH_COMMAND_ID0="da kai kong tiao"
CONFIG_CN_SPEECH_COMMAND_ID1="guan bi kong tiao"
CONFIG_CN_SPEECH_COMMAND_ID2="zeng da feng su"
CONFIG_CN_SPEECH_COMMAND_ID3="jian xiao feng su"
CONFIG_CN_SPEECH_COMMAND_ID4="sheng gao yi du"
CONFIG_CN_SPEECH_COMMAND_ID5="jiang di yi du"
CONFIG_CN_SPEECH_COMMAND_ID6="zhi re mo shi"
CONFIG_CN_SPEECH_COMMAND_ID7="zhi leng mo shi"
CONFIG_CN_SPEECH_COMMAND_ID8="song feng mo shi"
CONFIG_CN_SPEECH_COMMAND_ID9="jie neng mo shi"
CONFIG_CN_SPEECH_COMMAND_ID10="chu shi mo shi"
CONFIG_CN_SPEECH_COMMAND_ID11="jian kang mo shi"
CONFIG_CN_SPEECH_COMMAND_ID12="shui mian mo shi"
CONFIG_CN_SPEECH_COMMAND_ID13="da kai lan ya"
CONFIG_CN_SPEECH_COMMAND_ID14="guan bi lan ya"
CONFIG_CN_SPEECH_COMMAND_ID15="kai shi bo fang"
CONFIG_CN_SPEECH_COMMAND_ID16="zan ting bo fang"
CONFIG_CN_SPEECH_COMMAND_ID17="ding shi yi xiao shi"
CONFIG_CN_SPEECH_COMMAND_ID18="da kai dian deng"
CONFIG_CN_SPEECH_COMMAND_ID19="guan bi dian deng"
CONFIG_CN_SPEECH_COMMAND_ID20=""
CONFIG_CN_SPEECH_COMMAND_ID21=""
CONFIG_CN_SPEECH_COMMAND_ID22=""
CONFIG_CN_SPEECH_COMMAND_ID23=""
CONFIG_CN_SPEECH_COMMAND_ID24=""
CONFIG_CN_SPEECH_COMMAND_ID25=""
CONFIG_CN_SPEECH_COMMAND_ID26=""
CONFIG_CN_SPEECH_COMMAND_ID27=""
CONFIG_CN_SPEECH_COMMAND_ID28=""
CONFIG_CN_SPEECH_COMMAND_ID29=""
CONFIG_CN_SPEECH_COMMAND_ID30=""
CONFIG_CN_SPEECH_COMMAND_ID31=""
CONFIG_CN_SPEECH_COMMAND_ID32=""
CONFIG_CN_SPEECH_COMMAND_ID33=""
CONFIG_CN_SPEECH_COMMAND_ID34=""
CONFIG_CN_SPEECH_COMMAND_ID35=""
CONFIG_CN_SPEECH_COMMAND_ID36=""
CONFIG_CN_SPEECH_COMMAND_ID37=""
CONFIG_CN_SPEECH_COMMAND_ID38=""
CONFIG_CN_SPEECH_COMMAND_ID39=""
CONFIG_CN_SPEECH_COMMAND_ID40=""
CONFIG_CN_SPEECH_COMMAND_ID41=""
CONFIG_CN_SPEECH_COMMAND_ID42=""
CONFIG_CN_SPEECH_COMMAND_ID43=""
CONFIG_CN_SPEECH_COMMAND_ID44=""
CONFIG_CN_SPEECH_COMMAND_ID45=""
CONFIG_CN_SPEECH_COMMAND_ID46=""
CONFIG_CN_SPEECH_COMMAND_ID47=""
CONFIG_CN_SPEECH_COMMAND_ID48=""
CONFIG_CN_SPEECH_COMMAND_ID49=""
CONFIG_CN_SPEECH_COMMAND_ID50=""
CONFIG_CN_SPEECH_COMMAND_ID51=""
CONFIG_CN_SPEECH_COMMAND_ID52=""
CONFIG_CN_SPEECH_COMMAND_ID53=""
CONFIG_CN_SPEECH_COMMAND_ID54=""
CONFIG_CN_SPEECH_COMMAND_ID55=""
CONFIG_CN_SPEECH_COMMAND_ID56=""
CONFIG_CN_SPEECH_COMMAND_ID57=""
CONFIG_CN_SPEECH_COMMAND_ID58=""
CONFIG_CN_SPEECH_COMMAND_ID59=""
CONFIG_CN_SPEECH_COMMAND_ID60=""
CONFIG_CN_SPEECH_COMMAND_ID61=""
CONFIG_CN_SPEECH_COMMAND_ID62=""
CONFIG_CN_SPEECH_COMMAND_ID63=""
CONFIG_CN_SPEECH_COMMAND_ID64=""
CONFIG_CN_SPEECH_COMMAND_ID65=""
CONFIG_CN_SPEECH_COMMAND_ID66=""
CONFIG_CN_SPEECH_COMMAND_ID67=""
CONFIG_CN_SPEECH_COMMAND_ID68=""
CONFIG_CN_SPEECH_COMMAND_ID69=""
CONFIG_CN_SPEECH_COMMAND_ID70=""
CONFIG_CN_SPEECH_COMMAND_ID71=""
CONFIG_CN_SPEECH_COMMAND_ID72=""
CONFIG_CN_SPEECH_COMMAND_ID73=""
CONFIG_CN_SPEECH_COMMAND_ID74=""
CONFIG_CN_SPEECH_COMMAND_ID75=""
CONFIG_CN_SPEECH_COMMAND_ID76=""
CONFIG_CN_SPEECH_COMMAND_ID77=""
CONFIG_CN_SPEECH_COMMAND_ID78=""
CONFIG_CN_SPEECH_COMMAND_ID79=""
CONFIG_CN_SPEECH_COMMAND_ID80=""
CONFIG_CN_SPEECH_COMMAND_ID81=""
CONFIG_CN_SPEECH_COMMAND_ID82=""
CONFIG_CN_SPEECH_COMMAND_ID83=""
CONFIG_CN_SPEECH_COMMAND_ID84=""
CONFIG_CN_SPEECH_COMMAND_ID85=""
CONFIG_CN_SPEECH_COMMAND_ID86=""
CONFIG_CN_SPEECH_COMMAND_ID87=""
CONFIG_CN_SPEECH_COMMAND_ID88=""
CONFIG_CN_SPEECH_COMMAND_ID89=""
CONFIG_CN_SPEECH_COMMAND_ID90=""
CONFIG_CN_SPEECH_COMMAND_ID91=""
CONFIG_CN_SPEECH_COMMAND_ID92=""
CONFIG_CN_SPEECH_COMMAND_ID93=""
CONFIG_CN_SPEECH_COMMAND_ID94=""
CONFIG_CN_SPEECH_COMMAND_ID95=""
CONFIG_CN_SPEECH_COMMAND_ID96=""
CONFIG_CN_SPEECH_COMMAND_ID97=""
CONFIG_CN_SPEECH_COMMAND_ID98=""
CONFIG_CN_SPEECH_COMMAND_ID99=""
CONFIG_CN_SPEECH_COMMAND_ID100=""
CONFIG_CN_SPEECH_COMMAND_ID101=""
CONFIG_CN_SPEECH_COMMAND_ID102=""
CONFIG_CN_SPEECH_COMMAND_ID103=""
CONFIG_CN_SPEECH_COMMAND_ID104=""
CONFIG_CN_SPEECH_COMMAND_ID105=""
CONFIG_CN_SPEECH_COMMAND_ID106=""
CONFIG_CN_SPEECH_COMMAND_ID107=""
CONFIG_CN_SPEECH_COMMAND_ID108=""
CONFIG_CN_SPEECH_COMMAND_ID109=""
CONFIG_CN_SPEECH_COMMAND_ID110=""
CONFIG_CN_SPEECH_COMMAND_ID111=""
CONFIG_CN_SPEECH_COMMAND_ID112=""
CONFIG_CN_SPEECH_COMMAND_ID113=""
CONFIG_CN_SPEECH_COMMAND_ID114=""
CONFIG_CN_SPEECH_COMMAND_ID115=""
CONFIG_CN_SPEECH_COMMAND_ID116=""
CONFIG_CN_SPEECH_COMMAND_ID117=""
CONFIG_CN_SPEECH_COMMAND_ID118=""
CONFIG_CN_SPEECH_COMMAND_ID119=""
CONFIG_CN_SPEECH_COMMAND_ID120=""
CONFIG_CN_SPEECH_COMMAND_ID121=""
CONFIG_CN_SPEECH_COMMAND_ID122=""
CONFIG_CN_SPEECH_COMMAND_ID123=""
CONFIG_CN_SPEECH_COMMAND_ID124=""
CONFIG_CN_SPEECH_COMMAND_ID125=""
CONFIG_CN_SPEECH_COMMAND_ID126=""
CONFIG_CN_SPEECH_COMMAND_ID127=""
CONFIG_CN_SPEECH_COMMAND_ID128=""
CONFIG_CN_SPEECH_COMMAND_ID129=""
CONFIG_CN_SPEECH_COMMAND_ID130=""
CONFIG_CN_SPEECH_COMMAND_ID131=""
CONFIG_CN_SPEECH_COMMAND_ID132=""
CONFIG_CN_SPEECH_COMMAND_ID133=""
CONFIG_CN_SPEECH_COMMAND_ID134=""
CONFIG_CN_SPEECH_COMMAND_ID135=""
CONFIG_CN_SPEECH_COMMAND_ID136=""
CONFIG_CN_SPEECH_COMMAND_ID137=""
CONFIG_CN_SPEECH_COMMAND_ID138=""
CONFIG_CN_SPEECH_COMMAND_ID139=""
CONFIG_CN_SPEECH_COMMAND_ID140=""
CONFIG_CN_SPEECH_COMMAND_ID141=""
CONFIG_CN_SPEECH_COMMAND_ID142=""
CONFIG_CN_SPEECH_COMMAND_ID143=""
CONFIG_CN_SPEECH_COMMAND_ID144=""
CONFIG_CN_SPEECH_COMMAND_ID145=""
CONFIG_CN_SPEECH_COMMAND_ID146=""
CONFIG_CN_SPEECH_COMMAND_ID147=""
CONFIG_CN_SPEECH_COMMAND_ID148=""
CONFIG_CN_SPEECH_COMMAND_ID149=""
CONFIG_CN_SPEECH_COMMAND_ID150=""
CONFIG_CN_SPEECH_COMMAND_ID151=""
CONFIG_CN_SPEECH_COMMAND_ID152=""
CONFIG_CN_SPEECH_COMMAND_ID153=""
CONFIG_CN_SPEECH_COMMAND_ID154=""
CONFIG_CN_SPEECH_COMMAND_ID155=""
CONFIG_CN_SPEECH_COMMAND_ID156=""
CONFIG_CN_SPEECH_COMMAND_ID157=""
CONFIG_CN_SPEECH_COMMAND_ID158=""
CONFIG_CN_SPEECH_COMMAND_ID159=""
CONFIG_CN_SPEECH_COMMAND_ID160=""
CONFIG_CN_SPEECH_COMMAND_ID161=""
CONFIG_CN_SPEECH_COMMAND_ID162=""
CONFIG_CN_SPEECH_COMMAND_ID163=""
CONFIG_CN_SPEECH_COMMAND_ID164=""
CONFIG_CN_SPEECH_COMMAND_ID165=""
CONFIG_CN_SPEECH_COMMAND_ID166=""
CONFIG_CN_SPEECH_COMMAND_ID167=""
CONFIG_CN_SPEECH_COMMAND_ID168=""
CONFIG_CN_SPEECH_COMMAND_ID169=""
CONFIG_CN_SPEECH_COMMAND_ID170=""
CONFIG_CN_SPEECH_COMMAND_ID171=""
CONFIG_CN_SPEECH_COMMAND_ID172=""
CONFIG_CN_SPEECH_COMMAND_ID173=""
CONFIG_CN_SPEECH_COMMAND_ID174=""
CONFIG_CN_SPEECH_COMMAND_ID175=""
CONFIG_CN_SPEECH_COMMAND_ID176=""
CONFIG_CN_SPEECH_COMMAND_ID177=""
CONFIG_CN_SPEECH_COMMAND_ID178=""
CONFIG_CN_SPEECH_COMMAND_ID179=""
CONFIG_CN_SPEECH_COMMAND_ID180=""
CONFIG_CN_SPEECH_COMMAND_ID181=""
CONFIG_CN_SPEECH_COMMAND_ID182=""
CONFIG_CN_SPEECH_COMMAND_ID183=""
CONFIG_CN_SPEECH_COMMAND_ID184=""
CONFIG_CN_SPEECH_COMMAND_ID185=""
CONFIG_CN_SPEECH_COMMAND_ID186=""
CONFIG_CN_SPEECH_COMMAND_ID187=""
CONFIG_CN_SPEECH_COMMAND_ID188=""
CONFIG_CN_SPEECH_COMMAND_ID189=""
CONFIG_CN_SPEECH_COMMAND_ID190=""
CONFIG_CN_SPEECH_COMMAND_ID191=""
CONFIG_CN_SPEECH_COMMAND_ID192=""
CONFIG_CN_SPEECH_COMMAND_ID193=""
CONFIG_CN_SPEECH_COMMAND_ID194=""
CONFIG_CN_SPEECH_COMMAND_ID195=""
CONFIG_CN_SPEECH_COMMAND_ID196=""
CONFIG_CN_SPEECH_COMMAND_ID197=""
CONFIG_CN_SPEECH_COMMAND_ID198=""
CONFIG_CN_SPEECH_COMMAND_ID199=""
# end of Add speech commands
# end of ESP Speech Recognition

#
# Compiler options
#
# CONFIG_COMPILER_OPTIMIZATION_DEFAULT is not set
# CONFIG_COMPILER_OPTIMIZATION_SIZE is not set
CONFIG_COMPILER_OPTIMIZATION_PERF=y
# CONFIG_COMPILER_OPTIMIZATION_NONE is not set
CONFIG_COMPILER_OPTIMIZATION_ASSERTIONS_ENABLE=y
# CONFIG_COMPILER_OPTIMIZATION_ASSERTIONS_SILENT is not set
# CONFIG_COMPILER_OPTIMIZATION_ASSERTIONS_DISABLE is not set
CONFIG_COMPILER_OPTIMIZATION_ASSERTION_LEVEL=2
# CONFIG_COMPILER_OPTIMIZATION_CHECKS_SILENT is not set
CONFIG_COMPILER_HIDE_PATHS_MACROS=y
# CONFIG_COMPILER_CXX_EXCEPTIONS is not set
# CONFIG_COMPILER_CXX_RTTI is not set
CONFIG_COMPILER_STACK_CHECK_MODE_NONE=y
# CONFIG_COMPILER_STACK_CHECK_MODE_NORM is not set
# CONFIG_COMPILER_STACK_CHECK_MODE_STRONG is not set
# CONFIG_COMPILER_STACK_CHECK_MODE_ALL is not set
# CONFIG_COMPILER_WARN_WRITE_STRINGS is not set
# CONFIG_COMPILER_DISABLE_GCC8_WARNINGS is not set
# CONFIG_COMPILER_DUMP_RTL_FILES is not set
# end of Compiler options

#
# Component config
#

#
# Driver configurations
#

#
# ESP32S3-Specific
#
# CONFIG_ESP32S3_DEFAULT_CPU_FREQ_80 is not set
# CONFIG_ESP32S3_DEFAULT_CPU_FREQ_160 is not set
CONFIG_ESP32S3_DEFAULT_CPU_FREQ_240=y
CONFIG_ESP32S3_DEFAULT_CPU_FREQ_MHZ=240

#
# Cache config
#
# CONFIG_ESP32S3_INSTRUCTION_CACHE_16KB is not set
CONFIG_ESP32S3_INSTRUCTION_CACHE_32KB=y
CONFIG_ESP32S3_INSTRUCTION_CACHE_SIZE=0x8000
# CONFIG_ESP32S3_INSTRUCTION_CACHE_4WAYS is not set
CONFIG_ESP32S3_INSTRUCTION_CACHE_8WAYS=y
CONFIG_ESP32S3_ICACHE_ASSOCIATED_WAYS=8
CONFIG_ESP32S3_INSTRUCTION_CACHE_LINE_32B=y
CONFIG_ESP32S3_INSTRUCTION_CACHE_LINE_SIZE=32
# CONFIG_ESP32S3_INSTRUCTION_CACHE_WRAP is not set
# CONFIG_ESP32S3_DATA_CACHE_16KB is not set
# CONFIG_ESP32S3_DATA_CACHE_32KB is not set
CONFIG_ESP32S3_DATA_CACHE_64KB=y
CONFIG_ESP32S3_DATA_CACHE_SIZE=0x10000
# CONFIG_ESP32S3_DATA_CACHE_4WAYS is not set
CONFIG_ESP32S3_DATA_CACHE_8WAYS=y
CONFIG_ESP32S3_DCACHE_ASSOCIATED_WAYS=8
# CONFIG_ESP32S3_DATA_CACHE_LINE_32B is not set
CONFIG_ESP32S3_DATA_CACHE_LINE_64B=y
CONFIG_ESP32S3_DATA_CACHE_LINE_SIZE=64
# CONFIG_ESP32S3_DATA_CACHE_WRAP is not set
# end of Cache config

CONFIG_ESP32S3_SPIRAM_SUPPORT=y

#
# SPI RAM config
#
# CONFIG_SPIRAM_MODE_QUAD is not set
CONFIG_SPIRAM_MODE_OCT=y
CONFIG_SPIRAM_TYPE_AUTO=y
# CONFIG_SPIRAM_TYPE_ESPPSRAM64 is not set
CONFIG_SPIRAM_SIZE=-1

#
# PSRAM Clock and CS IO for ESP32S3
#
CONFIG_DEFAULT_PSRAM_CLK_IO=30
CONFIG_DEFAULT_PSRAM_CS_IO=26
# end of PSRAM Clock and CS IO for ESP32S3

# CONFIG_SPIRAM_FETCH_INSTRUCTIONS is not set
# CONFIG_SPIRAM_RODATA is not set
CONFIG_SPIRAM_SPEED_80M=y
# CONFIG_SPIRAM_SPEED_40M is not set
CONFIG_SPIRAM=y
CONFIG_SPIRAM_BOOT_INIT=y
# CONFIG_SPIRAM_IGNORE_NOTFOUND is not set
# CONFIG_SPIRAM_USE_MEMMAP is not set
# CONFIG_SPIRAM_USE_CAPS_ALLOC is not set
CONFIG_SPIRAM_USE_MALLOC=y
CONFIG_SPIRAM_MEMTEST=y
CONFIG_SPIRAM_MALLOC_ALWAYSINTERNAL=16384
# CONFIG_SPIRAM_TRY_ALLOCATE_WIFI_LWIP is not set
CONFIG_SPIRAM_MALLOC_RESERVE_INTERNAL=32768
# end of SPI RAM config

# CONFIG_ESP32S3_TRAX is not set
CONFIG_ESP32S3_TRACEMEM_RESERVE_DRAM=0x0
# CONFIG_ESP32S3_ULP_COPROC_ENABLED is not set
CONFIG_ESP32S3_ULP_COPROC_RESERVE_MEM=0
CONFIG_ESP32S3_DEBUG_OCDAWARE=y
# CONFIG_ESP32S3_DEBUG_STUBS_ENABLE is not set
CONFIG_ESP32S3_BROWNOUT_DET=y
CONFIG_ESP32S3_BROWNOUT_DET_LVL_SEL_7=y
# CONFIG_ESP32S3_BROWNOUT_DET_LVL_SEL_6 is not set
# CONFIG_ESP32S3_BROWNOUT_DET_LVL_SEL_5 is not set
# CONFIG_ESP32S3_BROWNOUT_DET_LVL_SEL_4 is not set
# CONFIG_ESP32S3_BROWNOUT_DET_LVL_SEL_3 is not set
# CONFIG_ESP32S3_BROWNOUT_DET_LVL_SEL_2 is not set
# CONFIG_ESP32S3_BROWNOUT_DET_LVL_SEL_1 is not set
CONFIG_ESP32S3_BROWNOUT_DET_LVL=7
CONFIG_ESP32S3_TIME_SYSCALL_USE_RTC_FRC1=y
# CONFIG_ESP32S3_TIME_SYSCALL_USE_RTC is not set
# CONFIG_ESP32S3_TIME_SYSCALL_USE_FRC1 is not set
# CONFIG_ESP32S3_TIME_SYSCALL_USE_NONE is not set
CONFIG_ESP32S3_RTC_CLK_SRC_INT_RC=y
# CONFIG_ESP32S3_RTC_CLK_SRC_EXT_CRYS is not set
# CONFIG_ESP32S3_RTC_CLK_SRC_EXT_OSC is not set
# CONFIG_ESP32S3_RTC_CLK_SRC_INT_8MD256 is not set
CONFIG_ESP32S3_RTC_CLK_CAL_CYCLES=1024
CONFIG_ESP32S3_DEEP_SLEEP_WAKEUP_DELAY=2000
# CONFIG_ESP32S3_NO_BLOBS is not set
# CONFIG_ESP32S3_RTCDATA_IN_FAST_MEM is not set
# CONFIG_ESP32S3_USE_FIXED_STATIC_RAM_SIZE is not set
# end of ESP32S3-Specific


#
# ESP NETIF Adapter
#
CONFIG_ESP_NETIF_IP_LOST_TIMER_INTERVAL=120
CONFIG_ESP_NETIF_TCPIP_LWIP=y
# CONFIG_ESP_NETIF_LOOPBACK is not set
CONFIG_ESP_NETIF_TCPIP_ADAPTER_COMPATIBLE_LAYER=y
# end of ESP NETIF Adapter

#
# Heap memory debugging
#
CONFIG_HEAP_POISONING_DISABLED=y
# CONFIG_HEAP_POISONING_LIGHT is not set
# CONFIG_HEAP_POISONING_COMPREHENSIVE is not set
CONFIG_HEAP_TRACING_OFF=y
# CONFIG_HEAP_TRACING_STANDALONE is not set
# CONFIG_HEAP_TRACING_TOHOST is not set
# CONFIG_HEAP_ABORT_WHEN_ALLOCATION_FAILS is not set
# end of Heap memory debugging
```

## examples/system/battery/main/Kconfig.projbuild
```kconfig
menu "Example Configuration"

config VOLTAGE_OF_BATTERY_FULL
    int "voltage of battery full"
    default 4200
    help
        unit: mv

config VOLTAGE_OF_BATTERY_LOW
    int "voltage of battery low"
    default 3600
    help
        unit: mv

endmenu
```

## examples/system/coredump/main/Kconfig.projbuild
```kconfig
menu "Core dump upload configuration"

config WIFI_SSID
    string "WiFi SSID"
    default "myssid"
    help
	SSID (network name) for the example to connect to.

config WIFI_PASSWORD
    string "WiFi Password"
    default "mypassword"
    help
	WiFi password (WPA or WPA2) for the example to use.

config COREDUMP_UPLOAD_URI
    string "core dump upload uri"
    default "http://192.168.1.10:8000/upload"
    help
        URI to upload the core dump
        image.
endmenu
```

## examples/system/coredump/sdkconfig.defaults
```kconfig
#
# Serial flasher config
#
CONFIG_ESPTOOLPY_FLASHSIZE_4MB=y

CONFIG_FREERTOS_ENABLE_BACKWARD_COMPATIBILITY=y

#
# Partition Table
#
CONFIG_PARTITION_TABLE_CUSTOM=y
CONFIG_PARTITION_TABLE_CUSTOM_FILENAME="partitions.csv"
CONFIG_PARTITION_TABLE_FILENAME="partitions.csv"
CONFIG_PARTITION_TABLE_MD5=y

#
# Core dump
#
CONFIG_ESP32_ENABLE_COREDUMP_TO_FLASH=y
CONFIG_ESP32_ENABLE_COREDUMP=y
CONFIG_ESP32_CORE_DUMP_MAX_TASKS_NUM=64
```
